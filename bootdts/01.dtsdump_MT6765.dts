/dts-v1/;

/ {
	model = "MT6765";
	compatible = "mediatek,MT6765";
	interrupt-parent = <0x01>;
	#address-cells = <0x02>;
	#size-cells = <0x02>;

	chosen {
		bootargs = "console=tty0 console=ttyS0,921600n1 vmalloc=400M slub_debug=OFZPU page_owner=on swiotlb=noforce androidboot.hardware=mt6765 maxcpus=8 loop.max_part=7 firmware_class.path=/vendor/firmware";
		kaslr-seed = <0x00 0x00>;
		phandle = <0x2a>;
	};

	regulator_vibrator {
		compatible = "regulator-vibrator";
		min-volt = <0x231860>;
		max-volt = <0x30d400>;
		min-limit = <0x0f>;
		max-limit = <0x3a98>;
		vib-supply = <0x02>;
	};

	opp_table0 {
		compatible = "operating-points-v2";
		opp-shared;
		phandle = <0x05>;

		opp0 {
			opp-hz = <0x00 0x35a4e900>;
			opp-microvolt = <0x927c0>;
		};

		opp1 {
			opp-hz = <0x00 0x3a5a5ac0>;
			opp-microvolt = <0x970fe>;
		};

		opp2 {
			opp-hz = <0x00 0x40abc940>;
			opp-microvolt = <0x9d2a6>;
		};

		opp3 {
			opp-hz = <0x00 0x48993480>;
			opp-microvolt = <0xa4cb8>;
		};

		opp4 {
			opp-hz = <0x00 0x50869fc0>;
			opp-microvolt = <0xac6ca>;
		};

		opp5 {
			opp-hz = <0x00 0x58740b00>;
			opp-microvolt = <0xb40dc>;
		};

		opp6 {
			opp-hz = <0x00 0x60617640>;
			opp-microvolt = <0xbbaee>;
		};

		opp7 {
			opp-hz = <0x00 0x684ee180>;
			opp-microvolt = <0xc3500>;
		};

		opp8 {
			opp-hz = <0x00 0x6c1f7180>;
			opp-microvolt = <0xcc77c>;
		};

		opp9 {
			opp-hz = <0x00 0x6fff43c0>;
			opp-microvolt = <0xd59f8>;
		};

		opp10 {
			opp-hz = <0x00 0x73df1600>;
			opp-microvolt = <0xdec74>;
		};

		opp11 {
			opp-hz = <0x00 0x77bee840>;
			opp-microvolt = <0xe7ef0>;
		};

		opp12 {
			opp-hz = <0x00 0x7b9eba80>;
			opp-microvolt = <0xf116c>;
		};

		opp13 {
			opp-hz = <0x00 0x7f7e8cc0>;
			opp-microvolt = <0xfa3e8>;
		};

		opp14 {
			opp-hz = <0x00 0x840637c0>;
			opp-microvolt = <0x104ece>;
		};

		opp15 {
			opp-hz = <0x00 0x89267940>;
			opp-microvolt = <0x11121e>;
		};
	};

	opp_table1 {
		compatible = "operating-points-v2";
		opp-shared;
		phandle = <0x0d>;

		opp0 {
			opp-hz = <0x00 0x17d78400>;
			opp-microvolt = <0x927c0>;
		};

		opp1 {
			opp-hz = <0x00 0x1ddca740>;
			opp-microvolt = <0x9a1d2>;
		};

		opp2 {
			opp-hz = <0x00 0x204e4380>;
			opp-microvolt = <0x9d2a6>;
		};

		opp3 {
			opp-hz = <0x00 0x265366c0>;
			opp-microvolt = <0xa4cb8>;
		};

		opp4 {
			opp-hz = <0x00 0x2c67cc40>;
			opp-microvolt = <0xac6ca>;
		};

		opp5 {
			opp-hz = <0x00 0x326cef80>;
			opp-microvolt = <0xb40dc>;
		};

		opp6 {
			opp-hz = <0x00 0x38815500>;
			opp-microvolt = <0xbbaee>;
		};

		opp7 {
			opp-hz = <0x00 0x3e95ba80>;
			opp-microvolt = <0xc3500>;
		};

		opp8 {
			opp-hz = <0x00 0x43d48080>;
			opp-microvolt = <0xcc77c>;
		};

		opp9 {
			opp-hz = <0x00 0x49134680>;
			opp-microvolt = <0xd59f8>;
		};

		opp10 {
			opp-hz = <0x00 0x4e520c80>;
			opp-microvolt = <0xdec74>;
		};

		opp11 {
			opp-hz = <0x00 0x5390d280>;
			opp-microvolt = <0xe7ef0>;
		};

		opp12 {
			opp-hz = <0x00 0x58dedac0>;
			opp-microvolt = <0xf116c>;
		};

		opp13 {
			opp-hz = <0x00 0x5e1da0c0>;
			opp-microvolt = <0xfa3e8>;
		};

		opp14 {
			opp-hz = <0x00 0x64414880>;
			opp-microvolt = <0x104ec4>;
		};

		opp15 {
			opp-hz = <0x00 0x6b49d200>;
			opp-microvolt = <0x11121e>;
		};
	};

	opp_table2 {
		compatible = "operating-points-v2";
		opp-shared;
		phandle = <0x04>;

		opp00 {
			opp-hz = <0x00 0x11e1a300>;
			opp-microvolt = <0x927c0>;
		};

		opp01 {
			opp-hz = <0x00 0x1434bac0>;
			opp-microvolt = <0x970fe>;
		};

		opp02 {
			opp-hz = <0x00 0x175d7200>;
			opp-microvolt = <0x9d2a6>;
		};

		opp03 {
			opp-hz = <0x00 0x1b5bc8c0>;
			opp-microvolt = <0xa4cb8>;
		};

		opp04 {
			opp-hz = <0x00 0x1f4add40>;
			opp-microvolt = <0xac6ca>;
		};

		opp05 {
			opp-hz = <0x00 0x23493400>;
			opp-microvolt = <0xb40dc>;
		};

		opp06 {
			opp-hz = <0x00 0x27384880>;
			opp-microvolt = <0xbbaee>;
		};

		opp07 {
			opp-hz = <0x00 0x2b275d00>;
			opp-microvolt = <0xc3500>;
		};

		opp08 {
			opp-hz = <0x00 0x48c3ee0>;
			opp-microvolt = <0xcc77c>;
		};

		opp09 {
			opp-hz = <0x00 0x4c63aa0>;
			opp-microvolt = <0xd59f8>;
		};

		opp10 {
			opp-hz = <0x00 0x501bd00>;
			opp-microvolt = <0xdec74>;
		};

		opp11 {
			opp-hz = <0x00 0x53bb8c0>;
			opp-microvolt = <0xe7ef0>;
		};

		opp12 {
			opp-hz = <0x00 0x36a84f40>;
			opp-microvolt = <0xf116c>;
		};

		opp13 {
			opp-hz = <0x00 0x38ec24c0>;
			opp-microvolt = <0xfa3e8>;
		};

		opp14 {
			opp-hz = <0x00 0x3b9aca00>;
			opp-microvolt = <0x104ece>;
		};

		opp15 {
			opp-hz = <0x00 0x3ea4fcc0>;
			opp-microvolt = <0x11121e>;
		};
	};

	cci {
		compatible = "mediatek,mtk-cci";
		clocks = <0x03 0x02>;
		clock-names = "dsu_clock";
		operating-points-v2 = <0x04>;
		phandle = <0x6c>;
	};

	cpus {
		#address-cells = <0x01>;
		#size-cells = <0x00>;

		cpu@000 {
			device_type = "cpu";
			compatible = "arm,cortex-a53";
			reg = <0x00>;
			enable-method = "psci";
			clock-frequency = <0x89267940>;
			operating-points-v2 = <0x05>;
			dynamic-power-coefficient = <0x113>;
			capacity-dmips-mhz = <0x400>;
			cpu-idle-states = <0x06 0x07 0x08 0x09 0x0a 0x0b 0x0c>;
			phandle = <0x0e>;
		};

		cpu@001 {
			device_type = "cpu";
			compatible = "arm,cortex-a53";
			reg = <0x01>;
			enable-method = "psci";
			clock-frequency = <0x89267940>;
			operating-points-v2 = <0x05>;
			dynamic-power-coefficient = <0x113>;
			capacity-dmips-mhz = <0x400>;
			cpu-idle-states = <0x06 0x07 0x08 0x09 0x0a 0x0b 0x0c>;
			phandle = <0x0f>;
		};

		cpu@002 {
			device_type = "cpu";
			compatible = "arm,cortex-a53";
			reg = <0x02>;
			enable-method = "psci";
			clock-frequency = <0x89267940>;
			operating-points-v2 = <0x05>;
			dynamic-power-coefficient = <0x113>;
			capacity-dmips-mhz = <0x400>;
			cpu-idle-states = <0x06 0x07 0x08 0x09 0x0a 0x0b 0x0c>;
			phandle = <0x10>;
		};

		cpu@003 {
			device_type = "cpu";
			compatible = "arm,cortex-a53";
			reg = <0x03>;
			enable-method = "psci";
			clock-frequency = <0x89267940>;
			operating-points-v2 = <0x05>;
			dynamic-power-coefficient = <0x113>;
			capacity-dmips-mhz = <0x400>;
			cpu-idle-states = <0x06 0x07 0x08 0x09 0x0a 0x0b 0x0c>;
			phandle = <0x11>;
		};

		cpu@100 {
			device_type = "cpu";
			compatible = "arm,cortex-a53";
			reg = <0x100>;
			enable-method = "psci";
			clock-frequency = <0x6b49d200>;
			operating-points-v2 = <0x0d>;
			dynamic-power-coefficient = <0x55>;
			capacity-dmips-mhz = <0x321>;
			cpu-idle-states = <0x06 0x07 0x08 0x09 0x0a 0x0b 0x0c>;
			phandle = <0x12>;
		};

		cpu@101 {
			device_type = "cpu";
			compatible = "arm,cortex-a53";
			reg = <0x101>;
			enable-method = "psci";
			clock-frequency = <0x6b49d200>;
			operating-points-v2 = <0x0d>;
			dynamic-power-coefficient = <0x55>;
			capacity-dmips-mhz = <0x321>;
			cpu-idle-states = <0x06 0x07 0x08 0x09 0x0a 0x0b 0x0c>;
			phandle = <0x13>;
		};

		cpu@102 {
			device_type = "cpu";
			compatible = "arm,cortex-a53";
			reg = <0x102>;
			enable-method = "psci";
			clock-frequency = <0x6b49d200>;
			operating-points-v2 = <0x0d>;
			dynamic-power-coefficient = <0x55>;
			capacity-dmips-mhz = <0x321>;
			cpu-idle-states = <0x06 0x07 0x08 0x09 0x0a 0x0b 0x0c>;
			phandle = <0x14>;
		};

		cpu@103 {
			device_type = "cpu";
			compatible = "arm,cortex-a53";
			reg = <0x103>;
			enable-method = "psci";
			clock-frequency = <0x6b49d200>;
			operating-points-v2 = <0x0d>;
			dynamic-power-coefficient = <0x55>;
			capacity-dmips-mhz = <0x321>;
			cpu-idle-states = <0x06 0x07 0x08 0x09 0x0a 0x0b 0x0c>;
			phandle = <0x15>;
		};

		cpu-map {

			cluster0 {

				core0 {
					cpu = <0x0e>;
				};

				core1 {
					cpu = <0x0f>;
				};

				core2 {
					cpu = <0x10>;
				};

				core3 {
					cpu = <0x11>;
				};
			};

			cluster1 {

				core0 {
					cpu = <0x12>;
				};

				core1 {
					cpu = <0x13>;
				};

				core2 {
					cpu = <0x14>;
				};

				core3 {
					cpu = <0x15>;
				};
			};
		};

		idle-states {
			entry-method = "arm,psci";

			standby {
				compatible = "arm,idle-state";
				arm,psci-suspend-param = <0x01>;
				entry-latency-us = <0x258>;
				exit-latency-us = <0x258>;
				min-residency-us = <0x4b0>;
				phandle = <0x06>;
			};

			mcdi-cpu {
				compatible = "arm,idle-state";
				arm,psci-suspend-param = <0x10001>;
				entry-latency-us = <0x258>;
				exit-latency-us = <0x258>;
				min-residency-us = <0x4b0>;
				phandle = <0x07>;
			};

			mcdi-cluster {
				compatible = "arm,idle-state";
				arm,psci-suspend-param = <0x1010001>;
				entry-latency-us = <0x258>;
				exit-latency-us = <0x258>;
				min-residency-us = <0x4b0>;
				phandle = <0x08>;
			};

			sodi {
				compatible = "arm,idle-state";
				arm,psci-suspend-param = <0x1010002>;
				entry-latency-us = <0x320>;
				exit-latency-us = <0x3e8>;
				min-residency-us = <0x7d0>;
				phandle = <0x09>;
			};

			sodi3 {
				compatible = "arm,idle-state";
				arm,psci-suspend-param = <0x1010003>;
				entry-latency-us = <0x320>;
				exit-latency-us = <0x3e8>;
				min-residency-us = <0x7d0>;
				phandle = <0x0a>;
			};

			dpidle {
				compatible = "arm,idle-state";
				arm,psci-suspend-param = <0x1010004>;
				entry-latency-us = <0x320>;
				exit-latency-us = <0x3e8>;
				min-residency-us = <0x7d0>;
				phandle = <0x0b>;
			};

			suspend {
				compatible = "arm,idle-state";
				arm,psci-suspend-param = <0x1010005>;
				entry-latency-us = <0x320>;
				exit-latency-us = <0x3e8>;
				min-residency-us = <0x7d0>;
				phandle = <0x0c>;
			};
		};
	};

	psci {
		compatible = "arm,psci-1.0";
		method = "smc";
	};

	pmu {
		compatible = "arm,armv8-pmuv3";
		interrupt-parent = <0x16>;
		interrupts = <0x01 0x07 0x08>;
	};

	l2c_parity {
		compatible = "mediatek,l2c_parity-v1";
		interrupts = <0x00 0x18 0x04 0x00 0x19 0x04>;
	};

	memory {
		device_type = "memory";
		reg = <0x00 0x40000000 0x00 0x20000000>;
	};

	reserved-memory {
		#address-cells = <0x02>;
		#size-cells = <0x02>;
		ranges;
		phandle = <0x6d>;

		reserve-memory-sspm_share {
			compatible = "mediatek,reserve-memory-sspm_share";
			no-map;
			status = "okay";
			size = <0x00 0x510000>;
			alignment = <0x00 0x10000>;
			alloc-ranges = <0x00 0x40000000 0x00 0x60000000>;
		};

		reserve-memory-scp_share {
			compatible = "mediatek,reserve-memory-scp_share";
			no-map;
			size = <0x00 0x300000>;
			alignment = <0x00 0x1000000>;
			alloc-ranges = <0x00 0x40000000 0x00 0x50000000>;
		};

		consys-reserve-memory {
			compatible = "mediatek,consys-reserve-memory";
			no-map;
			size = <0x00 0x400000>;
			alignment = <0x00 0x1000000>;
			alloc-ranges = <0x00 0x40000000 0x00 0x80000000>;
			phandle = <0x4c>;
		};

		wifi-reserve-memory {
			compatible = "shared-dma-pool";
			no-map;
			size = <0x00 0x300000>;
			alignment = <0x00 0x1000000>;
			alloc-ranges = <0x00 0x40000000 0x00 0x80000000>;
			phandle = <0x4d>;
		};

		ssmr-reserved-cma_memory {
			compatible = "shared-dma-pool";
			reusable;
			size = <0x00 0x10000000>;
			alignment = <0x00 0x1000000>;
			alloc-range = <0x00 0xc0000000 0x00 0x10000000>;
			phandle = <0x6a>;
		};

		ion-carveout-heap {
			compatible = "mediatek,ion-carveout-heap";
			no-map;
			size = <0x00 0x5000>;
			alignment = <0x00 0x1000>;
			alloc-ranges = <0x00 0xc0000000 0x00 0x10000000>;
		};
	};

	cpu_dbgapb@0d410000 {
		compatible = "mediatek,hw_dbg";
		num = <0x08>;
		reg = <0x00 0xd410000 0x00 0x1000 0x00 0xd510000 0x00 0x1000 0x00 0xd610000 0x00 0x1000 0x00 0xd710000 0x00 0x1000 0x00 0xd810000 0x00 0x1000 0x00 0xd910000 0x00 0x1000 0x00 0xda10000 0x00 0x1000 0x00 0xdb10000 0x00 0x1000>;
		phandle = <0x6e>;
	};

	atf_logger {
		compatible = "mediatek,atf_logger";
		interrupts = <0x00 0xf7 0x01>;
	};

	amms_control {
		compatible = "mediatek,amms";
		interrupts = <0x00 0x86 0x01>;
	};

	utos {
		compatible = "microtrust,utos";
		interrupts = <0x00 0xf9 0x01 0x00 0xfa 0x01>;
	};

	utos_tester {
		compatible = "microtrust,tester-v1";
	};

	interrupt-controller@0c000000 {
		compatible = "arm,gic-v3";
		#interrupt-cells = <0x03>;
		#address-cells = <0x02>;
		#size-cells = <0x02>;
		#redistributor-regions = <0x01>;
		interrupt-parent = <0x16>;
		interrupt-controller;
		reg = <0x00 0xc000000 0x00 0x40000 0x00 0xc100000 0x00 0x200000 0x00 0x10200a80 0x00 0x50>;
		interrupts = <0x01 0x09 0x04>;
		phandle = <0x16>;
	};

	dcm@10001000 {
		compatible = "mediatek,mt6765-dcm";
		reg = <0x00 0x10001000 0x00 0x1000 0x00 0x10200000 0x00 0x1000 0x00 0x10200000 0x00 0x1000 0x00 0x10200200 0x00 0x1000 0x00 0x10200400 0x00 0x1000 0x00 0x1022d000 0x00 0x1000 0x00 0x10235000 0x00 0x1000 0x00 0x10238000 0x00 0x1000 0x00 0x11220000 0x00 0x1000 0x00 0x11c50000 0x00 0x1000 0x00 0x13000000 0x00 0x1000 0x00 0x14000000 0x00 0x1000 0x00 0x14002000 0x00 0x1000 0x00 0x14003000 0x00 0x1000 0x00 0x15021000 0x00 0x1000 0x00 0x17010000 0x00 0x1000 0x00 0x17020000 0x00 0x1000 0x00 0x17030000 0x00 0x1000>;
		reg-names = "infracfg_ao\0mcucfg\0mp0_cpucfg\0mp1_cpucfg\0mcu_misccfg\0chn0_emi\0chn1_emi\0gce\0audio\0efusec\0mfgcfg\0mmsys_config\0smi_common\0smi_larb0\0smi_larb2\0smi_larb1\0venc\0jpgenc";
		phandle = <0x6f>;
	};

	intpol-controller@10200a80 {
		compatible = "mediatek,mt6577-sysirq";
		interrupt-controller;
		#interrupt-cells = <0x03>;
		interrupt-parent = <0x16>;
		reg = <0x00 0x10200a80 0x00 0x50>;
		phandle = <0x01>;
	};

	infracfg_ao@10001000 {
		compatible = "mediatek,common-infracfg_ao\0mediatek,infracfg_ao\0mediatek,mt6765-infracfg\0syscon";
		reg = <0x00 0x10001000 0x00 0x1000>;
		interrupts = <0x00 0x93 0x01>;
		#clock-cells = <0x01>;
		phandle = <0x25>;
	};

	mcdi@00110100 {
		compatible = "mediatek,mt6765-mcdi";
		reg = <0x00 0x110100 0x00 0x800>;
	};

	scpsys@10001000 {
		compatible = "mediatek,mt6765-scpsys\0syscon";
		reg = <0x00 0x10001000 0x00 0x1000 0x00 0x10006000 0x00 0x1000 0x00 0x14002000 0x00 0x1000 0x00 0x1020e000 0x00 0x1000 0x00 0x18004000 0x00 0x1000 0x00 0x18002000 0x00 0x1000>;
		#clock-cells = <0x01>;
		phandle = <0x35>;
	};

	topckgen@10000000 {
		compatible = "mediatek,mt6765-topckgen\0syscon";
		reg = <0x00 0x10000000 0x00 0x1000>;
		#clock-cells = <0x01>;
		phandle = <0x26>;
	};

	scp_infra@10001000 {
		compatible = "mediatek,scpinfra";
		reg = <0x00 0x10001000 0x00 0x1000>;
		phandle = <0x70>;
	};

	io_cfg_lt@10002000 {
		compatible = "mediatek,io_cfg_lt";
		reg = <0x00 0x10002000 0x00 0x200>;
		phandle = <0x18>;
	};

	io_cfg_lm@10002200 {
		compatible = "mediatek,io_cfg_lm";
		reg = <0x00 0x10002200 0x00 0x200>;
		phandle = <0x19>;
	};

	io_cfg_lb@10002400 {
		compatible = "mediatek,io_cfg_lb";
		reg = <0x00 0x10002400 0x00 0x200>;
		phandle = <0x1a>;
	};

	io_cfg_bl@10002600 {
		compatible = "mediatek,io_cfg_bl";
		reg = <0x00 0x10002600 0x00 0x200>;
		phandle = <0x1b>;
	};

	io_cfg_rr@10002800 {
		compatible = "mediatek,io_cfg_rr";
		reg = <0x00 0x10002800 0x00 0x200>;
		phandle = <0x1c>;
	};

	io_cfg_rb@10002a00 {
		compatible = "mediatek,io_cfg_rb";
		reg = <0x00 0x10002a00 0x00 0x200>;
		phandle = <0x1d>;
	};

	io_cfg_rt@10002c00 {
		compatible = "mediatek,io_cfg_rt";
		reg = <0x00 0x10002c00 0x00 0x200>;
		phandle = <0x1e>;
	};

	pericfg@10003000 {
		compatible = "mediatek,pericfg\0syscon";
		reg = <0x00 0x10003000 0x00 0x1000>;
		#clock-cells = <0x01>;
		phandle = <0x4e>;
	};

	efuse_dbg@10004000 {
		compatible = "mediatek,efuse_dbg";
		reg = <0x00 0x10004000 0x00 0x1000>;
	};

	gpio {
		compatible = "mediatek,gpio_usage_mapping";
		phandle = <0x71>;
	};

	eint@1000b000 {
		compatible = "mediatek,eint";
		reg = <0x00 0x1000b000 0x00 0x1000>;
		phandle = <0x72>;
	};

	gpio@10005000 {
		compatible = "mediatek,gpio\0syscon";
		reg = <0x00 0x10005000 0x00 0x1000>;
		phandle = <0x17>;
	};

	pinctrl@1000b000 {
		compatible = "mediatek,mt6765-pinctrl";
		reg_bases = <0x17 0x18 0x19 0x1a 0x1b 0x1c 0x1d 0x1e>;
		pins-are-numbered;
		gpio-controller;
		gpio-ranges = <0x1f 0x00 0x00 0xb3>;
		#gpio-cells = <0x02>;
		interrupt-controller;
		#interrupt-cells = <0x02>;
		interrupts = <0x00 0xab 0x04>;
		interrupt-parent = <0x16>;
		phandle = <0x1f>;

		plv3venable {
			phandle = <0x62>;

			pins_cmd_dat {
				pinmux = <0x9a00>;
				slew-rate = <0x01>;
				output-high;
			};
		};

		plv3vdisable {
			phandle = <0x63>;

			pins_cmd_dat {
				pinmux = <0x9a00>;
				slew-rate = <0x01>;
				output-low;
			};
		};

		msdc0@default {
			phandle = <0x51>;

			pins_cmd {
				drive-strength = [03];
			};

			pins_dat {
				drive-strength = [03];
			};

			pins_clk {
				drive-strength = [03];
			};

			pins_rst {
				drive-strength = [03];
			};

			pins_ds {
				drive-strength = [03];
			};
		};

		msdc0@hs400 {
			phandle = <0x52>;

			pins_cmd {
				drive-strength = [03];
			};

			pins_dat {
				drive-strength = [04];
			};

			pins_clk {
				drive-strength = [04];
			};

			pins_rst {
				drive-strength = [03];
			};

			pins_ds {
				drive-strength = [04];
			};
		};

		msdc0@hs200 {
			phandle = <0x53>;

			pins_cmd {
				drive-strength = [03];
			};

			pins_dat {
				drive-strength = [04];
			};

			pins_clk {
				drive-strength = [04];
			};

			pins_rst {
				drive-strength = [03];
			};

			pins_ds {
				drive-strength = [04];
			};
		};

		msdc0@register_default {
			cmd_edge = [00];
			rdata_edge = [00];
			wdata_edge = [00];
			phandle = <0x54>;
		};

		msdc1@default {
			phandle = <0x56>;

			pins_cmd {
				drive-strength = [03];
			};

			pins_dat {
				drive-strength = [03];
			};

			pins_clk {
				drive-strength = [03];
			};
		};

		msdc1@sdr104 {
			phandle = <0x57>;

			pins_cmd {
				drive-strength = [03];
			};

			pins_dat {
				drive-strength = [03];
			};

			pins_clk {
				drive-strength = [03];
			};
		};

		msdc1@sdr50 {
			phandle = <0x58>;

			pins_cmd {
				drive-strength = [03];
			};

			pins_dat {
				drive-strength = [03];
			};

			pins_clk {
				drive-strength = [03];
			};
		};

		msdc1@ddr50 {
			phandle = <0x59>;

			pins_cmd {
				drive-strength = [03];
			};

			pins_dat {
				drive-strength = [03];
			};

			pins_clk {
				drive-strength = [03];
			};
		};

		msdc1@register_default {
			cmd_edge = [00];
			rdata_edge = [00];
			wdata_edge = [00];
			phandle = <0x5a>;
		};

		msdc3@default {
			phandle = <0x73>;

			pins_cmd {
				drive-strength = [04];
			};

			pins_dat {
				drive-strength = [04];
			};

			pins_clk {
				drive-strength = [04];
			};
		};

		msdc3@register_default {
			cmd_edge = [01];
			rdata_edge = [01];
			wdata_edge = [01];
			phandle = <0x74>;
		};
	};

	sleep@10006000 {
		compatible = "mediatek,sleep\0syscon";
		reg = <0x00 0x10006000 0x00 0x1000>;
		interrupts = <0x00 0xb5 0x08>;
		wakeup-source = <0x20 0x00 0x04 0x21 0x01 0x20 0x22 0x03 0x2000000>;
		phandle = <0x6b>;
	};

	toprgu@10007000 {
		compatible = "mediatek,mt6765-wdt\0mediatek,mt6589-wdt\0mediatek,toprgu\0syscon\0simple-mfd";
		reg = <0x00 0x10007000 0x00 0x1000>;
		interrupts = <0x00 0x8b 0x00>;
		mediatek,rg_dfd_timeout = <0xa0>;
		#reset-cells = <0x01>;
		phandle = <0x48>;

		reboot-mode {
			compatible = "syscon-reboot-mode";
			offset = <0x24>;
			mask = <0x0f>;
			mode-charger = <0x01>;
			mode-recovery = <0x02>;
			mode-bootloader = <0x03>;
			mode-dm-verity-dev-corrupt = <0x04>;
			mode-kpoc = <0x05>;
			mode-ddr-reserve = <0x06>;
			mode-meta = <0x07>;
			mode-rpmbpk = <0x08>;
		};
	};

	chipid@08000000 {
		compatible = "mediatek,chipid";
		reg = <0x00 0x8000000 0x00 0x04 0x00 0x8000004 0x00 0x04 0x00 0x8000008 0x00 0x04 0x00 0x800000c 0x00 0x04>;
	};

	hwrng {
		compatible = "mediatek,mt67xx-rng";
		phandle = <0x75>;
	};

	mobicore {
		compatible = "trustonic,mobicore";
		interrupts = <0x00 0x10f 0x01>;
	};

	tee_sanity {
		compatible = "trustonic,tee_sanity";
		interrupts = <0x00 0x110 0x01>;
	};

	tkcore {
		compatible = "trustkernel,tkcore";
		interrupts = <0x00 0xf8 0x01>;
	};

	timer {
		compatible = "arm,armv8-timer";
		interrupt-parent = <0x16>;
		interrupts = <0x01 0x0d 0x08 0x01 0x0e 0x08 0x01 0x0b 0x08 0x01 0x0a 0x08>;
		clock-frequency = <0xc65d40>;
	};

	clocks {

		clk26m {
			compatible = "fixed-clock";
			#clock-cells = <0x00>;
			clock-frequency = <0x18cba80>;
			phandle = <0x24>;
		};

		clk13m {
			compatible = "fixed-clock";
			#clock-cells = <0x00>;
			clock-frequency = <0xc65d40>;
			phandle = <0x34>;
		};

		clk32k {
			compatible = "fixed-clock";
			#clock-cells = <0x00>;
			clock-frequency = <0x7d00>;
			phandle = <0x23>;
		};
	};

	apxgpt@10008000 {
		compatible = "mediatek,apxgpt";
		reg = <0x00 0x10008000 0x00 0x1000>;
		interrupts = <0x00 0xaa 0x08>;
		clocks = <0x23>;
	};

	hacc@1000a000 {
		compatible = "mediatek,hacc";
		reg = <0x00 0x1000a000 0x00 0x1000>;
		interrupts = <0x00 0xbd 0x08>;
	};

	apmixed@1000c000 {
		compatible = "mediatek,mt6765-apmixedsys\0syscon";
		reg = <0x00 0x1000c000 0x00 0xe00>;
		#clock-cells = <0x01>;
		phandle = <0x03>;
	};

	fhctl@1000ce00 {
		compatible = "mediatek,mt6765-fhctl";
		reg = <0x00 0x1000ce00 0x00 0x100>;
		mediatek,apmixed = <0x03>;

		armpll {
			mediatek,fh-id = <0x00>;
			mediatek,fh-pll-id = <0x01>;
			mediatek,fh-cpu-pll;
		};

		mainpll {
			mediatek,fh-id = <0x01>;
			mediatek,fh-pll-id = <0x03>;
		};

		msdcpll {
			mediatek,fh-id = <0x02>;
			mediatek,fh-pll-id = <0x07>;
		};

		mfgpll {
			mediatek,fh-id = <0x03>;
			mediatek,fh-pll-id = <0x04>;
		};

		mpll {
			mediatek,fh-id = <0x05>;
			mediatek,fh-pll-id = <0x09>;
		};

		mmpll {
			mediatek,fh-id = <0x06>;
			mediatek,fh-pll-id = <0x05>;
		};

		armpll_l {
			mediatek,fh-id = <0x07>;
			mediatek,fh-pll-id = <0x00>;
			mediatek,fh-cpu-pll;
		};
	};

	pwrap@1000d000 {
		compatible = "mediatek,mt6765-pwrap\0syscon";
		reg = <0x00 0x1000d000 0x00 0x1000>;
		reg-names = "pwrap";
		interrupts = <0x00 0xb3 0x04>;
		clocks = <0x24 0x25 0x02 0x26 0x7c>;
		clock-names = "spi\0wrap\0ulposc";
		phandle = <0x2f>;

		main_pmic {
			compatible = "mediatek,mt6357";
			interrupt-controller;
			#interrupt-cells = <0x02>;
			interrupt-parent = <0x1f>;
			interrupts = <0x90 0x04 0x90 0x00>;
			phandle = <0x30>;

			mtk_battery_oc_throttling {
				compatible = "mediatek,mt6357-battery_oc_throttling";
				oc-thd-h = <0x123e>;
				oc-thd-l = <0x157c>;
			};

			pmic_accdet {
				compatible = "mediatek,mt6357-accdet";
				accdet-name = "mt63xx-accdet";
				accdet-mic-vol = <0x06>;
				accdet-plugout-debounce = <0x01>;
				accdet-mic-mode = <0x01>;
				headset-mode-setting = <0x500 0x500 0x01 0x1f0 0x800 0x800 0x20 0x44>;
				headset-eint-level-pol = <0x08>;
				headset-use-ap-eint = <0x00>;
				headset-eint-num = <0x00>;
				headset-eint-trig-mode = <0x00>;
				headset-key-mode = <0x00>;
				headset-three-key-threshold = <0x00 0x50 0xdc 0x190>;
				headset-three-key-threshold-CDD = <0x00 0x79 0xc0 0x258>;
				headset-four-key-threshold = <0x00 0x3a 0x79 0xc0 0x190>;
				io-channels = <0x27 0x09>;
				io-channel-names = "pmic_accdet";
				nvmem = <0x28>;
				nvmem-names = "mt63xx-accdet-efuse";
				status = "okay";
				phandle = <0x76>;
			};

			mt6357keys {
				compatible = "mediatek,mt6357-keys";
				mediatek,long-press-mode = <0x01>;
				power-off-time-sec = <0x01>;
				phandle = <0x77>;

				power {
					linux,keycodes = <0x74>;
					wakeup-source;
				};

				home {
					linux,keycodes = <0x73>;
				};
			};

			pmic_auxadc {
				compatible = "mediatek,pmic-auxadc\0mediatek,mt6357-auxadc";
				#io-channel-cells = <0x01>;
				#interconnect-cells = <0x01>;
				phandle = <0x27>;

				batadc {
					channel = <0x00>;
					resistance-ratio = <0x03 0x01>;
					avg-num = <0x80>;
				};

				isense {
					channel = <0x01>;
					resistance-ratio = <0x03 0x01>;
					avg-num = <0x80>;
				};

				vcdt {
					channel = <0x02>;
				};

				bat_temp {
					channel = <0x03>;
					resistance-ratio = <0x01 0x01>;
				};

				chip_temp {
					channel = <0x05>;
				};

				vcore_temp {
					channel = <0x06>;
				};

				vproc_temp {
					channel = <0x07>;
				};

				accdet {
					channel = <0x09>;
				};

				tsx_temp {
					channel = <0x0b>;
					avg-num = <0x80>;
				};

				hpofs_cal {
					channel = <0x0c>;
					avg-num = <0x100>;
				};

				dcxo_temp {
					channel = <0x0d>;
					avg-num = <0x10>;
				};

				vbif {
					channel = <0x0e>;
					resistance-ratio = <0x01 0x01>;
				};

				imp {
					channel = <0x0f>;
					resistance-ratio = <0x03 0x01>;
					avg-num = <0x80>;
				};

				imix_r {
					channel = <0x10>;
				};
			};

			mtk_gauge {
				compatible = "mediatek,mt6357-gauge";
				charger = <0x29>;
				bootmode = <0x2a>;
				io-channels = <0x27 0x03 0x27 0x01 0x27 0x0e 0x27 0x0f 0x27 0x10>;
				io-channel-names = "pmic_battery_temp\0pmic_battery_voltage\0pmic_bif_voltage\0pmic_ptim_voltage\0pmic_ptim_r";
				nvmem-cells = <0x2b 0x2c>;
				nvmem-cell-names = "initialization\0state-of-charge";
				DIFFERENCE_FULLOCV_ITH = <0xc8>;
				SHUTDOWN_1_TIME = <0x1e>;
				KEEP_100_PERCENT = <0x01>;
				R_FG_VALUE = <0x0a>;
				EMBEDDED_SEL = <0x01>;
				PMIC_SHUTDOWN_CURRENT = <0x14>;
				FG_METER_RESISTANCE = <0x4b>;
				CAR_TUNE_VALUE = <0x64>;
				PMIC_MIN_VOL = <0x82dc>;
				POWERON_SYSTEM_IBOOT = <0x1f4>;
				SHUTDOWN_GAUGE0_VOLTAGE = <0x84d0>;
				TEMPERATURE_T0 = <0x32>;
				TEMPERATURE_T1 = <0x19>;
				TEMPERATURE_T2 = <0x0a>;
				TEMPERATURE_T3 = <0x00>;
				TEMPERATURE_T4 = <0xfffffff6>;
				g_FG_PSEUDO100_T0 = <0x61>;
				g_FG_PSEUDO100_T1 = <0x61>;
				g_FG_PSEUDO100_T2 = <0x5f>;
				g_FG_PSEUDO100_T3 = <0x5a>;
				g_FG_PSEUDO100_T4 = <0x5a>;
				Q_MAX_SYS_VOLTAGE_BAT0 = <0xd16>;
				Q_MAX_SYS_VOLTAGE_BAT1 = <0xd16>;
				Q_MAX_SYS_VOLTAGE_BAT2 = <0xd16>;
				Q_MAX_SYS_VOLTAGE_BAT3 = <0xd16>;
				COM_FG_METER_RESISTANCE = <0x64>;
				COM_R_FG_VALUE = <0x00>;
				enable_tmp_intr_suspend = <0x00>;
				ACTIVE_TABLE = <0x06>;
				MULTI_TEMP_GAUGE0 = <0x01>;
				RBAT_PULL_UP_R = <0x4204>;
				RBAT_PULL_UP_VOLT = <0x708>;
				battery0_profile_t0_num = <0x64>;
				battery0_profile_t0_col = <0x04>;
				battery0_profile_t0 = <0x00 0xad40 0x214 0x214 0x1f5 0xac99 0x214 0x214 0x2ee 0xac51 0x214 0x214 0x3ea 0xac09 0x214 0x214 0x5df 0xab82 0x20d 0x20d 0x7d5 0xaafe 0x20d 0x20d 0x9ca 0xaa7f 0x21a 0x21a 0xabe 0xaa3c 0x210 0x210 0xbbf 0xa9f7 0x210 0x210 0xdb4 0xa972 0x21a 0x21a 0xfaa 0xa8e7 0x214 0x214 0x10a4 0xa8a2 0x21a 0x21a 0x119f 0xa856 0x21a 0x21a 0x1394 0xa7c4 0x21a 0x21a 0x158a 0xa72e 0x21a 0x21a 0x1685 0xa6e3 0x220 0x220 0x177f 0xa699 0x220 0x220 0x1974 0xa5fe 0x21d 0x21d 0x1b6a 0xa565 0x223 0x223 0x1d5f 0xa4cc 0x223 0x223 0x1e5a 0xa47e 0x220 0x220 0x1f54 0xa431 0x220 0x220 0x2149 0xa39d 0x22f 0x22f 0x233f 0xa306 0x232 0x232 0x2436 0xa2ba 0x22f 0x22f 0x2534 0xa26f 0x22f 0x22f 0x2729 0xa1dc 0x232 0x232 0x291f 0xa14e 0x23e 0x23e 0x2b14 0xa0c0 0x23e 0x23e 0x2c0e 0xa079 0x23e 0x23e 0x2d09 0xa032 0x23e 0x23e 0x2efe 0x9fa9 0x24b 0x24b 0x30f4 0x9f24 0x254 0x254 0x31ee 0x9ee3 0x257 0x257 0x32e9 0x9ea1 0x257 0x257 0x34de 0x9e1d 0x257 0x257 0x36d3 0x9da3 0x26c 0x26c 0x38c9 0x9d28 0x27c 0x27c 0x39c4 0x9ced 0x282 0x282 0x3abe 0x9cb1 0x282 0x282 0x3cb3 0x9c3e 0x2a0 0x2a0 0x3ea8 0x9bc8 0x2b9 0x2b9 0x3fa2 0x9b89 0x2d1 0x2d1 0x409e 0x9b49 0x2d1 0x2d1 0x4293 0x9a9a 0x2a3 0x2a3 0x4488 0x99cb 0x23e 0x23e 0x4588 0x9982 0x21d 0x21d 0x467d 0x9939 0x21d 0x21d 0x4873 0x98c8 0x21a 0x21a 0x4a68 0x986b 0x223 0x223 0x4c5d 0x980e 0x21a 0x21a 0x4d58 0x97e4 0x21a 0x21a 0x4e53 0x97bb 0x21a 0x21a 0x5048 0x976d 0x21a 0x21a 0x523d 0x9724 0x220 0x220 0x5334 0x96ff 0x220 0x220 0x5432 0x96da 0x220 0x220 0x5628 0x9696 0x226 0x226 0x581d 0x9656 0x22c 0x22c 0x5a12 0x9616 0x232 0x232 0x5b04 0x95fa 0x232 0x232 0x5c08 0x95dc 0x232 0x232 0x5dfd 0x95a1 0x23e 0x23e 0x5ff2 0x956b 0x23e 0x23e 0x60ed 0x9550 0x24b 0x24b 0x61e8 0x9535 0x24b 0x24b 0x63dd 0x9505 0x257 0x257 0x65d2 0x94d5 0x25a 0x25a 0x66cc 0x94bf 0x266 0x266 0x67c7 0x94a8 0x266 0x266 0x69bd 0x9479 0x275 0x275 0x6bb2 0x9437 0x263 0x263 0x6da7 0x93c7 0x226 0x226 0x6ea1 0x9392 0x220 0x220 0x6f9c 0x935d 0x220 0x220 0x7192 0x931b 0x22f 0x22f 0x7387 0x92d7 0x226 0x226 0x7481 0x92b5 0x226 0x226 0x757c 0x9292 0x226 0x226 0x7771 0x9253 0x22f 0x22f 0x7967 0x9217 0x22f 0x22f 0x7b5c 0x91df 0x229 0x229 0x7c56 0x91be 0x226 0x226 0x7d51 0x919e 0x226 0x226 0x7f46 0x914b 0x226 0x226 0x813c 0x90f0 0x220 0x220 0x8236 0x90c7 0x226 0x226 0x8331 0x909f 0x226 0x226 0x8526 0x9039 0x226 0x226 0x871b 0x8fef 0x21a 0x21a 0x8815 0x8fe7 0x21d 0x21d 0x8911 0x8fdd 0x21d 0x21d 0x8b06 0x8fd1 0x22f 0x22f 0x8cfb 0x8fb9 0x238 0x238 0x8ef0 0x8f92 0x254 0x254 0x8fea 0x8f3a 0x248 0x248 0x90e6 0x8ee2 0x248 0x248 0x92db 0x8d08 0x263 0x263 0x94d0 0x8a7d 0x273 0x273 0x96c5 0x86dc 0x2d1 0x2d1>;
				battery0_profile_t1_num = <0x64>;
				battery0_profile_t1_col = <0x04>;
				battery0_profile_t1 = <0x00 0xade6 0x3c7 0x3c7 0x1f4 0xad26 0x3c7 0x3c7 0x2ee 0xacf5 0x3d1 0x3d1 0x3e8 0xac9b 0x3d1 0x3d1 0x5dc 0xac1c 0x3d1 0x3d1 0x7d1 0xaba3 0x3d1 0x3d1 0x9c5 0xab24 0x3ca 0x3ca 0xabe 0xaae4 0x3ca 0x3ca 0xbb9 0xaaa4 0x3c0 0x3c0 0xdad 0xaa25 0x3c0 0x3c0 0xfa2 0xa99d 0x3b8 0x3b8 0x1196 0xa911 0x3b1 0x3b1 0x128e 0xa8cb 0x3b1 0x3b1 0x138a 0xa886 0x3b1 0x3b1 0x157e 0xa7f1 0x3a9 0x3a9 0x1773 0xa75f 0x3b1 0x3b1 0x186a 0xa70a 0x3a2 0x3a2 0x1967 0xa6c4 0x3a2 0x3a2 0x1b5b 0xa62c 0x3a2 0x3a2 0x1d4f 0xa591 0x3a2 0x3a2 0x1f44 0xa4f6 0x3a2 0x3a2 0x203a 0xa4ab 0x3a2 0x3a2 0x2138 0xa45b 0x3a2 0x3a2 0x232c 0xa3c3 0x3a9 0x3a9 0x2520 0xa32c 0x3a2 0x3a2 0x2715 0xa2a0 0x3a9 0x3a9 0x280a 0xa252 0x3b1 0x3b1 0x2909 0xa202 0x3b1 0x3b1 0x2afd 0xa170 0x3c0 0x3c0 0x2cf2 0xa0e2 0x3ca 0x3ca 0x2ee6 0xa056 0x3cf 0x3cf 0x2fda 0xa011 0x3d9 0x3d9 0x30da 0x9fcb 0x3d9 0x3d9 0x32ce 0x9f42 0x3e8 0x3e8 0x34c3 0x9ebd 0x3fe 0x3fe 0x35b6 0x9e7a 0x417 0x417 0x36b7 0x9e3e 0x417 0x417 0x38ab 0x9dbc 0x41f 0x41f 0x3aa0 0x9d40 0x43d 0x43d 0x3c94 0x9cc7 0x45d 0x45d 0x3d8e 0x9c87 0x483 0x483 0x3e88 0x9c4b 0x483 0x483 0x407c 0x9bcf 0x49c 0x49c 0x4271 0x9b3d 0x492 0x492 0x4465 0x9a86 0x42e 0x42e 0x455f 0x9a26 0x3c0 0x3c0 0x4659 0x99cc 0x3c0 0x3c0 0x484d 0x9934 0x37a 0x37a 0x4a42 0x98c1 0x372 0x372 0x4b3c 0x988f 0x363 0x363 0x4c36 0x985b 0x363 0x363 0x4e2a 0x9801 0x35c 0x35c 0x501f 0x97ad 0x363 0x363 0x5213 0x9760 0x36b 0x36b 0x530d 0x9738 0x363 0x363 0x5407 0x9712 0x363 0x363 0x55fb 0x96ce 0x36b 0x36b 0x57f0 0x9687 0x36b 0x36b 0x59e4 0x964c 0x37a 0x37a 0x5ade 0x962e 0x384 0x384 0x5bd8 0x960e 0x384 0x384 0x5dcc 0x95d3 0x38b 0x38b 0x5fc1 0x959b 0x390 0x390 0x60bb 0x9581 0x39a 0x39a 0x61b5 0x9567 0x39a 0x39a 0x63a9 0x9535 0x3a9 0x3a9 0x659d 0x9503 0x3a9 0x3a9 0x6792 0x94d5 0x3b8 0x3b8 0x688c 0x94bf 0x3ca 0x3ca 0x6986 0x94aa 0x3ca 0x3ca 0x6b7a 0x947e 0x3c7 0x3c7 0x6d6e 0x9450 0x3d1 0x3d1 0x6f62 0x9418 0x3c2 0x3c2 0x705c 0x93f8 0x39a 0x39a 0x7157 0x93d7 0x39a 0x39a 0x734b 0x9399 0x38b 0x38b 0x753f 0x9358 0x375 0x375 0x7733 0x9317 0x375 0x375 0x782d 0x92f6 0x36b 0x36b 0x7928 0x92d5 0x36b 0x36b 0x7b1c 0x92a1 0x37c 0x37c 0x7d10 0x926c 0x37c 0x37c 0x7e0a 0x924d 0x372 0x372 0x7f04 0x922e 0x372 0x372 0x80f9 0x91e0 0x37a 0x37a 0x82ed 0x918a 0x37c 0x37c 0x84e1 0x9142 0x389 0x389 0x85db 0x9111 0x381 0x381 0x86d5 0x90df 0x381 0x381 0x88ca 0x907c 0x372 0x372 0x8abe 0x9063 0x37a 0x37a 0x8cb2 0x9054 0x393 0x393 0x8dac 0x9022 0x3a9 0x3a9 0x8ea6 0x8fce 0x3a9 0x3a9 0x909b 0x8f60 0x3b8 0x3b8 0x928f 0x8f3f 0x3de 0x3de 0x9389 0x8ebb 0x3c0 0x3c0 0x9483 0x8e51 0x3c0 0x3c0 0x9677 0x8be8 0x406 0x406 0x986c 0x8890 0x471 0x471>;
				battery0_profile_t2_num = <0x64>;
				battery0_profile_t2_col = <0x04>;
				battery0_profile_t2 = <0x00 0xadaa 0x78a 0x608 0x1f4 0xad58 0x78a 0x608 0x2ee 0xad0c 0x73c 0x5ca 0x3e8 0xacc3 0x73c 0x5ca 0x5dc 0xac44 0x74b 0x5d6 0x7d0 0xabce 0x71e 0x5b2 0x9c4 0xab55 0x70d 0x5a4 0xabe 0xab1b 0x6f6 0x592 0xbb8 0xaae2 0x6f6 0x592 0xdac 0xaa63 0x6dd 0x57e 0xfa1 0xa9e4 0x6bf 0x566 0x1195 0xa95f 0x6a9 0x554 0x128e 0xa91a 0x69f 0x54c 0x1389 0xa8d6 0x69f 0x54c 0x157d 0xa848 0x683 0x536 0x1771 0xa7b6 0x672 0x528 0x1965 0xa721 0x663 0x51c 0x1a5e 0xa6d4 0x642 0x502 0x1b59 0xa686 0x642 0x502 0x1d4d 0xa5ee 0x654 0x510 0x1f42 0xa553 0x642 0x502 0x2136 0xa4bb 0x63b 0x4fc 0x222e 0xa46e 0x624 0x4ea 0x232a 0xa420 0x624 0x4ea 0x251e 0xa389 0x61f 0x4e6 0x2712 0xa2f4 0x62e 0x4f2 0x2906 0xa25c 0x62e 0x4f2 0x29fe 0xa212 0x62c 0x4f0 0x2afa 0xa1ca 0x62c 0x4f0 0x2cee 0xa138 0x62c 0x4f0 0x2ee3 0xa0aa 0x636 0x4f8 0x30d7 0xa01b 0x645 0x504 0x31ce 0x9fd8 0x65b 0x516 0x32cb 0x9f93 0x65b 0x516 0x34bf 0x9f0a 0x663 0x51c 0x36b3 0x9e88 0x679 0x52e 0x38a7 0x9e06 0x68b 0x53c 0x399e 0x9dc6 0x6a9 0x554 0x3a9b 0x9d84 0x6a9 0x554 0x3c8f 0x9d02 0x6ba 0x562 0x3e84 0x9c86 0x6d8 0x57a 0x4078 0x9c03 0x6dd 0x57e 0x416e 0x9bbc 0x6c9 0x56e 0x426c 0x9b75 0x6c9 0x56e 0x4460 0x9ad4 0x67c 0x530 0x4654 0x9a26 0x624 0x4ea 0x4848 0x9982 0x5ca 0x4a2 0x493e 0x993e 0x591 0x474 0x4a3c 0x98f9 0x591 0x474 0x4c30 0x9886 0x57a 0x462 0x4e25 0x9820 0x56b 0x456 0x5019 0x97c6 0x56b 0x456 0x510e 0x979e 0x573 0x45c 0x520d 0x9773 0x573 0x45c 0x5401 0x9722 0x573 0x45c 0x55f5 0x96d8 0x573 0x45c 0x56ea 0x96b4 0x57a 0x462 0x57e9 0x9690 0x57a 0x462 0x59dd 0x964c 0x582 0x468 0x5bd1 0x960b 0x589 0x46e 0x5dc6 0x95d0 0x598 0x47a 0x5eba 0x95b2 0x5a0 0x480 0x5fba 0x9595 0x5a0 0x480 0x61ae 0x955d 0x5a7 0x486 0x63a2 0x9526 0x5aa 0x488 0x6596 0x94f7 0x5c8 0x4a0 0x668a 0x94de 0x5de 0x4b2 0x678a 0x94c5 0x5de 0x4b2 0x697e 0x9497 0x5e8 0x4ba 0x6b72 0x9468 0x5ed 0x4be 0x6d67 0x943d 0x5f0 0x4c0 0x6e5a 0x9429 0x5ff 0x4cc 0x6f5b 0x9415 0x5ff 0x4cc 0x714f 0x93ec 0x5fc 0x4ca 0x7343 0x93c1 0x606 0x4d2 0x7537 0x9393 0x5f7 0x4c6 0x762a 0x9376 0x5f0 0x4c0 0x772b 0x935b 0x5f0 0x4c0 0x791f 0x931a 0x5e1 0x4b4 0x7b13 0x92dc 0x5d9 0x4ae 0x7d08 0x92a7 0x5d7 0x4ac 0x7dfa 0x928e 0x5ed 0x4be 0x7efc 0x9275 0x5ed 0x4be 0x80f0 0x9234 0x606 0x4d2 0x82e4 0x91e0 0x604 0x4d0 0x84d8 0x9190 0x615 0x4de 0x85ca 0x916a 0x651 0x50e 0x86cc 0x9145 0x651 0x50e 0x88c0 0x90d9 0x65b 0x516 0x8ab4 0x9079 0x672 0x528 0x8ca9 0x905a 0x6a9 0x554 0x8d9a 0x904c 0x6e7 0x586 0x8e9d 0x903e 0x6e7 0x586 0x9091 0x9025 0x72d 0x5be 0x9285 0x8ffd 0x7a8 0x620 0x9479 0x8fa0 0x863 0x6b6 0x956a 0x8ee9 0x8cf 0x70c 0x966d 0x8e32 0x8cf 0x70c 0x9861 0x8bb0 0x9b0 0x7c0 0x9a55 0x8833 0xb6f 0x926>;
				battery0_profile_t3_num = <0x64>;
				battery0_profile_t3_col = <0x04>;
				battery0_profile_t3 = <0x00 0xad5b 0xddf 0x9b6 0x1f4 0xad0c 0xddf 0x9b6 0x2ee 0xacbc 0xdba 0x99c 0x3e8 0xac35 0xdba 0x99c 0x5dc 0xabbc 0xd89 0x97a 0x7d1 0xab43 0xd5b 0x959 0x9c5 0xab07 0xd21 0x931 0xabe 0xaacb 0xcf0 0x90e 0xbb9 0xaa52 0xcf0 0x90e 0xdae 0xa9d2 0xcbf 0x8ec 0xfa2 0xa953 0xc85 0x8c4 0x1196 0xa910 0xc54 0x8a1 0x128e 0xa8cd 0xc23 0x87f 0x138b 0xa841 0xc23 0x87f 0x157f 0xa7b3 0xbff 0x866 0x1773 0xa720 0xbda 0x84c 0x1968 0xa6d6 0xbb5 0x832 0x1a5e 0xa689 0xb87 0x812 0x1b5c 0xa5f1 0xb87 0x812 0x1d50 0xa559 0xb60 0x7f6 0x1f45 0xa4c1 0xb44 0x7e3 0x2139 0xa47b 0xb2f 0x7d4 0x222e 0xa42a 0xb1f 0x7c9 0x232d 0xa393 0xb1f 0x7c9 0x2522 0xa2fe 0xb04 0x7b6 0x2716 0xa267 0xaf1 0x7a9 0x290a 0xa221 0xae2 0x79e 0x29fe 0xa1d5 0xae5 0x7a0 0x2aff 0xa144 0xae5 0x7a0 0x2cf3 0xa0b3 0xaeb 0x7a5 0x2ee7 0xa026 0xae2 0x79e 0x30dc 0x9fdf 0xae5 0x7a0 0x31ce 0x9f99 0xaf1 0x7a9 0x32d0 0x9f0f 0xaf1 0x7a9 0x34c4 0x9e87 0xaf4 0x7ab 0x36b9 0x9dff 0xb07 0x7b8 0x38ad 0x9dbc 0xb10 0x7be 0x399e 0x9d79 0xb16 0x7c3 0x3aa1 0x9cf0 0xb16 0x7c3 0x3c96 0x9c62 0xb0a 0x7ba 0x3e8a 0x9bd0 0xb0a 0x7ba 0x407e 0x9b80 0xaf4 0x7ab 0x416e 0x9b32 0xab4 0x77e 0x4273 0x9a91 0xab4 0x77e 0x4467 0x99f2 0xa65 0x747 0x465c 0x9961 0xa0f 0x70b 0x4850 0x9925 0x9d8 0x6e4 0x493e 0x98e3 0x9b6 0x6cc 0x4a44 0x9874 0x9b6 0x6cc 0x4c39 0x9810 0x9a1 0x6be 0x4e2d 0x97b3 0x99e 0x6bb 0x5022 0x9786 0x992 0x6b3 0x510e 0x975b 0x995 0x6b5 0x5216 0x970c 0x995 0x6b5 0x540a 0x96be 0x9a7 0x6c2 0x55ff 0x969b 0x9b3 0x6ca 0x56ea 0x9677 0x9c3 0x6d5 0x57f3 0x9634 0x9c3 0x6d5 0x59e7 0x95f1 0x9d5 0x6e2 0x5bdc 0x95b2 0x9e4 0x6ec 0x5dd0 0x9597 0x9fd 0x6fe 0x5eba 0x9579 0xa0f 0x70b 0x5fc4 0x953f 0xa0f 0x70b 0x61b9 0x950a 0xa1e 0x715 0x63ad 0x94d8 0xa37 0x727 0x65a1 0x94c0 0xa4f 0x737 0x668a 0x94a7 0xa65 0x747 0x6796 0x9478 0xa65 0x747 0x698a 0x944c 0xa77 0x753 0x6b7e 0x9424 0xa93 0x767 0x6d73 0x9410 0xab4 0x77e 0x6e5a 0x93fd 0xad3 0x794 0x6f67 0x93d9 0xad3 0x794 0x715b 0x93b6 0xaeb 0x7a5 0x7350 0x9390 0xb10 0x7be 0x7544 0x9380 0xb1f 0x7c9 0x762a 0x936d 0x998 0x6b7 0x7738 0x933b 0x998 0x6b7 0x792d 0x9304 0xa86 0x75e 0x7b21 0x92ca 0xb22 0x7cb 0x7d15 0x92ac 0xb7b 0x809 0x7dfa 0x928e 0xbda 0x84c 0x7f0a 0x924a 0xbda 0x84c 0x80fe 0x91f5 0xc45 0x897 0x82f2 0x919c 0xcb6 0x8e6 0x84e7 0x9171 0xd27 0x935 0x85ca 0x9146 0xdb1 0x996 0x86db 0x90d9 0xdb1 0x996 0x88d0 0x9074 0xe4a 0xa01 0x8ac4 0x903f 0xef5 0xa78 0x8cb8 0x902b 0xfe1 0xb1e 0x8d9a 0x9017 0x1103 0xbe9 0x8ead 0x8feb 0x1103 0xbe9 0x90a1 0x8fb1 0x1266 0xce1 0x9295 0x8f37 0x144c 0xe35 0x948a 0x8e94 0x16e7 0x1008 0x956a 0x8de9 0x1a0c 0x123c 0x967e 0x8b68 0x1a0c 0x123c 0x9873 0x87d6 0x1f72 0x1603 0x9a67 0x86c4 0x2d21 0x1f97>;
				battery0_profile_t4_num = <0x64>;
				battery0_profile_t4_col = <0x04>;
				battery0_profile_t4 = <0x00 0xada1 0x17a3 0x1545 0x1f5 0xacbf 0x17a3 0x1545 0x2ee 0xac72 0x176c 0x1514 0x3ea 0xac10 0x176c 0x1514 0x5e0 0xab7a 0x1726 0x14d5 0x7d5 0xaaee 0x16ec 0x14a1 0x9ca 0xaa67 0x16a5 0x1461 0xabe 0xaa24 0x1650 0x1414 0xbc0 0xa9de 0x1650 0x1414 0xdb5 0xa959 0x161f 0x13e8 0xfaa 0xa8d0 0x15d5 0x13a6 0x11a0 0xa847 0x1598 0x136f 0x1298 0xa801 0x1552 0x1330 0x1395 0xa7bb 0x1552 0x1330 0x158a 0xa72e 0x151e 0x1301 0x1780 0xa69e 0x14e1 0x12ca 0x1975 0xa60c 0x14b3 0x12a1 0x1a6f 0xa5c2 0x1473 0x1267 0x1b6b 0xa578 0x1473 0x1267 0x1d60 0xa4e5 0x144e 0x1246 0x1f55 0xa453 0x1426 0x1222 0x204e 0xa40a 0x1405 0x1204 0x214b 0xa3c0 0x1405 0x1204 0x2340 0xa32d 0x13e0 0x11e3 0x2535 0xa29a 0x13c7 0x11cc 0x272b 0xa208 0x13af 0x11b7 0x2825 0xa1c1 0x13a3 0x11ac 0x2920 0xa17a 0x13a3 0x11ac 0x2b16 0xa0e7 0x138a 0x1195 0x2d0b 0xa059 0x137e 0x118b 0x2f00 0x9fcb 0x1378 0x1185 0x2ffa 0x9f86 0x137e 0x118b 0x30f6 0x9f42 0x137e 0x118b 0x32eb 0x9eb4 0x1372 0x1180 0x34e0 0x9e26 0x1366 0x1175 0x36d6 0x9d98 0x1366 0x1175 0x37d0 0x9d51 0x1353 0x1164 0x38cb 0x9d0b 0x1353 0x1164 0x3ac0 0x9c73 0x1328 0x113d 0x3cb6 0x9bdb 0x1301 0x111a 0x3db0 0x9b8e 0x12ca 0x10e9 0x3eab 0x9b40 0x12ca 0x10e9 0x40a0 0x9aa7 0x1296 0x10ba 0x4296 0x9a14 0x125f 0x1088 0x448b 0x9986 0x122e 0x105c 0x4585 0x98c4 0x1215 0x1046 0x4680 0x9905 0x1215 0x1046 0x4876 0x988f 0x11fd 0x1030 0x4a6b 0x9821 0x11f7 0x102b 0x4c61 0x97bf 0x11f7 0x102b 0x4d58 0x9790 0x1206 0x1038 0x4e56 0x9762 0x1206 0x1038 0x504b 0x970a 0x121b 0x104b 0x5241 0x96bb 0x1231 0x105f 0x5436 0x966c 0x1249 0x1074 0x5528 0x9646 0x1265 0x108e 0x562b 0x9624 0x1265 0x108e 0x5821 0x95e0 0x1289 0x10ae 0x5a16 0x95a0 0x12ae 0x10cf 0x5b10 0x9581 0x12d3 0x10f1 0x5c0b 0x9561 0x12d3 0x10f1 0x5e01 0x9526 0x12f8 0x1112 0x5ff6 0x94f0 0x1328 0x113d 0x61eb 0x94ba 0x134d 0x115e 0x62e5 0x94a2 0x137e 0x118b 0x63e1 0x9489 0x137e 0x118b 0x65d6 0x945d 0x13af 0x11b7 0x67cc 0x9437 0x13ec 0x11ee 0x69c1 0x9415 0x1439 0x1233 0x6abb 0x9407 0x1494 0x1285 0x6bb6 0x93fa 0x1494 0x1285 0x6dac 0x93de 0x14ed 0x12d5 0x6fa1 0x93c1 0x154f 0x132d 0x7196 0x93a3 0x15bd 0x1390 0x7290 0x9392 0x1637 0x13fe 0x738c 0x9381 0x1637 0x13fe 0x7581 0x935a 0x16a5 0x1461 0x7776 0x932e 0x172c 0x14da 0x7870 0x9315 0x17c8 0x1567 0x796c 0x92fd 0x17c8 0x1567 0x7b61 0x92c7 0x186a 0x15f9 0x7d56 0x9288 0x192b 0x16a6 0x7f4c 0x923e 0x19fe 0x1764 0x8046 0x9212 0x1ae6 0x1835 0x8141 0x91e6 0x1ae6 0x1835 0x8336 0x918e 0x1bff 0x1932 0x852c 0x9135 0x1d3a 0x1a4d 0x8721 0x90ce 0x1e9d 0x1b8d 0x881b 0x9097 0x203d 0x1d03 0x8916 0x905f 0x203d 0x1d03 0x8b0c 0x9012 0x2238 0x1ecc 0x8d01 0x8fde 0x24a2 0x20f8 0x8ef6 0x8faf 0x27d9 0x23dc 0x9088 0x8f78 0x2c53 0x27e4 0x9182 0x8f1c 0x3344 0x2e23 0x927c 0x8e3e 0x40df 0x3a62 0x9376 0x8d08 0x4f28 0x473d 0x9470 0x8c48 0x4d48 0x458d 0x956a 0x8bb5 0x4bd9 0x4443 0x9664 0x89da 0x4734 0x4015>;
				battery1_profile_t0_num = <0x64>;
				battery1_profile_t0_col = <0x04>;
				battery1_profile_t0 = <0x00 0xae18 0x302 0x302 0x18f 0xad94 0x302 0x302 0x31e 0xad1e 0x302 0x302 0x4ad 0xacb2 0x301 0x301 0x63c 0xac4b 0x300 0x300 0x7cb 0xabe9 0x2ff 0x2ff 0x95a 0xab87 0x2ff 0x2ff 0xae9 0xab25 0x308 0x308 0xc78 0xaabe 0x30a 0x30a 0xe07 0xaa52 0x2ff 0x2ff 0xf96 0xa9e7 0x2f3 0x2f3 0x1125 0xa97f 0x2fd 0x2fd 0x12b4 0xa914 0x30a 0x30a 0x1443 0xa8a6 0x311 0x311 0x15d2 0xa835 0x311 0x311 0x1761 0xa7be 0x311 0x311 0x18f0 0xa744 0x304 0x304 0x1a7f 0xa6cd 0x312 0x312 0x1c0e 0xa657 0x320 0x320 0x1d9d 0xa5df 0x31e 0x31e 0x1f2c 0xa55f 0x312 0x312 0x20bb 0xa4e9 0x30f 0x30f 0x224a 0xa473 0x321 0x321 0x23d9 0xa3fc 0x32a 0x32a 0x2568 0xa381 0x320 0x320 0x26f7 0xa306 0x320 0x320 0x2886 0xa28f 0x32b 0x32b 0x2a15 0xa21d 0x32f 0x32f 0x2ba4 0xa1aa 0x32f 0x32f 0x2d33 0xa135 0x331 0x331 0x2ec2 0xa0c5 0x33d 0x33d 0x3051 0xa053 0x33e 0x33e 0x31e0 0x9fe6 0x346 0x346 0x336f 0x9f7c 0x353 0x353 0x34fe 0x9f14 0x35f 0x35f 0x368d 0x9ea9 0x35f 0x35f 0x381c 0x9e46 0x374 0x374 0x39ab 0x9de0 0x37b 0x37b 0x3b3a 0x9d7a 0x380 0x380 0x3cc9 0x9d18 0x391 0x391 0x3e58 0x9cb6 0x3b5 0x3b5 0x3fe7 0x9c4f 0x3c3 0x3c3 0x4176 0x9be2 0x3c9 0x3c9 0x4305 0x9b66 0x3b2 0x3b2 0x4494 0x9ad6 0x372 0x372 0x4623 0x9a3e 0x328 0x328 0x47b2 0x99c9 0x320 0x320 0x4941 0x9967 0x317 0x317 0x4ad0 0x9912 0x30f 0x30f 0x4c5f 0x98c4 0x30f 0x30f 0x4ded 0x9875 0x301 0x301 0x4f7c 0x9833 0x30a 0x30a 0x510b 0x97f0 0x30f 0x30f 0x529a 0x97ae 0x30a 0x30a 0x5429 0x976e 0x301 0x301 0x55b8 0x9734 0x30f 0x30f 0x5747 0x96fd 0x31b 0x31b 0x58d6 0x96c7 0x320 0x320 0x5a65 0x9691 0x320 0x320 0x5bf4 0x965c 0x31f 0x31f 0x5d83 0x9625 0x313 0x313 0x5f12 0x95f8 0x327 0x327 0x60a1 0x95c9 0x330 0x330 0x6230 0x959b 0x338 0x338 0x63bf 0x9573 0x34e 0x34e 0x654e 0x9546 0x340 0x340 0x66dd 0x951a 0x348 0x348 0x686c 0x94f4 0x354 0x354 0x69fb 0x94cf 0x361 0x361 0x6b8a 0x94a3 0x36d 0x36d 0x6d19 0x9476 0x36b 0x36b 0x6ea8 0x942e 0x344 0x344 0x7037 0x93da 0x321 0x321 0x71c6 0x9389 0x30d 0x30d 0x7355 0x934a 0x301 0x301 0x74e4 0x9319 0x31b 0x31b 0x7673 0x92e4 0x316 0x316 0x7802 0x92ae 0x318 0x318 0x7991 0x9278 0x31c 0x31c 0x7b20 0x9243 0x312 0x312 0x7caf 0x921b 0x31b 0x31b 0x7e3e 0x91ec 0x329 0x329 0x7fcd 0x91b6 0x32f 0x32f 0x815c 0x9177 0x32c 0x32c 0x82eb 0x912d 0x320 0x320 0x847a 0x90e9 0x320 0x320 0x8609 0x90a0 0x315 0x315 0x8798 0x9051 0x303 0x303 0x8927 0x900e 0x2f2 0x2f2 0x8ab6 0x8ff6 0x2f1 0x2f1 0x8c45 0x8fec 0x317 0x317 0x8dd4 0x8fe2 0x332 0x332 0x8f63 0x8fd3 0x34b 0x34b 0x90f2 0x8fb7 0x36b 0x36b 0x9281 0x8f7e 0x399 0x399 0x9410 0x8e7e 0x344 0x344 0x959f 0x8cf2 0x355 0x355 0x972e 0x8ae4 0x386 0x386 0x98bd 0x883c 0x3c8 0x3c8 0x9a4c 0x86c4 0x442 0x442>;
				battery1_profile_t1_num = <0x64>;
				battery1_profile_t1_col = <0x04>;
				battery1_profile_t1 = <0x00 0xadbb 0x45e 0x45e 0x18f 0xad3b 0x45e 0x45e 0x31e 0xacc5 0x45c 0x45c 0x4ad 0xac58 0x45c 0x45c 0x63c 0xabf0 0x45b 0x45b 0x7cb 0xab88 0x44f 0x44f 0x95a 0xab25 0x45a 0x45a 0xae9 0xaabe 0x45c 0x45c 0xc78 0xaa54 0x45b 0x45b 0xe07 0xa9e7 0x45b 0x45b 0xf96 0xa97b 0x45d 0x45d 0x1125 0xa912 0x45c 0x45c 0x12b4 0xa8a0 0x454 0x454 0x1443 0xa829 0x44e 0x44e 0x15d2 0xa7b2 0x44c 0x44c 0x1761 0xa73c 0x44c 0x44c 0x18f0 0xa6bb 0x44c 0x44c 0x1a7f 0xa642 0x454 0x454 0x1c0e 0xa5c9 0x45b 0x45b 0x1d9d 0xa54d 0x45b 0x45b 0x1f2c 0xa4d1 0x45b 0x45b 0x20bb 0xa456 0x45b 0x45b 0x224a 0xa3dd 0x463 0x463 0x23d9 0xa366 0x46a 0x46a 0x2568 0xa2ef 0x46a 0x46a 0x26f7 0xa273 0x46a 0x46a 0x2886 0xa201 0x477 0x477 0x2a15 0xa18c 0x484 0x484 0x2ba4 0xa117 0x48b 0x48b 0x2d33 0xa0a6 0x48d 0x48d 0x2ec2 0xa039 0x499 0x499 0x3051 0x9fcd 0x4a6 0x4a6 0x31e0 0x9f63 0x4c3 0x4c3 0x336f 0x9efb 0x4dd 0x4dd 0x34fe 0x9e93 0x4eb 0x4eb 0x368d 0x9e2b 0x505 0x505 0x381c 0x9dc8 0x512 0x512 0x39ab 0x9d62 0x517 0x517 0x3b3a 0x9cfc 0x521 0x521 0x3cc9 0x9c98 0x539 0x539 0x3e58 0x9c30 0x542 0x542 0x3fe7 0x9bbf 0x539 0x539 0x4176 0x9b47 0x51d 0x51d 0x4305 0x9ac6 0x4ea 0x4ea 0x4494 0x9a3c 0x4a0 0x4a0 0x4623 0x99bc 0x462 0x462 0x47b2 0x9951 0x446 0x446 0x4941 0x98ef 0x425 0x425 0x4ad0 0x9899 0x40e 0x40e 0x4c5f 0x984f 0x40f 0x40f 0x4ded 0x980a 0x41b 0x41b 0x4f7c 0x97c9 0x41e 0x41e 0x510b 0x9789 0x41f 0x41f 0x529a 0x974c 0x41f 0x41f 0x5429 0x9715 0x41f 0x41f 0x55b8 0x96d9 0x41d 0x41d 0x5747 0x96a6 0x427 0x427 0x58d6 0x9672 0x42d 0x42d 0x5a65 0x963f 0x432 0x432 0x5bf4 0x9612 0x43d 0x43d 0x5d83 0x95e1 0x43d 0x43d 0x5f12 0x95b4 0x43d 0x43d 0x60a1 0x958d 0x44b 0x44b 0x6230 0x9567 0x45b 0x45b 0x63bf 0x953b 0x45d 0x45d 0x654e 0x9519 0x477 0x477 0x66dd 0x94f2 0x470 0x470 0x686c 0x94cd 0x479 0x479 0x69fb 0x94ab 0x48b 0x48b 0x6b8a 0x9488 0x48a 0x48a 0x6d19 0x9460 0x47e 0x47e 0x6ea8 0x9438 0x47c 0x47c 0x7037 0x940e 0x46e 0x46e 0x71c6 0x93e0 0x456 0x456 0x7355 0x93af 0x43f 0x43f 0x74e4 0x937d 0x43f 0x43f 0x7673 0x934c 0x440 0x440 0x7802 0x9317 0x438 0x438 0x7991 0x92e5 0x42e 0x42e 0x7b20 0x92be 0x42e 0x42e 0x7caf 0x9296 0x42e 0x42e 0x7e3e 0x926a 0x441 0x441 0x7fcd 0x9238 0x44c 0x44c 0x815c 0x91fc 0x449 0x449 0x82eb 0x91b3 0x43d 0x43d 0x847a 0x9182 0x449 0x449 0x8609 0x9141 0x44c 0x44c 0x8798 0x90ee 0x438 0x438 0x8927 0x90a2 0x424 0x424 0x8ab6 0x9085 0x43d 0x43d 0x8c45 0x9076 0x43d 0x43d 0x8dd4 0x9067 0x44f 0x44f 0x8f63 0x9058 0x46f 0x46f 0x90f2 0x9041 0x498 0x498 0x9281 0x9013 0x4c9 0x4c9 0x9410 0x8f4e 0x4b1 0x4b1 0x959f 0x8dd3 0x4a9 0x4a9 0x972e 0x8bcb 0x4cf 0x4cf 0x98bd 0x8925 0x523 0x523 0x9a4c 0x86c4 0x591 0x591>;
				battery1_profile_t2_num = <0x64>;
				battery1_profile_t2_col = <0x04>;
				battery1_profile_t2 = <0x00 0xadaa 0x5fe 0x565 0x18f 0xacca 0x5fe 0x565 0x31e 0xac44 0x61a 0x57e 0x4ad 0xabdc 0x62d 0x58f 0x63c 0xab77 0x630 0x592 0x7cb 0xab19 0x63c 0x59c 0x95a 0xaaac 0x624 0x587 0xae9 0xaa47 0x627 0x58a 0xc78 0xa9df 0x627 0x58a 0xe07 0xa972 0x621 0x584 0xf96 0xa905 0x62d 0x58f 0x1125 0xa88f 0x621 0x584 0x12b4 0xa818 0x615 0x579 0x1443 0xa7a3 0x614 0x578 0x15d2 0xa72e 0x61b 0x57f 0x1761 0xa6ae 0x60e 0x573 0x18f0 0xa632 0x60e 0x573 0x1a7f 0xa5ba 0x60e 0x573 0x1c0e 0xa541 0x614 0x578 0x1d9d 0xa4c5 0x61b 0x57f 0x1f2c 0xa449 0x60f 0x574 0x20bb 0xa3d2 0x61a 0x57e 0x224a 0xa35c 0x626 0x589 0x23d9 0xa2e5 0x633 0x594 0x2568 0xa26e 0x63d 0x59d 0x26f7 0xa1f7 0x63d 0x59d 0x2886 0xa181 0x63d 0x59d 0x2a15 0xa111 0x645 0x5a5 0x2ba4 0xa0a2 0x657 0x5b5 0x2d33 0xa030 0x66b 0x5c7 0x2ec2 0x9fbe 0x66b 0x5c7 0x3051 0x9f55 0x676 0x5d1 0x31e0 0x9eed 0x68b 0x5e4 0x336f 0x9e86 0x6a9 0x5ff 0x34fe 0x9e1e 0x6ca 0x61c 0x368d 0x9db6 0x6d7 0x628 0x381c 0x9d4e 0x6e3 0x633 0x39ab 0x9ce6 0x6ef 0x63e 0x3b3a 0x9c7c 0x6fc 0x649 0x3cc9 0x9c0c 0x6ff 0x64c 0x3e58 0x9b8c 0x6cd 0x61f 0x3fe7 0x9b02 0x685 0x5de 0x4176 0x9a7b 0x63b 0x59c 0x4305 0x99f9 0x5fb 0x562 0x4494 0x9981 0x5cd 0x539 0x4623 0x991e 0x5b4 0x522 0x47b2 0x98c4 0x59b 0x50c 0x4941 0x9874 0x592 0x503 0x4ad0 0x982c 0x592 0x503 0x4c5f 0x97e6 0x592 0x503 0x4ded 0x97a1 0x592 0x503 0x4f7c 0x9764 0x59d 0x50d 0x510b 0x9729 0x5a2 0x512 0x529a 0x96f0 0x5a6 0x515 0x5429 0x96b9 0x5b1 0x51f 0x55b8 0x9683 0x5b1 0x51f 0x5747 0x9651 0x5bc 0x529 0x58d6 0x961f 0x5c1 0x52e 0x5a65 0x95ef 0x5ca 0x536 0x5bf4 0x95c3 0x5e2 0x54b 0x5d83 0x9596 0x5fb 0x562 0x5f12 0x956a 0x5ff 0x566 0x60a1 0x9540 0x606 0x56c 0x6230 0x9518 0x612 0x577 0x63bf 0x94f1 0x61e 0x581 0x654e 0x94c9 0x61e 0x581 0x66dd 0x94a6 0x628 0x58a 0x686c 0x9483 0x62d 0x58f 0x69fb 0x9462 0x635 0x596 0x6b8a 0x9444 0x64c 0x5ab 0x6d19 0x9422 0x64c 0x5ab 0x6ea8 0x93ff 0x656 0x5b4 0x7037 0x93d7 0x64d 0x5ac 0x71c6 0x93aa 0x63d 0x59d 0x7355 0x937d 0x63b 0x59c 0x74e4 0x9341 0x622 0x585 0x7673 0x9312 0x61e 0x581 0x7802 0x92e5 0x61e 0x581 0x7991 0x92b9 0x621 0x584 0x7b20 0x928c 0x62e 0x590 0x7caf 0x925b 0x647 0x5a6 0x7e3e 0x921d 0x64c 0x5ab 0x7fcd 0x91dd 0x653 0x5b1 0x815c 0x919e 0x667 0x5c3 0x82eb 0x9162 0x68b 0x5e4 0x847a 0x910e 0x697 0x5ee 0x8609 0x90bd 0x69a 0x5f1 0x8798 0x908b 0x6ad 0x602 0x8927 0x9075 0x6d3 0x624 0x8ab6 0x9066 0x6f8 0x646 0x8c45 0x9058 0x736 0x67d 0x8dd4 0x903d 0x77e 0x6be 0x8f63 0x900e 0x7ee 0x723 0x90f2 0x8f95 0x85e 0x788 0x9281 0x8e7d 0x86c 0x794 0x9410 0x8c89 0x8e8 0x804 0x959f 0x89ff 0x9d4 0x8d8 0x972e 0x88b8 0xb6e 0xa49 0x98bd 0x87be 0xd05 0xbb8 0x9920 0x86c4 0xd05 0xbb8>;
				battery1_profile_t3_num = <0x64>;
				battery1_profile_t3_col = <0x04>;
				battery1_profile_t3 = <0x00 0xad4e 0xa7a 0x96e 0x18f 0xabbc 0xa7a 0x96e 0x31e 0xaaf6 0xaba 0x9a7 0x4ad 0xaa7c 0xaf2 0x9da 0x63c 0xaa0a 0xb08 0x9ee 0x7cb 0xa999 0xb15 0x9f9 0x95a 0xa922 0xb15 0x9f9 0xae9 0xa8ab 0xafa 0x9e1 0xc78 0xa834 0xaf2 0x9da 0xe07 0xa7bd 0xb05 0x9eb 0xf96 0xa741 0xb05 0x9eb 0x1125 0xa6c5 0xad5 0x9c0 0x12b4 0xa649 0xaf4 0x9dc 0x1443 0xa5cb 0xb15 0x9f9 0x15d2 0xa54d 0xb0f 0x9f4 0x1761 0xa4d6 0xaf7 0x9de 0x18f0 0xa456 0xb02 0x9e8 0x1a7f 0xa3dc 0xb0e 0x9f3 0x1c0e 0xa363 0xafe 0x9e5 0x1d9d 0xa2e8 0xade 0x9c8 0x1f2c 0xa26c 0xb03 0x9e9 0x20bb 0xa1f5 0xb28 0xa0a 0x224a 0xa182 0xb3c 0xa1c 0x23d9 0xa10e 0xb48 0xa27 0x2568 0xa099 0xb57 0xa35 0x26f7 0xa02c 0xb70 0xa4b 0x2886 0x9fb6 0xb66 0xa42 0x2a15 0x9f42 0xb6b 0xa47 0x2ba4 0x9ed5 0xb82 0xa5b 0x2d33 0x9e6d 0xba7 0xa7d 0x2ec2 0x9e05 0xbcc 0xa9e 0x3051 0x9d94 0xbda 0xaab 0x31e0 0x9d22 0xbde 0xaae 0x336f 0x9cac 0xbd9 0xaaa 0x34fe 0x9c2f 0xbc9 0xa9b 0x368d 0x9ba9 0xba4 0xa7a 0x381c 0x9b1b 0xb68 0xa44 0x39ab 0x9a8f 0xb22 0xa05 0x3b3a 0x9a0c 0xaf1 0x9d9 0x3cc9 0x9998 0xadf 0x9c9 0x3e58 0x9935 0xaad 0x99c 0x3fe7 0x98d2 0xab3 0x9a1 0x4176 0x987c 0xa98 0x989 0x4305 0x982f 0xa8d 0x97f 0x4494 0x97e5 0xabb 0x9a8 0x4623 0x97a0 0xad4 0x9bf 0x47b2 0x975f 0xac1 0x9ae 0x4941 0x971f 0xadf 0x9c9 0x4ad0 0x96e1 0xb05 0x9eb 0x4c5f 0x96a6 0xb0c 0x9f1 0x4ded 0x966f 0xb3d 0xa1d 0x4f7c 0x9639 0xb59 0xa37 0x510b 0x9606 0xb79 0xa53 0x529a 0x95d2 0xb95 0xa6d 0x5429 0x959d 0xba4 0xa7a 0x55b8 0x9571 0xbca 0xa9c 0x5747 0x9544 0xbe4 0xab4 0x58d6 0x951a 0xc04 0xad0 0x5a65 0x94f3 0xc2e 0xaf6 0x5bf4 0x94cc 0xc5e 0xb21 0x5d83 0x94a9 0xc83 0xb43 0x5f12 0x9482 0xc93 0xb51 0x60a1 0x9461 0xcb5 0xb70 0x6230 0x9441 0xce7 0xb9d 0x63bf 0x941f 0xd16 0xbc7 0x654e 0x93fc 0xd2f 0xbde 0x66dd 0x93dd 0xd5d 0xc07 0x686c 0x93c0 0xd87 0xc2d 0x69fb 0x93a0 0xdb0 0xc52 0x6b8a 0x937e 0xde2 0xc7f 0x6d19 0x935b 0xe13 0xcab 0x6ea8 0x9334 0xe4f 0xce1 0x7037 0x930a 0xe9b 0xd25 0x71c6 0x92de 0xee9 0xd6b 0x7355 0x92b0 0xf2a 0xda6 0x74e4 0x9275 0xf8c 0xdfe 0x7673 0x9231 0x1003 0xe69 0x7802 0x91ec 0x1078 0xed2 0x7991 0x91a8 0x10fa 0xf47 0x7b20 0x9167 0x11a8 0xfe4 0x7caf 0x9118 0x1255 0x1080 0x7e3e 0x90c1 0x1302 0x111b 0x7fcd 0x907b 0x13d1 0x11d6 0x815c 0x904c 0x14ce 0x12b9 0x82eb 0x902e 0x15fa 0x13c7 0x847a 0x9010 0x176d 0x1515 0x8609 0x8fef 0x1941 0x16bb 0x8798 0x8fbc 0x1ba6 0x18e2 0x8927 0x8f5c 0x1eb5 0x1ba3 0x8ab6 0x8ea4 0x2280 0x1f0d 0x8c45 0x8d09 0x292b 0x250d 0x8dd4 0x8ac3 0x3d02 0x36e8 0x8f63 0x88ca 0x4676 0x3f6a 0x90f2 0x878e 0x43b2 0x3ced 0x9281 0x875a 0x43b2 0x3ced 0x9410 0x8746 0x43b2 0x3ced 0x959f 0x873c 0x43b2 0x3ced 0x972e 0x8728 0x43b2 0x3ced 0x9858 0x86f6 0x43b2 0x3ced 0x98bc 0x86c4 0x43b2 0x3ced>;
				battery1_profile_t4_num = <0x64>;
				battery1_profile_t4_col = <0x04>;
				battery1_profile_t4 = <0x00 0xad33 0xece 0xece 0x18f 0xac8b 0x1db6 0x1db6 0x31e 0xabf5 0x216a 0x216a 0x4ad 0xab6d 0x213e 0x213e 0x63c 0xaaef 0x20fe 0x20fe 0x7cb 0xaa78 0x20b3 0x20b3 0x95a 0xaa01 0x205d 0x205d 0xae9 0xa98a 0x2006 0x2006 0xc78 0xa914 0x1fb0 0x1fb0 0xe07 0xa89e 0x1f59 0x1f59 0xf96 0xa82c 0x1f03 0x1f03 0x1125 0xa7b6 0x1e94 0x1e94 0x12b4 0xa742 0x1e48 0x1e48 0x1443 0xa6ce 0x1e10 0x1e10 0x15d2 0xa658 0x1dda 0x1dda 0x1761 0xa5e1 0x1d8f 0x1d8f 0x18f0 0xa56a 0x1d51 0x1d51 0x1a7f 0xa4f7 0x1d1c 0x1d1c 0x1c0e 0xa483 0x1cdf 0x1cdf 0x1d9d 0xa40d 0x1c97 0x1c97 0x1f2c 0xa39b 0x1c5a 0x1c5a 0x20bb 0xa320 0x1c04 0x1c04 0x224a 0xa2a8 0x1bc8 0x1bc8 0x23d9 0xa233 0x1b91 0x1b91 0x2568 0xa1c1 0x1b5a 0x1b5a 0x26f7 0xa14a 0x1b41 0x1b41 0x2886 0xa0d8 0x1b11 0x1b11 0x2a15 0xa062 0x1adf 0x1adf 0x2ba4 0x9fec 0x1aae 0x1aae 0x2d33 0x9f74 0x1a7d 0x1a7d 0x2ec2 0x9ef8 0x1a4b 0x1a4b 0x3051 0x9e7d 0x1a1a 0x1a1a 0x31e0 0x9e04 0x19e8 0x19e8 0x336f 0x9d8c 0x19ad 0x19ad 0x34fe 0x9d0f 0x1962 0x1962 0x368d 0x9c8e 0x1918 0x1918 0x381c 0x9c1b 0x18f0 0x18f0 0x39ab 0x9ba6 0x18c2 0x18c2 0x3b3a 0x9b2f 0x188c 0x188c 0x3cc9 0x9abb 0x1853 0x1853 0x3e58 0x9a53 0x183b 0x183b 0x3fe7 0x99f0 0x1838 0x1838 0x4176 0x998d 0x1828 0x1828 0x4305 0x992e 0x1819 0x1819 0x4494 0x98d5 0x1818 0x1818 0x4623 0x9881 0x180b 0x180b 0x47b2 0x9831 0x182b 0x182b 0x4941 0x97e5 0x1848 0x1848 0x4ad0 0x979d 0x1861 0x1861 0x4c5f 0x9758 0x1878 0x1878 0x4ded 0x9712 0x1884 0x1884 0x4f7c 0x96d2 0x189c 0x189c 0x510b 0x9694 0x18c4 0x18c4 0x529a 0x9659 0x18f5 0x18f5 0x5429 0x961e 0x1927 0x1927 0x55b8 0x95e8 0x1958 0x1958 0x5747 0x95b1 0x1989 0x1989 0x58d6 0x957e 0x19bb 0x19bb 0x5a65 0x954e 0x19fa 0x19fa 0x5bf4 0x9521 0x1a4c 0x1a4c 0x5d83 0x94f5 0x1a7e 0x1a7e 0x5f12 0x94c4 0x1aba 0x1aba 0x60a1 0x949c 0x1aff 0x1aff 0x6230 0x9477 0x1b49 0x1b49 0x63bf 0x9451 0x1b94 0x1b94 0x654e 0x9433 0x1beb 0x1beb 0x66dd 0x9415 0x1c42 0x1c42 0x686c 0x93f8 0x1ca0 0x1ca0 0x69fb 0x93db 0x1d17 0x1d17 0x6b8a 0x93c2 0x1db6 0x1db6 0x6d19 0x93a5 0x1e3e 0x1e3e 0x6ea8 0x9387 0x1ee4 0x1ee4 0x7037 0x9366 0x1f92 0x1f92 0x71c6 0x9344 0x204b 0x204b 0x7355 0x9321 0x211e 0x211e 0x74e4 0x92f9 0x21fc 0x21fc 0x7673 0x92d2 0x2303 0x2303 0x7802 0x92a2 0x2421 0x2421 0x7991 0x926d 0x2559 0x2559 0x7b20 0x923b 0x26b6 0x26b6 0x7caf 0x9205 0x284f 0x284f 0x7e3e 0x91ca 0x29fa 0x29fa 0x7fcd 0x918c 0x2be1 0x2be1 0x815c 0x914c 0x2e19 0x2e19 0x82eb 0x910b 0x30ac 0x30ac 0x847a 0x90c1 0x339f 0x339f 0x8609 0x90b1 0x3442 0x3442 0x8798 0x9088 0x3442 0x3442 0x8927 0x9024 0x3442 0x3442 0x8ab6 0x8fc0 0x3442 0x3442 0x8c45 0x8f5c 0x3442 0x3442 0x8dd4 0x8ef8 0x3442 0x3442 0x8f63 0x8e94 0x3442 0x3442 0x90f2 0x8e30 0x3442 0x3442 0x9281 0x8dcc 0x3442 0x3442 0x9410 0x8d68 0x3442 0x3442 0x959f 0x8d04 0x3442 0x3442 0x972e 0x8ca0 0x3442 0x3442 0x97f4 0x8aac 0x3442 0x3442 0x9858 0x88b8 0x3442 0x3442>;
				phandle = <0x68>;
			};

			mtk_charger_type {
				compatible = "mediatek,mt6357-charger-type";
				io-channels = <0x27 0x02>;
				io-channel-names = "pmic_vbus";
				bc12_active = <0x01>;
				phandle = <0x29>;
			};

			mt6357_charger {
				compatible = "mediatek,mt6357-pulse-charger";
				charger_name = "primary_chg";
				alias_name = "mt6357";
				ichg = <0x7a120>;
				cv = <0x426030>;
				vcdt_hv_thres = <0x6acfc0>;
				vbat_ov_thres = <0x43e6d0>;
				phandle = <0x78>;
			};

			mtk_ts_pmic {
				compatible = "mediatek,mtk_ts_pmic";
				io-channels = <0x27 0x05 0x27 0x06 0x27 0x07>;
				io-channel-names = "pmic_chip_temp\0pmic_buck1_temp\0pmic_buck2_temp";
				interconnects = <0x27 0x01>;
				#interconnect-cells = <0x01>;
				phandle = <0x2d>;
			};

			mt6357_ts_buck1 {
				compatible = "mediatek,mt6357_ts_buck1";
				io-channels = <0x27 0x06>;
				io-channel-names = "pmic_buck1_temp";
				interconnects = <0x2d 0x01>;
				phandle = <0x79>;
			};

			mt6357_ts_buck2 {
				compatible = "mediatek,mt6357_ts_buck2";
				io-channels = <0x27 0x07>;
				io-channel-names = "pmic_buck2_temp";
				interconnects = <0x2d 0x01>;
				phandle = <0x7a>;
			};

			pmic_efuse {
				compatible = "mediatek,mt6357-efuse";
				#address-cells = <0x01>;
				#size-cells = <0x01>;
				phandle = <0x28>;
			};

			mt6357regulator {
				compatible = "mediatek,mt6357-regulator";
				phandle = <0x7b>;

				buck_vs1 {
					regulator-name = "vs1";
					regulator-min-microvolt = <0x124f80>;
					regulator-max-microvolt = <0x2191c0>;
					regulator-ramp-delay = <0x30d4>;
					regulator-enable-ramp-delay = <0xdc>;
					phandle = <0x7c>;
				};

				buck_vmodem {
					regulator-name = "vmodem";
					regulator-min-microvolt = <0x7a120>;
					regulator-max-microvolt = <0x123716>;
					regulator-ramp-delay = <0x186a>;
					regulator-enable-ramp-delay = <0xdc>;
					phandle = <0x36>;
				};

				buck_vcore {
					regulator-name = "vcore";
					regulator-min-microvolt = <0x7ea5e>;
					regulator-max-microvolt = <0x1406f4>;
					regulator-ramp-delay = <0x186a>;
					regulator-enable-ramp-delay = <0xdc>;
					phandle = <0x37>;
				};

				buck_vproc {
					regulator-name = "vproc";
					regulator-min-microvolt = <0x7ea5e>;
					regulator-max-microvolt = <0x1406f4>;
					regulator-ramp-delay = <0x186a>;
					regulator-enable-ramp-delay = <0xdc>;
					phandle = <0x7d>;
				};

				buck_vpa {
					regulator-name = "vpa";
					regulator-min-microvolt = <0x7a120>;
					regulator-max-microvolt = <0x37b1d0>;
					regulator-ramp-delay = <0xc350>;
					regulator-enable-ramp-delay = <0xdc>;
					phandle = <0x7e>;
				};

				ldo_vfe28 {
					regulator-name = "vfe28";
					regulator-min-microvolt = <0x2ab980>;
					regulator-max-microvolt = <0x2ab980>;
					regulator-enable-ramp-delay = <0x108>;
					phandle = <0x7f>;
				};

				ldo_vxo22 {
					regulator-name = "vxo22";
					regulator-min-microvolt = <0x2191c0>;
					regulator-max-microvolt = <0x249f00>;
					regulator-enable-ramp-delay = <0x6e>;
					phandle = <0x80>;
				};

				ldo_vrf18 {
					regulator-name = "vrf18";
					regulator-min-microvolt = <0x1b7740>;
					regulator-max-microvolt = <0x1b7740>;
					regulator-enable-ramp-delay = <0x6e>;
					phandle = <0x81>;
				};

				ldo_vrf12 {
					regulator-name = "vrf12";
					regulator-min-microvolt = <0x124f80>;
					regulator-max-microvolt = <0x124f80>;
					regulator-enable-ramp-delay = <0x6e>;
					phandle = <0x82>;
				};

				ldo_vefuse {
					regulator-name = "vefuse";
					regulator-min-microvolt = <0x124f80>;
					regulator-max-microvolt = <0x325aa0>;
					regulator-enable-ramp-delay = <0x108>;
					phandle = <0x83>;
				};

				ldo_vcn33_bt {
					regulator-name = "vcn33_bt";
					regulator-min-microvolt = <0x325aa0>;
					regulator-max-microvolt = <0x3567e0>;
					regulator-enable-ramp-delay = <0x108>;
					phandle = <0x84>;
				};

				ldo_vcn33_wifi {
					regulator-name = "vcn33_wifi";
					regulator-min-microvolt = <0x325aa0>;
					regulator-max-microvolt = <0x3567e0>;
					regulator-enable-ramp-delay = <0x108>;
					phandle = <0x85>;
				};

				ldo_vcn28 {
					regulator-name = "vcn28";
					regulator-min-microvolt = <0x2ab980>;
					regulator-max-microvolt = <0x2ab980>;
					regulator-enable-ramp-delay = <0x108>;
					phandle = <0x86>;
				};

				ldo_vcn18 {
					regulator-name = "vcn18";
					regulator-min-microvolt = <0x1b7740>;
					regulator-max-microvolt = <0x1b7740>;
					regulator-enable-ramp-delay = <0x108>;
					phandle = <0x87>;
				};

				ldo_vcama {
					regulator-name = "vcama";
					regulator-min-microvolt = <0x2625a0>;
					regulator-max-microvolt = <0x2ab980>;
					regulator-enable-ramp-delay = <0x108>;
					phandle = <0x88>;
				};

				ldo_vcamd {
					regulator-name = "vcamd";
					regulator-min-microvolt = <0xf4240>;
					regulator-max-microvolt = <0x1b7740>;
					regulator-enable-ramp-delay = <0x108>;
					phandle = <0x89>;
				};

				ldo_vcamio {
					regulator-name = "vcamio";
					regulator-min-microvolt = <0x1b7740>;
					regulator-max-microvolt = <0x1b7740>;
					regulator-enable-ramp-delay = <0x108>;
					phandle = <0x8a>;
				};

				ldo_vldo28 {
					regulator-name = "vldo28";
					regulator-min-microvolt = <0x2ab980>;
					regulator-max-microvolt = <0x2dc6c0>;
					regulator-enable-ramp-delay = <0x108>;
					phandle = <0x8b>;
				};

				ldo_vsram_others {
					regulator-name = "vsram_others";
					regulator-min-microvolt = <0x7ea5e>;
					regulator-max-microvolt = <0x1406f4>;
					regulator-ramp-delay = <0x186a>;
					regulator-enable-ramp-delay = <0x6e>;
					phandle = <0x8c>;
				};

				ldo_vsram_proc {
					regulator-name = "vsram_proc";
					regulator-min-microvolt = <0x7ea5e>;
					regulator-max-microvolt = <0x1406f4>;
					regulator-ramp-delay = <0x186a>;
					regulator-enable-ramp-delay = <0x6e>;
					phandle = <0x8d>;
				};

				ldo_vaux18 {
					regulator-name = "vaux18";
					regulator-min-microvolt = <0x1b7740>;
					regulator-max-microvolt = <0x1b7740>;
					regulator-enable-ramp-delay = <0x108>;
					phandle = <0x8e>;
				};

				ldo_vaud28 {
					regulator-name = "vaud28";
					regulator-min-microvolt = <0x2ab980>;
					regulator-max-microvolt = <0x2ab980>;
					regulator-enable-ramp-delay = <0x108>;
					phandle = <0x8f>;
				};

				ldo_vio28 {
					regulator-name = "vio28";
					regulator-min-microvolt = <0x2ab980>;
					regulator-max-microvolt = <0x2ab980>;
					regulator-enable-ramp-delay = <0x108>;
					phandle = <0x90>;
				};

				ldo_vio18 {
					regulator-name = "vio18";
					regulator-min-microvolt = <0x1b7740>;
					regulator-max-microvolt = <0x1b7740>;
					regulator-enable-ramp-delay = <0x108>;
					phandle = <0x91>;
				};

				ldo_vdram {
					regulator-name = "vdram";
					regulator-min-microvolt = <0x10c8e0>;
					regulator-max-microvolt = <0x124f80>;
					regulator-enable-ramp-delay = <0xce4>;
					phandle = <0x92>;
				};

				ldo_vmc {
					regulator-name = "vmc";
					regulator-min-microvolt = <0x1b7740>;
					regulator-max-microvolt = <0x325aa0>;
					regulator-enable-ramp-delay = <0x2c>;
					phandle = <0x5c>;
				};

				ldo_vmch {
					regulator-name = "vmch";
					regulator-min-microvolt = <0x2c4020>;
					regulator-max-microvolt = <0x325aa0>;
					regulator-enable-ramp-delay = <0x2c>;
					phandle = <0x5b>;
				};

				ldo_vemc {
					regulator-name = "vemc";
					regulator-min-microvolt = <0x2c4020>;
					regulator-max-microvolt = <0x325aa0>;
					regulator-enable-ramp-delay = <0x2c>;
					phandle = <0x55>;
				};

				ldo_vsim1 {
					regulator-name = "vsim1";
					regulator-min-microvolt = <0x19f0a0>;
					regulator-max-microvolt = <0x2f4d60>;
					regulator-enable-ramp-delay = <0x108>;
					phandle = <0x93>;
				};

				ldo_vsim2 {
					regulator-name = "vsim2";
					regulator-min-microvolt = <0x19f0a0>;
					regulator-max-microvolt = <0x2f4d60>;
					regulator-enable-ramp-delay = <0x108>;
					phandle = <0x94>;
				};

				ldo_vibr {
					regulator-name = "vibr";
					regulator-min-microvolt = <0x124f80>;
					regulator-max-microvolt = <0x325aa0>;
					regulator-enable-ramp-delay = <0x2c>;
					phandle = <0x02>;
				};

				ldo_vusb33 {
					regulator-name = "vusb33";
					regulator-min-microvolt = <0x2dc6c0>;
					regulator-max-microvolt = <0x2f4d60>;
					regulator-enable-ramp-delay = <0x108>;
					phandle = <0x95>;
				};
			};

			mtk_dynamic_loading_throttling {
				compatible = "mediatek,mt6357-dynamic_loading_throttling";
				mediatek,charger = <0x2e>;
				uvlo-level = <0xa28>;
				isense_support;
				io-channels = <0x27 0x0f 0x27 0x10 0x27 0x01 0x27 0x00>;
				io-channel-names = "pmic_ptim\0pmic_imix_r\0pmic_isense\0pmic_batadc";
			};

			pmic_lbat_service {
				compatible = "mediatek,mt6357-lbat_service";
			};

			mt6357_debug {
				compatible = "mediatek,mt63xx-debug";
			};

			mt63xx-oc-debug {
				compatible = "mediatek,mt63xx-oc-debug";
			};

			leds-mt6357 {
				compatible = "mediatek,mt6357_leds";

				Isink1 {
					reg = <0x01>;
					label = "white";
					linux,default-trigger = "none";
					default-state = "off";
				};
			};

			mtk_rtc {
				compatible = "mediatek,mt6357-rtc";
				#address-cells = <0x01>;
				#size-cells = <0x01>;
				bootmode = <0x2a>;
				phandle = <0x96>;

				fg_init {
					reg = <0x00 0x01>;
					bits = <0x00 0x08>;
					phandle = <0x2b>;
				};

				fg_soc {
					reg = <0x01 0x01>;
					bits = <0x00 0x08>;
					phandle = <0x2c>;
				};

				ext_32k {
					reg = <0x02 0x01>;
					bits = <0x06 0x01>;
					phandle = <0x97>;
				};
			};

			pmic_codec {
				compatible = "mediatek,mt6357-sound";
				mediatek,pwrap-regmap = <0x2f>;
				nvmem = <0x28>;
				nvmem-names = "pmic-hp-efuse";
				io-channels = <0x27 0x0c 0x27 0x09>;
				io-channel-names = "pmic_codec\0pmic_accdet";
				use_hp_depop_flow = <0x00>;
				use_ul_260k = <0x00>;
				phandle = <0x98>;
			};

			clock_buffer_ctrl {
				compatible = "mediatek,clock_buffer";
				n-clkbuf-pmic-dependent = <0x0a>;
				clkbuf-pmic-dependent = "pmic-drvcurr\0pmic-auxout-sel\0pmic-auxout-xo\0pmic-auxout-drvcurr\0pmic-auxout-bblpm-en\0pmic-cofst-fpm\0pmic-cdac-fpm\0pmic-core-idac-fpm\0pmic-aac-fpm-swen\0pmic-heater-sel";
				pmic-dcxo-cw = <0x788>;
				pmic-xo-mode = <0x788 0x00 0x788 0x03 0x788 0x06 0x788 0x09 0xffff 0xffff 0x7a2 0x08 0x7a2 0x0b>;
				pmic-xo-en = <0x788 0x02 0x788 0x05 0x788 0x08 0x788 0x0b 0xffff 0xffff 0x7a2 0x0a 0x7a2 0x0d>;
				pmic-bblpm-sw = <0x788 0x0c>;
				pmic-srclkeni3 = <0x44a 0x00>;
				n-pmic-drvcurr = <0x07>;
				pmic-drvcurr = <0x7b0 0x00 0x7b0 0x02 0x7b0 0x04 0x7b0 0x06 0xffff 0xffff 0x7b0 0x0a 0x7b0 0x0c>;
				n-pmic-auxout-sel = <0x06>;
				pmic-auxout-sel = <0x7b4 0x00 0x7b4 0x05 0x7b4 0x06 0x7b4 0x07 0x7b4 0x06 0x7b4 0x18>;
				n-pmic-auxout-xo = <0x07>;
				pmic-auxout-xo = <0x7b6 0x00 0x7b6 0x06 0x7b6 0x00 0x7b6 0x06 0xffff 0xffff 0x7b6 0x06 0x7b6 0x0c>;
				n-pmic-auxout-drvcurr = <0x07>;
				pmic-auxout-drvcurr = <0x7b6 0x01 0x7b6 0x07 0x7b6 0x01 0x7b6 0x07 0xffff 0xffff 0x7b6 0x01 0x7b6 0x0c>;
				n-pmic-auxout-bblpm-en = <0x01>;
				pmic-auxout-bblpm-en = <0x7b6 0x00>;
				n-pmic-cofst-fpm = <0x01>;
				pmic-cofst-fpm = <0x796 0x0e>;
				n-pmic-cdac-fpm = <0x01>;
				pmic-cdac-fpm = <0x794 0x00>;
				n-pmic-core-idac-fpm = <0x01>;
				pmic-core-idac-fpm = <0x79a 0x0e>;
				n-pmic-aac-fpm-swen = <0x01>;
				pmic-aac-fpm-swen = <0x79e 0x0e>;
				n-pmic-heater-sel = <0x01>;
				pmic-heater-sel = <0x7b8 0x01>;
				phandle = <0x99>;
			};
		};
	};

	scp@10500000 {
		compatible = "mediatek,scp";
		status = "okay";
		reg = <0x00 0x10500000 0x00 0x40000 0x00 0x105c0000 0x00 0x3000 0x00 0x105c4000 0x00 0x1000 0x00 0x105d4000 0x00 0x6000>;
		interrupts = <0x00 0xc0 0x04>;
		core_1 = "enable";
		scp_sramSize = <0x40000>;
		scp_mpuRegionId = <0x1b>;
		scp_feature_tbl = <0x00 0x2f 0x01 0x164 0x02 0x3e 0x03 0x2f 0x04 0x1a 0x05 0x00 0x06 0xc8 0x07 0x00 0x08 0x64 0x09 0x0a>;
		scp_mem_key = "mediatek,reserve-memory-scp_share";
		scp_mem_tbl = <0x01 0x100000 0x04 0x200000>;
	};

	scp_dvfs {
		compatible = "mediatek,scp_dvfs";
		clocks = <0x26 0x63 0x24 0x26 0x0e 0x26 0x1a 0x26 0x02 0x26 0x17 0x26 0x06 0x26 0x19>;
		clock-names = "clk_mux\0clk_pll_0\0clk_pll_1\0clk_pll_2\0clk_pll_3\0clk_pll_4\0clk_pll_5\0clk_pll_6";
		dvfsrc-opp-num = <0x03>;
		dvfs-opp = <0xff 0xff 0xff 0x00 0x00 0xfa 0x00 0xff 0xff 0xff 0x00 0x00 0x111 0x03 0xff 0xff 0xff 0x02 0x08 0x14a 0x05 0xff 0xff 0xff 0x03 0x0c 0x1a0 0x06>;
		pmic = <0x30>;
		pmic-feature = "pmic-vow-lp\0pmic-pmrc";
		pmic-feature-cfg = <0x00 0x00>;
		gpio = <0x17 0x01>;
		gpio-feature = "gpio-mode";
		gpio-feature-cfg = <0x00>;
	};

	sleep_reg_md@1000f000 {
		compatible = "mediatek,sleep_reg_md";
		reg = <0x00 0x1000f000 0x00 0x1000>;
	};

	kp@10010000 {
		compatible = "mediatek,kp";
		reg = <0x00 0x10010000 0x00 0x1000>;
		interrupts = <0x00 0xb4 0x02>;
		clocks = <0x24>;
		clock-names = "kpd";
		phandle = <0x20>;
	};

	otg_iddig {
		compatible = "mediatek,usb_iddig_bi_eint";
		phandle = <0x9a>;
	};

	mrdump_ext_rst {
		compatible = "mediatek, mrdump_ext_rst-eint";
		force_mode = "EINT";
		mode = "IRQ";
		status = "okay";
		phandle = <0x9b>;
	};

	touch {
		compatible = "mediatek,touch";
		phandle = <0x9c>;
	};

	accdet {
		compatible = "mediatek,pmic-accdet";
		phandle = <0x9d>;
	};

	usb_cable {
		compatible = "mediatek,usb_cable_eint";
		phandle = <0x9e>;
	};

	fingerprint {
		compatible = "mediatek,goodix-fp";
		phandle = <0x9f>;
	};

	fingerprint_pinctrl {
		compatible = "mediatek,fingerprint-pinctrl";
		phandle = <0xa0>;
	};

	fps_fpc_eint {
		compatible = "mediatek,fpc-eint";
		interrupt-parent = <0x1f>;
		interrupts = <0x05 0x00 0x05 0x00>;
		debounce = <0x05 0x00>;
		fpc,gpio-irq = <0x1f 0x05 0x00>;
		fpc,gpio-power = <0x1f 0xaa 0x00>;
		status = "okay";
		phandle = <0xa1>;
	};

	fps_egis_eint {
		compatible = "mediatek,egis-eint";
		interrupt-parent = <0x1f>;
		interrupts = <0x05 0x00 0x05 0x00>;
		fp-ctrl-power;
		fp-gpio-vcc-enable;
		egistec,gpio_vcc_en = <0x1f 0xaa 0x00>;
		egistec,gpio_reset = <0x1f 0x16 0x00>;
		egistec,gpio_irq = <0x1f 0x05 0x00>;
		status = "okay";
		phandle = <0xa2>;
	};

	topmisc@10011000 {
		compatible = "mediatek,topmisc";
		reg = <0x00 0x10011000 0x00 0x1000>;
	};

	dvfsrc@10012000 {
		compatible = "mediatek,mt6765-dvfsrc";
		reg = <0x00 0x10012000 0x00 0x1000 0x00 0x10006000 0x00 0x1000>;
		reg-names = "dvfsrc\0spm";
		#address-cells = <0x02>;
		#size-cells = <0x02>;
		ranges;
		phandle = <0xa3>;

		opp2 {
			opp-level = <0x02>;
			phandle = <0x33>;
		};

		opp1 {
			opp-level = <0x01>;
			phandle = <0x32>;
		};

		opp0 {
			opp-level = <0x00>;
			phandle = <0x31>;
		};

		dvfsrc-up {
			compatible = "mediatek,mt6765-dvfsrc-up";
		};

		dvfsrc-debug {
			compatible = "mediatek,mt6765-dvfsrc-debug";
			required-opps = <0x31 0x32 0x33>;
		};

		dvfsrc-met {
			compatible = "mediatek,mt6765-dvfsrc-met";
		};

		qos@00110b80 {
			compatible = "mediatek,mt6765-qos";
			reg = <0x00 0x110b80 0x00 0x80>;
		};
	};

	mbist_ao@10013000 {
		compatible = "mediatek,mbist_ao";
		reg = <0x00 0x10013000 0x00 0x1000>;
	};

	apcldmain_ao@10014000 {
		compatible = "mediatek,apcldmain_ao";
		reg = <0x00 0x10014000 0x00 0x400>;
	};

	apcldmaout_ao@10014400 {
		compatible = "mediatek,apcldmaout_ao";
		reg = <0x00 0x10014400 0x00 0x400>;
	};

	apcldmamisc_ao@10014800 {
		compatible = "mediatek,apcldmamisc_ao";
		reg = <0x00 0x10014800 0x00 0x400>;
	};

	ddrphy@10015000 {
		compatible = "mediatek,ddrphy";
		reg = <0x00 0x10015000 0x00 0x1000>;
	};

	aes_top0@10016000 {
		compatible = "mediatek,aes_top0";
		reg = <0x00 0x10016000 0x00 0x1000>;
	};

	timer@10017000 {
		compatible = "mediatek,sys_timer\0mediatek,mt6761-timer\0mediatek,mt6765-timer";
		reg = <0x00 0x10017000 0x00 0x1000>;
		reg-names = "sys_timer_base";
		interrupts = <0x00 0xc2 0x04>;
		clocks = <0x34>;
		phandle = <0xa4>;
	};

	modem_temp_share@10018000 {
		compatible = "mediatek,modem_temp_share";
		reg = <0x00 0x10018000 0x00 0x1000>;
	};

	security_ao@1001a000 {
		compatible = "mediatek,security_ao";
		reg = <0x00 0x1001a000 0x00 0x1000>;
	};

	topckgen_ao@1001b000 {
		compatible = "mediatek,topckgen_ao";
		reg = <0x00 0x1001b000 0x00 0x1000>;
	};

	dramc0@1001d000 {
		compatible = "mediatek,dramc0";
		reg = <0x00 0x1001d000 0x00 0x1000>;
	};

	ddrphy@1001e000 {
		compatible = "mediatek,ddrphy";
		reg = <0x00 0x1001e000 0x00 0x1000>;
	};

	mdcldmain_ao@10015000 {
		compatible = "mediatek,mdcldmain_ao";
		reg = <0x00 0x10015000 0x00 0x400>;
	};

	mdcldmaout_ao@10015400 {
		compatible = "mediatek,mdcldmaout_ao";
		reg = <0x00 0x10015400 0x00 0x400>;
	};

	mdcldmamisc_ao@10015800 {
		compatible = "mediatek,mdcldmamisc_ao";
		reg = <0x00 0x10015800 0x00 0x400>;
	};

	sys_cirq@10204000 {
		compatible = "mediatek,sys_cirq";
		reg = <0x00 0x10204000 0x00 0x1000>;
		mediatek,cirq_num = <0xd1>;
		mediatek,spi_start_offset = <0x48>;
		interrupts = <0x00 0x118 0x08>;
	};

	mcucfg@10200000 {
		compatible = "mediatek,mcucfg";
		reg = <0x00 0x10200000 0x00 0x1000>;
		interrupts = <0x00 0x00 0x08>;
	};

	mcucfg_mp0_counter@10200000 {
		compatible = "mediatek,mcucfg_mp0_counter";
		reg = <0x00 0x10200000 0x00 0x4000>;
	};

	m4u@10205000 {
		cell-index = <0x00>;
		compatible = "mediatek,m4u";
		reg = <0x00 0x10205000 0x00 0x1000>;
		interrupts = <0x00 0x9e 0x08>;
	};

	devapc@10207000 {
		compatible = "mediatek,devapc";
		reg = <0x00 0x10207000 0x00 0x1000>;
		interrupts = <0x00 0x8e 0x08>;
		clocks = <0x25 0x28>;
		clock-names = "devapc-infra-clock";
	};

	bus_dbg@10208000 {
		compatible = "mediatek,bus_dbg-v2";
		reg = <0x00 0x10208000 0x00 0x1000 0x00 0x10001000 0x00 0x1000>;
		mediatek,bus_dbg_con_offset = <0x2fc>;
		interrupts = <0x00 0x8d 0x08>;
	};

	ap_ccif0@10209000 {
		compatible = "mediatek,ap_ccif0";
		reg = <0x00 0x10209000 0x00 0x1000>;
		interrupts = <0x00 0x94 0x08>;
	};

	md_ccif0@1020a000 {
		compatible = "mediatek,md_ccif0";
		reg = <0x00 0x1020a000 0x00 0x1000>;
	};

	ap_ccif1@1020b000 {
		compatible = "mediatek,ap_ccif1";
		reg = <0x00 0x1020b000 0x00 0x1000>;
		interrupts = <0x00 0x96 0x08>;
	};

	md_ccif1@1020c000 {
		compatible = "mediatek,md_ccif1";
		reg = <0x00 0x1020c000 0x00 0x1000>;
	};

	infra_mbist@1020d000 {
		compatible = "mediatek,infra_mbist";
		reg = <0x00 0x1020d000 0x00 0x1000>;
	};

	infracfg@1020e000 {
		compatible = "mediatek,infracfg";
		reg = <0x00 0x1020e000 0x00 0x1000>;
	};

	trng@1020f000 {
		compatible = "mediatek,trng";
		reg = <0x00 0x1020f000 0x00 0x1000>;
		interrupts = <0x00 0xa1 0x08>;
	};

	dxcc_sec@10210000 {
		compatible = "mediatek,dxcc_sec";
		reg = <0x00 0x10210000 0x00 0x1000>;
		interrupts = <0x00 0xa2 0x04>;
	};

	mcupm_sram2@10211000 {
		compatible = "mediatek,mcupm_sram2";
		reg = <0x00 0x10211000 0x00 0x1000>;
	};

	cq_dma@10212000 {
		compatible = "mediatek,mt-cqdma-v1";
		reg = <0x00 0x10212000 0x00 0x80 0x00 0x10212080 0x00 0x80>;
		interrupts = <0x00 0x71 0x08 0x00 0x72 0x08>;
		nr_channel = <0x02>;
		keep_clock_ao = "yes";
		clocks = <0x25 0x43>;
		clock-names = "cqdma";
	};

	mcupm_sram3@10213000 {
		compatible = "mediatek,mcupm_sram3";
		reg = <0x00 0x10213000 0x00 0x1000>;
	};

	sramrom@10214000 {
		compatible = "mediatek,sramrom";
		reg = <0x00 0x10214000 0x00 0x1000>;
	};

	mcupm_reg@10216000 {
		compatible = "mediatek,mcupm_reg";
		reg = <0x00 0x10216000 0x00 0x1000>;
	};

	mcupm_sram0@10217000 {
		compatible = "mediatek,mcupm_sram0";
		reg = <0x00 0x10217000 0x00 0x1000>;
	};

	mcupm_sram1@10218000 {
		compatible = "mediatek,mcupm_sram1";
		reg = <0x00 0x10218000 0x00 0x1000>;
	};

	emi@10219000 {
		compatible = "mediatek,emi";
		reg = <0x00 0x10219000 0x00 0x1000 0x00 0x10226000 0x00 0x1000 0x00 0x1022d000 0x00 0x1000 0x00 0x10235000 0x00 0x1000>;
		interrupts = <0x00 0x90 0x08>;
	};

	apcldmain@1021b000 {
		compatible = "mediatek,apcldmain";
		reg = <0x00 0x1021b000 0x00 0x00>;
	};

	apcldmaout@1021b400 {
		compatible = "mediatek,apcldmaout";
		reg = <0x00 0x1021b400 0x00 0x00>;
	};

	apcldmamisc@1021b800 {
		compatible = "mediatek,apcldmamisc";
		reg = <0x00 0x1021b800 0x00 0x00>;
		interrupts = <0x00 0xa5 0x04>;
	};

	mdcldmain@1021c000 {
		compatible = "mediatek,mdcldmain";
		reg = <0x00 0x1021c000 0x00 0x400>;
	};

	mdcldmaout@1021c400 {
		compatible = "mediatek,mdcldmaout";
		reg = <0x00 0x1021c400 0x00 0x400>;
	};

	mdcldmamisc@1021c800 {
		compatible = "mediatek,mdcldmamisc";
		reg = <0x00 0x1021c800 0x00 0x1000>;
	};

	ccifdriver@10209000 {
		compatible = "mediatek,ccci_ccif";
		reg = <0x00 0x10209000 0x00 0x1000 0x00 0x1020a000 0x00 0x1000>;
		mediatek,sram_size = <0x200>;
		interrupts = <0x00 0x94 0x08 0x00 0x95 0x08>;
		clocks = <0x25 0x29 0x25 0x2c 0x25 0x23 0x25 0x24 0x25 0x51 0x25 0x52>;
		clock-names = "infra-ccif-ap\0infra-ccif-md\0infra-ccif1-ap\0infra-ccif1-md\0infra-ccif2-ap\0infra-ccif2-md";
		phandle = <0xa5>;
	};

	cldmadriver@10014000 {
		compatible = "mediatek,ccci_cldma";
		reg = <0x00 0x10014000 0x00 0x1000 0x00 0x1021b000 0x00 0x1000>;
		interrupts = <0x00 0xa5 0x04>;
		mediatek,cldma_capability = <0x06>;
		mediatek,md_generation = <0x1895>;
		mediatek,platform = <0x1a6d>;
		clocks = <0x25 0x32>;
		clock-names = "infra-cldma-bclk";
		cldma-infracfg = <0x25>;
		phandle = <0xa6>;
	};

	mddriver@10014000 {
		compatible = "mediatek,mddriver\0mediatek,mddriver-mt6765";
		reg = <0x00 0x10014000 0x00 0x1000 0x00 0x1021b000 0x00 0x1000 0x00 0x10209000 0x00 0x1000 0x00 0x1020a000 0x00 0x1000>;
		interrupts = <0x00 0xa5 0x04 0x00 0x94 0x08 0x00 0x95 0x08 0x00 0x105 0x02>;
		mediatek,mdhif_type = <0x03>;
		mediatek,md_id = <0x00>;
		mediatek,ap_plat_info = <0x1a6d>;
		mediatek,md_generation = <0x1895>;
		mediatek,offset_apon_md1 = <0x1c24>;
		mediatek,cldma_capability = <0x06>;
		clocks = <0x35 0x00 0x25 0x32 0x25 0x29 0x25 0x2c 0x25 0x23 0x25 0x24 0x25 0x51 0x25 0x52>;
		clock-names = "scp-sys-md1-main\0infra-cldma-bclk\0infra-ccif-ap\0infra-ccif-md\0infra-ccif1-ap\0infra-ccif1-md\0infra-ccif2-ap\0infra-ccif2-md";
		_vmodem-supply = <0x36>;
		_vcore-supply = <0x37>;
		ccci-infracfg = <0x25>;
		phandle = <0x22>;
	};

	md_auxadc {
		compatible = "mediatek,md_auxadc";
		io-channels = <0x38 0x02>;
		io-channel-names = "md-channel\0md-battery";
		phandle = <0xa7>;
	};

	dramc_nao@1021d000 {
		compatible = "mediatek,dramc_nao";
		reg = <0x00 0x1021d000 0x00 0x1000>;
	};

	bpi_bsi_slv0@1021e000 {
		compatible = "mediatek,bpi_bsi_slv0";
		reg = <0x00 0x1021e000 0x00 0x1000>;
	};

	bpi_bsi_slv1@1021f000 {
		compatible = "mediatek,bpi_bsi_slv1";
		reg = <0x00 0x1021f000 0x00 0x6000>;
	};

	bpi_bsi_slv2@10225000 {
		compatible = "mediatek,bpi_bsi_slv2";
		reg = <0x00 0x10225000 0x00 0x1000>;
	};

	dvfsp@10227000 {
		compatible = "mediatek,dvfsp";
		reg = <0x00 0x10227000 0x00 0x1000>;
	};

	dvfsp@00110c00 {
		compatible = "mediatek,mt6765-dvfsp";
		reg = <0x00 0x110c00 0x00 0x1400 0x00 0x110c00 0x00 0x1400>;
		state = <0x01>;
		change_flag = <0x00>;
		little-rise-time = <0x3e8>;
		little-down-time = <0x2ee>;
		big-rise-time = <0x3e8>;
		big-down-time = <0x2ee>;
		nvmem-cells = <0x39 0x3a>;
		nvmem-cell-names = "efuse_segment_cell\0efuse_ly_cell";
		L-table = <0x7d0 0x60 0x01 0x01 0x78d 0x5c 0x01 0x01 0x74a 0x58 0x01 0x01 0x708 0x53 0x01 0x01 0x6c5 0x50 0x01 0x01 0x682 0x4b 0x01 0x01 0x60c 0x47 0x01 0x01 0x5c3 0x42 0x02 0x01 0x55f 0x40 0x02 0x01 0x4fb 0x3a 0x02 0x01 0x497 0x36 0x02 0x01 0x433 0x31 0x02 0x01 0x3e7 0x2e 0x02 0x01 0x39d 0x2b 0x02 0x01 0x352 0x28 0x02 0x01 0x306 0x26 0x02 0x01>;
		B-table = <0x898 0x64 0x01 0x01 0x855 0x60 0x01 0x01 0x812 0x5c 0x01 0x01 0x7d0 0x58 0x01 0x01 0x78d 0x54 0x01 0x01 0x74a 0x50 0x01 0x01 0x708 0x4b 0x01 0x01 0x673 0x46 0x01 0x01 0x5df 0x40 0x01 0x01 0x586 0x3d 0x02 0x01 0x50f 0x39 0x02 0x01 0x498 0x35 0x02 0x01 0x43f 0x31 0x02 0x01 0x3e6 0x2e 0x02 0x01 0x38d 0x2b 0x02 0x01 0x352 0x28 0x02 0x01>;
		CCI-table = <0x578 0x60 0x02 0x01 0x549 0x5c 0x02 0x01 0x51a 0x58 0x02 0x01 0x4ec 0x54 0x02 0x01 0x4a6 0x4e 0x02 0x01 0x483 0x4b 0x02 0x01 0x460 0x47 0x02 0x01 0x3d8 0x40 0x02 0x01 0x395 0x3e 0x02 0x01 0x33b 0x3a 0x02 0x01 0x2e1 0x36 0x02 0x02 0x29d 0x33 0x02 0x02 0x243 0x2f 0x02 0x02 0x200 0x2c 0x02 0x02 0x1bd 0x29 0x02 0x02 0x190 0x26 0x02 0x02>;
	};

	eem_fsm@1100b000 {
		compatible = "mediatek,eem_fsm";
		reg = <0x00 0x1100b000 0x00 0x1000>;
		interrupts = <0x00 0x7d 0x08>;
		nvmem = <0x3b>;
		nvmem-names = "mtk_efuse";
		nvmem-cells = <0x39>;
		nvmem-cell-names = "efuse_segment_cell";
	};

	dramc@1022a000 {
		compatible = "mediatek,dramc";
		reg = <0x00 0x1022a000 0x00 0x2000 0x00 0x10232000 0x00 0x2000 0x00 0x1022c000 0x00 0x1000 0x00 0x10234000 0x00 0x1000 0x00 0x10228000 0x00 0x2000 0x00 0x10230000 0x00 0x2000 0x00 0x1022e000 0x00 0x1000 0x00 0x10236000 0x00 0x1000>;
	};

	gce@10238000 {
		compatible = "mediatek,gce\0syscon";
		reg = <0x00 0x10238000 0x00 0x4000>;
		interrupts = <0x00 0x9a 0x08 0x00 0x9b 0x08>;
		g3d_config_base = <0x13000000 0x00 0xffff0000>;
		mmsys_config_base = <0x14000000 0x01 0xffff0000>;
		disp_dither_base = <0x14010000 0x02 0xffff0000>;
		mm_na_base = <0x14020000 0x03 0xffff0000>;
		imgsys_base = <0x15020000 0x04 0xffff0000>;
		vdec_gcon_base = <0x18800000 0x05 0xffff0000>;
		venc_gcon_base = <0x18810000 0x06 0xffff0000>;
		conn_peri_base = <0x18820000 0x07 0xffff0000>;
		topckgen_base = <0x18830000 0x08 0xffff0000>;
		kp_base = <0x18840000 0x09 0xffff0000>;
		scp_sram_base = <0x10000000 0x0a 0xffff0000>;
		infra_na3_base = <0x10010000 0x0b 0xffff0000>;
		infra_na4_base = <0x10020000 0x0c 0xffff0000>;
		scp_base = <0x10030000 0x0d 0xffff0000>;
		mcucfg_base = <0x10040000 0x0e 0xffff0000>;
		gcpu_base = <0x10050000 0x0f 0xffff0000>;
		usb0_base = <0x10200000 0x10 0xffff0000>;
		usb_sif_base = <0x10280000 0x11 0xffff0000>;
		audio_base = <0x17000000 0x12 0xffff0000>;
		vdec_base = <0x17010000 0x13 0xffff0000>;
		msdc2_base = <0x17020000 0x14 0xffff0000>;
		vdec1_base = <0x17030000 0x15 0xffff0000>;
		msdc3_base = <0x18000000 0x16 0xffff0000>;
		ap_dma_base = <0x18010000 0x17 0xffff0000>;
		gce_base = <0x18020000 0x18 0xffff0000>;
		vdec2_base = <0x18040000 0x19 0xffff0000>;
		vdec3_base = <0x18050000 0x1a 0xffff0000>;
		camsys_base = <0x18080000 0x1b 0xffff0000>;
		camsys1_base = <0x180a0000 0x1c 0xffff0000>;
		camsys2_base = <0x180b0000 0x1d 0xffff0000>;
		pwm_sw_base = <0x1100e000 0x63 0xffff0000>;
		mipitx0_base = <0x11c80000 0x63 0xffff0000>;
		mdp_rdma0_sof = <0x00>;
		mdp_ccorr0_sof = <0x01>;
		mdp_rsz0_sof = <0x02>;
		mdp_rsz1_sof = <0x03>;
		mdp_wdma_sof = <0x04>;
		mdp_wrot0_sof = <0x05>;
		mdp_tdshp0_sof = <0x06>;
		disp_ovl0_sof = <0x07>;
		disp_2l_ovl0_sof = <0x08>;
		disp_rdma0_sof = <0x09>;
		disp_wdma0_sof = <0x0a>;
		disp_color0_sof = <0x0b>;
		disp_ccorr0_sof = <0x0c>;
		disp_aal0_sof = <0x0d>;
		disp_gamma0_sof = <0x0e>;
		disp_dither0_sof = <0x0f>;
		disp_dsi0_sof = <0x10>;
		disp_rsz0_sof = <0x11>;
		img_dl_relay_sof = <0x12>;
		disp_pwm0_sof = <0x13>;
		mdp_rdma0_frame_done = <0x14>;
		mdp_ccorr0_frame_done = <0x15>;
		mdp_rsz0_frame_done = <0x16>;
		mdp_rsz1_frame_done = <0x17>;
		mdp_wrot0_write_frame_done = <0x18>;
		mdp_wdma_frame_done = <0x19>;
		mdp_tdshp0_frame_done = <0x1a>;
		disp_ovl0_frame_done = <0x1b>;
		disp_2l_ovl0_frame_done = <0x1c>;
		disp_rsz0_frame_done = <0x1d>;
		disp_rdma0_frame_done = <0x1e>;
		disp_wdma0_frame_done = <0x1f>;
		disp_color0_frame_done = <0x20>;
		disp_ccorr0_frame_done = <0x21>;
		disp_aal0_frame_done = <0x22>;
		disp_gamma0_frame_done = <0x23>;
		disp_dither0_frame_done = <0x24>;
		disp_dsi0_frame_done = <0x25>;
		stream_done_0 = <0x82>;
		stream_done_1 = <0x83>;
		stream_done_2 = <0x84>;
		stream_done_3 = <0x85>;
		stream_done_4 = <0x86>;
		stream_done_5 = <0x87>;
		stream_done_6 = <0x88>;
		stream_done_7 = <0x89>;
		stream_done_8 = <0x8a>;
		stream_done_9 = <0x8b>;
		buf_underrun_event_0 = <0x8c>;
		dsi0_te_event = <0x8d>;
		dsi0_irq_event = <0x8e>;
		dsi0_done_event = <0x8f>;
		disp_wdma0_rst_done = <0x93>;
		mdp_wdma_rst_done = <0x94>;
		mdp_wrot0_rst_done = <0x95>;
		mdp_rdma0_rst_done = <0x97>;
		disp_ovl0_frame_rst_done_pusle = <0x98>;
		dip_cq_thread0_frame_done = <0x101>;
		dip_cq_thread1_frame_done = <0x102>;
		dip_cq_thread2_frame_done = <0x103>;
		dip_cq_thread3_frame_done = <0x104>;
		dip_cq_thread4_frame_done = <0x105>;
		dip_cq_thread5_frame_done = <0x106>;
		dip_cq_thread6_frame_done = <0x107>;
		dip_cq_thread7_frame_done = <0x108>;
		dip_cq_thread8_frame_done = <0x109>;
		dip_cq_thread9_frame_done = <0x10a>;
		dip_cq_thread10_frame_done = <0x10b>;
		dip_cq_thread11_frame_done = <0x10c>;
		dip_cq_thread12_frame_done = <0x10d>;
		dip_cq_thread13_frame_done = <0x10e>;
		dip_cq_thread14_frame_done = <0x10f>;
		dip_cq_thread15_frame_done = <0x110>;
		dip_cq_thread16_frame_done = <0x111>;
		dip_cq_thread17_frame_done = <0x112>;
		dip_cq_thread18_frame_done = <0x113>;
		dve_frame_done = <0x114>;
		wmf_frame_done = <0x115>;
		rsc_frame_done = <0x116>;
		venc_done = <0x121>;
		jpgenc_done = <0x122>;
		jpgdec_done = <0x123>;
		venc_mb_done = <0x124>;
		venc_128byte_cnt_done = <0x125>;
		max_prefetch_cnt = <0x01>;
		prefetch_size = <0x60>;
		sram_size_cpr_64 = <0x40>;
		mmsys_config = <0x3c>;
		mdp_rdma0 = <0x3d>;
		mdp_rsz0 = <0x3e>;
		mdp_rsz1 = <0x3f>;
		mdp_wdma0 = <0x40>;
		mdp_wrot0 = <0x41>;
		mdp_tdshp0 = <0x42>;
		mdp_color0 = <0x43>;
		mdp_ccorr0 = <0x44>;
		mm_mutex = <0x45>;
		sram_share_cnt = <0x01>;
		sram_share_engine = <0x0a>;
		sram_share_event = <0x2c6>;
		clocks = <0x25 0x09 0x25 0x18>;
		clock-names = "GCE\0GCE_TIMER";
		mediatek,mailbox-gce = <0x46>;
		mboxes = <0x46 0x00 0x00 0x04 0x46 0x01 0x00 0x04 0x46 0x02 0x00 0x05 0x46 0x03 0x00 0x04 0x46 0x04 0x00 0x04 0x46 0x05 0x00 0x04 0x46 0x06 0x00 0x04 0x46 0x07 0xffffffff 0x02 0x47 0x08 0x00 0x04 0x47 0x09 0x00 0x04 0x47 0x0a 0x00 0x01 0x46 0x0b 0x00 0x01 0x46 0x0c 0x00 0x01 0x46 0x0d 0x00 0x01 0x46 0x0e 0x00 0x01 0x46 0x0f 0xffffffff 0x01>;
		phandle = <0xa8>;
	};

	gce_mbox@10238000 {
		compatible = "mediatek,mt6761-gce";
		reg = <0x00 0x10238000 0x00 0x4000>;
		interrupts = <0x00 0x9a 0x08 0x00 0x9b 0x08>;
		#mbox-cells = <0x03>;
		#gce-event-cells = <0x01>;
		#gce-subsys-cells = <0x02>;
		default_tokens = [02 bc 02 bd 02 be 02 bf 02 c0 02 c6 02 c7];
		clocks = <0x25 0x09 0x25 0x18>;
		clock-names = "gce\0gce-timer";
		phandle = <0x46>;
	};

	gce_mbox_svp@10238000 {
		compatible = "mediatek,mailbox-gce-svp";
		reg = <0x00 0x10238000 0x00 0x4000>;
		interrupts = <0x00 0x9a 0x08 0x00 0x9b 0x08>;
		#mbox-cells = <0x03>;
		clocks = <0x25 0x09 0x25 0x18>;
		clock-names = "gce\0GCE_TIMER";
		phandle = <0x47>;
	};

	ap_ccif2@1023c000 {
		compatible = "mediatek,ap_ccif2";
		reg = <0x00 0x1023c000 0x00 0x1000>;
		interrupts = <0x00 0x8f 0x08>;
	};

	md_ccif2@1023d000 {
		compatible = "mediatek,md_ccif2";
		reg = <0x00 0x1023d000 0x00 0x1000>;
	};

	ap_ccif3@1023e000 {
		compatible = "mediatek,ap_ccif3";
		reg = <0x00 0x1023e000 0x00 0x1000>;
		interrupts = <0x00 0x92 0x08>;
	};

	md_ccif3@1023f000 {
		compatible = "mediatek,md_ccif3";
		reg = <0x00 0x1023f000 0x00 0x1000>;
	};

	sspm@10440000 {
		compatible = "mediatek,mt6765-sspm";
		reg = <0x00 0x10440000 0x00 0x10000 0x00 0x10450000 0x00 0x100 0x00 0x10451000 0x00 0x08 0x00 0x10460000 0x00 0x100 0x00 0x10461000 0x00 0x08 0x00 0x10470000 0x00 0x100 0x00 0x10471000 0x00 0x08 0x00 0x10480000 0x00 0x100 0x00 0x10481000 0x00 0x08 0x00 0x10490000 0x00 0x100 0x00 0x10491000 0x00 0x08>;
		reg-names = "cfgreg\0mbox0_base\0mbox0_ctrl\0mbox1_base\0mbox1_ctrl\0mbox2_base\0mbox2_ctrl\0mbox3_base\0mbox3_ctrl\0mbox4_base\0mbox4_ctrl";
		interrupts = <0x00 0xca 0x04 0x00 0xcd 0x04 0x00 0xce 0x04 0x00 0xcf 0x04 0x00 0xd0 0x04 0x00 0xd1 0x04>;
		interrupt-names = "ipc\0mbox0\0mbox1\0mbox2\0mbox3\0mbox4";
	};

	gic500@0c000000 {
		compatible = "mediatek,gic500";
		reg = <0x00 0xc000000 0x00 0x1000>;
	};

	gic_cpu@0c400000 {
		compatible = "mediatek,gic_cpu";
		reg = <0x00 0xc400000 0x00 0x40000>;
	};

	dfd@10200b00 {
		compatible = "mediatek,dfd";
		reg = <0x00 0x10200b00 0x00 0x10000>;
		mediatek,enabled = <0x01>;
		mediatek,chain_length = <0xc350>;
		mediatek,rg_dfd_timeout = <0xa0>;
		mediatek,check_dfd_support = <0x01>;
		mediatek,dfd_infra_base = <0x390>;
		mediatek,dfd_ap_addr_offset = <0x18>;
		mediatek,dfd_latch_offset = <0x48>;
		reg_base = <0x48>;
	};

	dbg_cti@0d020000 {
		compatible = "mediatek,dbg_cti";
		reg = <0x00 0xd020000 0x00 0x10000>;
	};

	dbg_etr@0d030000 {
		compatible = "mediatek,dbg_etr";
		reg = <0x00 0xd030000 0x00 0x10000>;
	};

	dbg_funnel@0d040000 {
		compatible = "mediatek,dbg_funnel";
		reg = <0x00 0xd040000 0x00 0x10000>;
	};

	dbg_dem@0d0a0000 {
		compatible = "mediatek,dbg_dem";
		reg = <0x00 0xd0a0000 0x00 0x10000>;
		interrupts = <0x00 0x8c 0x08>;
	};

	dbg_mdsys1@0d0c0000 {
		compatible = "mediatek,dbg_mdsys1";
		reg = <0x00 0xd0c0000 0x00 0x40000>;
	};

	dbg_apmcu_mp0@0d400000 {
		compatible = "mediatek,dbg_apmcu_mp0";
		reg = <0x00 0xd400000 0x00 0x1000>;
	};

	dbg_apmcu_mp0@0d410000 {
		compatible = "mediatek,dbg_apmcu_mp0";
		reg = <0x00 0xd410000 0x00 0x1000>;
	};

	dbg_apmcu_mp0@0d420000 {
		compatible = "mediatek,dbg_apmcu_mp0";
		reg = <0x00 0xd420000 0x00 0x1000>;
	};

	dbg_apmcu_mp0@0d430000 {
		compatible = "mediatek,dbg_apmcu_mp0";
		reg = <0x00 0xd430000 0x00 0x1000>;
	};

	dbg_apmcu_mp0@0d440000 {
		compatible = "mediatek,dbg_apmcu_mp0";
		reg = <0x00 0xd440000 0x00 0x1000>;
	};

	dbg_apmcu_mp0@0d510000 {
		compatible = "mediatek,dbg_apmcu_mp0";
		reg = <0x00 0xd510000 0x00 0x1000>;
	};

	dbg_apmcu_mp0@0d520000 {
		compatible = "mediatek,dbg_apmcu_mp0";
		reg = <0x00 0xd520000 0x00 0x1000>;
	};

	dbg_apmcu_mp0@0d530000 {
		compatible = "mediatek,dbg_apmcu_mp0";
		reg = <0x00 0xd530000 0x00 0x1000>;
	};

	dbg_apmcu_mp0@0d540000 {
		compatible = "mediatek,dbg_apmcu_mp0";
		reg = <0x00 0xd540000 0x00 0x1000>;
	};

	dbg_apmcu_mp0@0d610000 {
		compatible = "mediatek,dbg_apmcu_mp0";
		reg = <0x00 0xd610000 0x00 0x1000>;
	};

	dbg_apmcu_mp0@0d620000 {
		compatible = "mediatek,dbg_apmcu_mp0";
		reg = <0x00 0xd620000 0x00 0x1000>;
	};

	dbg_apmcu_mp0@0d630000 {
		compatible = "mediatek,dbg_apmcu_mp0";
		reg = <0x00 0xd630000 0x00 0x1000>;
	};

	dbg_apmcu_mp0@0d640000 {
		compatible = "mediatek,dbg_apmcu_mp0";
		reg = <0x00 0xd640000 0x00 0x1000>;
	};

	dbg_apmcu_mp0@0d710000 {
		compatible = "mediatek,dbg_apmcu_mp0";
		reg = <0x00 0xd710000 0x00 0x1000>;
	};

	dbg_apmcu_mp0@0d720000 {
		compatible = "mediatek,dbg_apmcu_mp0";
		reg = <0x00 0xd720000 0x00 0x1000>;
	};

	dbg_apmcu_mp0@0d730000 {
		compatible = "mediatek,dbg_apmcu_mp0";
		reg = <0x00 0xd730000 0x00 0x1000>;
	};

	dbg_apmcu_mp0@0d740000 {
		compatible = "mediatek,dbg_apmcu_mp0";
		reg = <0x00 0xd740000 0x00 0x1000>;
	};

	dbg_apmcu_mp1@0d800000 {
		compatible = "mediatek,dbg_apmcu_mp1";
		reg = <0x00 0xd800000 0x00 0x1000>;
	};

	dbg_apmcu_mp1@0d810000 {
		compatible = "mediatek,dbg_apmcu_mp1";
		reg = <0x00 0xd810000 0x00 0x1000>;
	};

	dbg_apmcu_mp1@0d820000 {
		compatible = "mediatek,dbg_apmcu_mp1";
		reg = <0x00 0xd820000 0x00 0x1000>;
	};

	dbg_apmcu_mp1@0d830000 {
		compatible = "mediatek,dbg_apmcu_mp1";
		reg = <0x00 0xd830000 0x00 0x1000>;
	};

	dbg_apmcu_mp1@0d840000 {
		compatible = "mediatek,dbg_apmcu_mp1";
		reg = <0x00 0xd840000 0x00 0x1000>;
	};

	dbg_apmcu_mp1@0d910000 {
		compatible = "mediatek,dbg_apmcu_mp1";
		reg = <0x00 0xd910000 0x00 0x1000>;
	};

	dbg_apmcu_mp1@0d920000 {
		compatible = "mediatek,dbg_apmcu_mp1";
		reg = <0x00 0xd920000 0x00 0x1000>;
	};

	dbg_apmcu_mp1@0d930000 {
		compatible = "mediatek,dbg_apmcu_mp1";
		reg = <0x00 0xd930000 0x00 0x1000>;
	};

	dbg_apmcu_mp1@0d940000 {
		compatible = "mediatek,dbg_apmcu_mp1";
		reg = <0x00 0xd940000 0x00 0x1000>;
	};

	dbg_apmcu_mp1@0da10000 {
		compatible = "mediatek,dbg_apmcu_mp1";
		reg = <0x00 0xda10000 0x00 0x1000>;
	};

	dbg_apmcu_mp1@0da20000 {
		compatible = "mediatek,dbg_apmcu_mp1";
		reg = <0x00 0xda20000 0x00 0x1000>;
	};

	dbg_apmcu_mp1@0da30000 {
		compatible = "mediatek,dbg_apmcu_mp1";
		reg = <0x00 0xda30000 0x00 0x1000>;
	};

	dbg_apmcu_mp1@0da40000 {
		compatible = "mediatek,dbg_apmcu_mp1";
		reg = <0x00 0xda40000 0x00 0x1000>;
	};

	dbg_apmcu_mp1@0db10000 {
		compatible = "mediatek,dbg_apmcu_mp1";
		reg = <0x00 0xdb10000 0x00 0x1000>;
	};

	dbg_apmcu_mp1@0db20000 {
		compatible = "mediatek,dbg_apmcu_mp1";
		reg = <0x00 0xdb20000 0x00 0x1000>;
	};

	dbg_apmcu_mp1@0db30000 {
		compatible = "mediatek,dbg_apmcu_mp1";
		reg = <0x00 0xdb30000 0x00 0x1000>;
	};

	dbg_apmcu_mp1@0db40000 {
		compatible = "mediatek,dbg_apmcu_mp1";
		reg = <0x00 0xdb40000 0x00 0x1000>;
	};

	ap_dma@11000000 {
		compatible = "mediatek,ap_dma";
		reg = <0x00 0x11000000 0x00 0x1000>;
		interrupts = <0x00 0x61 0x08>;
	};

	auxadc@11001000 {
		compatible = "mediatek,mt6765-auxadc";
		reg = <0x00 0x11001000 0x00 0x1000>;
		interrupts = <0x00 0x4c 0x02>;
		clocks = <0x25 0x21>;
		clock-names = "main";
		#io-channel-cells = <0x01>;
		mediatek,cali-en-bit = <0x14>;
		mediatek,cali-ge-bit = <0x0a>;
		mediatek,cali-oe-bit = <0x00>;
		mediatek,cali-efuse-reg-offset = <0x1a8>;
		nvmem = <0x3b>;
		nvmem-names = "mtk_efuse";
		#interconnect-cells = <0x01>;
		phandle = <0x38>;
	};

	dma-controller@11000580 {
		compatible = "mediatek,mt6577-uart-dma";
		reg = <0x00 0x11000680 0x00 0x80 0x00 0x11000700 0x00 0x80 0x00 0x11000780 0x00 0x80 0x00 0x11000800 0x00 0x80>;
		interrupts = <0x00 0x6d 0x08 0x00 0x6e 0x08 0x00 0x6f 0x08 0x00 0x74 0x08>;
		dma-requests = <0x04>;
		clocks = <0x25 0x26>;
		clock-names = "apdma";
		#dma-cells = <0x01>;
		phandle = <0x49>;
	};

	serial@11020000 {
		compatible = "mediatek,mt6758-uart\0mediatek,mt6577-uart";
		reg = <0x00 0x11002000 0x00 0x1000>;
		interrupts = <0x00 0x5b 0x08>;
		clocks = <0x24 0x25 0x16>;
		clock-names = "baud\0bus";
		dmas = <0x49 0x00 0x49 0x01>;
		dma-names = "tx\0rx";
		phandle = <0xa9>;
	};

	serial@11030000 {
		compatible = "mediatek,mt6758-uart\0mediatek,mt6577-uart";
		reg = <0x00 0x11003000 0x00 0x1000>;
		interrupts = <0x00 0x5c 0x08>;
		clocks = <0x24 0x25 0x17>;
		clock-names = "baud\0bus";
		phandle = <0xaa>;
	};

	i2c_common {
		compatible = "mediatek,i2c_common";
		dma_support = [02];
		idvfs = [01];
		set_dt_div = [01];
		check_max_freq = [01];
		ver = [02];
		set_ltiming = [01];
		ext_time_config = [18 01];
		cnt_constraint = [01];
		phandle = <0xab>;
	};

	i2c0@11007000 {
		compatible = "mediatek,i2c";
		id = <0x00>;
		reg = <0x00 0x11007000 0x00 0x1000 0x00 0x11000080 0x00 0x80>;
		interrupts = <0x00 0x54 0x08>;
		clocks = <0x25 0x0b 0x25 0x26>;
		clock-names = "main\0dma";
		clock-div = <0x05>;
		scl-gpio-id = <0x53>;
		sda-gpio-id = <0x52>;
		gpio_start = <0x10002a00>;
		mem_len = <0x200>;
		eh_cfg = <0x20>;
		pu_cfg = <0x50>;
		rsel_cfg = <0x70>;
		aed = <0x1a>;
		mediatek,hs_only;
		phandle = <0xac>;
	};

	i2c1@11008000 {
		compatible = "mediatek,i2c";
		id = <0x01>;
		reg = <0x00 0x11008000 0x00 0x1000 0x00 0x11000100 0x00 0x80>;
		interrupts = <0x00 0x55 0x08>;
		clocks = <0x25 0x0b 0x25 0x26>;
		clock-names = "main\0dma";
		clock-div = <0x05>;
		scl-gpio-id = <0x54>;
		sda-gpio-id = <0x51>;
		gpio_start = <0x10002a00>;
		mem_len = <0x200>;
		eh_cfg = <0x20>;
		pu_cfg = <0x50>;
		rsel_cfg = <0x70>;
		aed = <0x1a>;
		mediatek,hs_only;
		phandle = <0xad>;
	};

	i2c2@11009000 {
		compatible = "mediatek,i2c";
		id = <0x02>;
		reg = <0x00 0x11009000 0x00 0x1000 0x00 0x11000180 0x00 0x180>;
		interrupts = <0x00 0x56 0x08>;
		clocks = <0x25 0x0b 0x25 0x26>;
		clock-names = "main\0dma";
		clock-div = <0x05>;
		scl-gpio-id = <0x67>;
		sda-gpio-id = <0x68>;
		gpio_start = <0x10002800>;
		mem_len = <0x200>;
		eh_cfg = <0x20>;
		pu_cfg = <0x60>;
		rsel_cfg = <0xa0>;
		aed = <0x1a>;
		ch_offset_default = <0x100>;
		ch_offset_ccu = <0x200>;
		mediatek,hs_only;
		phandle = <0xae>;
	};

	i2c3@1100f000 {
		compatible = "mediatek,i2c";
		id = <0x03>;
		reg = <0x00 0x1100f000 0x00 0x1000 0x00 0x11000300 0x00 0x100>;
		interrupts = <0x00 0x57 0x08>;
		clocks = <0x25 0x0b 0x25 0x26>;
		clock-names = "main\0dma";
		clock-div = <0x05>;
		scl-gpio-id = <0x32>;
		sda-gpio-id = <0x33>;
		gpio_start = <0x10002600>;
		mem_len = <0x200>;
		eh_cfg = <0x20>;
		pu_cfg = <0x90>;
		rsel_cfg = <0xb0>;
		aed = <0x1a>;
		ch_offset_default = <0x100>;
		mediatek,hs_only;
		phandle = <0xaf>;
	};

	i2c4@11011000 {
		compatible = "mediatek,i2c";
		id = <0x04>;
		reg = <0x00 0x11011000 0x00 0x1000 0x00 0x11000400 0x00 0x180>;
		interrupts = <0x00 0x58 0x08>;
		clocks = <0x25 0x0b 0x25 0x26>;
		clock-names = "main\0dma";
		clock-div = <0x05>;
		scl-gpio-id = <0x69>;
		sda-gpio-id = <0x6a>;
		gpio_start = <0x10002800>;
		mem_len = <0x200>;
		eh_cfg = <0x20>;
		pu_cfg = <0x60>;
		rsel_cfg = <0xa0>;
		aed = <0x1a>;
		ch_offset_default = <0x100>;
		ch_offset_ccu = <0x200>;
		mediatek,hs_only;
		phandle = <0xb0>;
	};

	i2c5@11016000 {
		compatible = "mediatek,i2c";
		id = <0x05>;
		reg = <0x00 0x11016000 0x00 0x1000 0x00 0x11000580 0x00 0x80>;
		interrupts = <0x00 0x82 0x08>;
		clocks = <0x25 0x0b 0x25 0x26>;
		clock-names = "main\0dma";
		clock-div = <0x05>;
		scl-gpio-id = <0x30>;
		sda-gpio-id = <0x31>;
		gpio_start = <0x10002600>;
		mem_len = <0x200>;
		eh_cfg = <0x20>;
		pu_cfg = <0x90>;
		rsel_cfg = <0xb0>;
		aed = <0x1a>;
		mediatek,hs_only;
		phandle = <0xb1>;
	};

	i2c6@1100d000 {
		compatible = "mediatek,i2c";
		id = <0x06>;
		reg = <0x00 0x1100d000 0x00 0x1000 0x00 0x11000600 0x00 0x80>;
		interrupts = <0x00 0x83 0x08>;
		clocks = <0x25 0x0b 0x25 0x26>;
		clock-names = "main\0dma";
		clock-div = <0x05>;
		scl-gpio-id = <0xa1>;
		sda-gpio-id = <0xa2>;
		gpio_start = <0x10002c00>;
		mem_len = <0x200>;
		eh_cfg = <0x20>;
		pu_cfg = <0x50>;
		rsel_cfg = <0x70>;
		aed = <0x1a>;
		ch_offset_default = <0x100>;
		ch_offset_ccu = <0x200>;
		mediatek,hs_only;
		phandle = <0xb2>;
	};

	pwm@11006000 {
		compatible = "mediatek,pwm";
		reg = <0x00 0x11006000 0x00 0x10000>;
		interrupts = <0x00 0x4d 0x08>;
		clocks = <0x25 0x10 0x25 0x11 0x25 0x12 0x25 0x13 0x25 0x14 0x25 0x30 0x25 0x0f 0x25 0x15>;
		clock-names = "PWM1-main\0PWM2-main\0PWM3-main\0PWM4-main\0PWM5-main\0PWM6-main\0PWM-HCLK-main\0PWM-main";
		phandle = <0xb3>;
	};

	spi@1100a000 {
		compatible = "mediatek,mt6765-spi";
		mediatek,pad-select = <0x00>;
		reg = <0x00 0x1100a000 0x00 0x1000>;
		interrupts = <0x00 0x76 0x08>;
		clocks = <0x26 0x0b 0x26 0x6b 0x25 0x1b>;
		clock-names = "parent-clk\0sel-clk\0spi-clk";
		phandle = <0xb4>;
	};

	therm_ctrl@1100b000 {
		compatible = "mediatek,therm_ctrl";
		reg = <0x00 0x1100b000 0x00 0x1000>;
		interrupts = <0x00 0x4e 0x08>;
		clocks = <0x25 0x0a>;
		clock-names = "therm-main";
		nvmem = <0x3b>;
		nvmem-names = "mtk_efuse";
		nvmem-cells = <0x4a 0x4b>;
		nvmem-cell-names = "cpu_freq_segment_cell\0thermal_efuse_cell";
	};

	thermal-sensor1 {
		compatible = "mediatek,mtboard-thermistor1";
		io-channels = <0x38 0x00>;
		io-channel-names = "thermistor-ch0";
		interconnects = <0x38 0x00>;
		phandle = <0xb5>;
	};

	thermal-sensor2 {
		compatible = "mediatek,mtboard-thermistor2";
		io-channels = <0x38 0x01>;
		io-channel-names = "thermistor-ch1";
		interconnects = <0x38 0x01>;
		phandle = <0xb6>;
	};

	thermal-sensor3 {
		compatible = "mediatek,mtboard-thermistor3";
		io-channels = <0x38 0x02>;
		io-channel-names = "thermistor-ch2";
		interconnects = <0x38 0x02>;
		phandle = <0xb7>;
	};

	btif@1100c000 {
		compatible = "mediatek,btif";
		reg = <0x00 0x1100c000 0x00 0x1000 0x00 0x11000880 0x00 0x80 0x00 0x11000900 0x00 0x80>;
		interrupts = <0x00 0x70 0x08 0x00 0x84 0x08 0x00 0x85 0x08>;
		clocks = <0x25 0x1a 0x25 0x26>;
		clock-names = "btifc\0apdmac";
	};

	consys@18002000 {
		compatible = "mediatek,mt6765-consys";
		#address-cells = <0x02>;
		#size-cells = <0x02>;
		reg = <0x00 0x18002000 0x00 0x1000 0x00 0x10007000 0x00 0x100 0x00 0x10001000 0x00 0x1000 0x00 0x10006000 0x00 0x1000 0x00 0x18007000 0x00 0x1000 0x00 0x180b1000 0x00 0x1000 0x00 0x180a3000 0x00 0x1000 0x00 0x180a5000 0x00 0x800 0x00 0x180c1000 0x00 0x1000 0x00 0x18004000 0x00 0x1000 0x00 0x00 0x00 0x00 0x00 0x00 0x00 0x00 0x00 0x1020e000 0x00 0x1000>;
		interrupts = <0x00 0x10b 0x08 0x00 0x10d 0x08 0x00 0x10e 0x01>;
		clocks = <0x35 0x01>;
		clock-names = "conn";
		pmic = <0x30>;
		memory-region = <0x4c>;
		phandle = <0x21>;
	};

	wifi@18000000 {
		compatible = "mediatek,wifi";
		reg = <0x00 0x18000000 0x00 0x100000>;
		interrupts = <0x00 0x10c 0x08>;
		memory-region = <0x4d>;
		phandle = <0xb8>;
	};

	disp_pwm@1100e000 {
		compatible = "mediatek,disp_pwm";
		reg = <0x00 0x1100e000 0x00 0x1000>;
	};

	spi@11010000 {
		compatible = "mediatek,mt6765-spi";
		mediatek,pad-select = <0x00>;
		reg = <0x00 0x11010000 0x00 0x1000>;
		interrupts = <0x00 0x7a 0x08>;
		clocks = <0x26 0x0b 0x26 0x6b 0x25 0x34>;
		clock-names = "parent-clk\0sel-clk\0spi-clk";
		phandle = <0xb9>;
	};

	spi@11012000 {
		compatible = "mediatek,mt6765-spi";
		mediatek,pad-select = <0x00>;
		reg = <0x00 0x11012000 0x00 0x1000>;
		interrupts = <0x00 0x80 0x08>;
		clocks = <0x26 0x0b 0x26 0x6b 0x25 0x37>;
		clock-names = "parent-clk\0sel-clk\0spi-clk";
		phandle = <0xba>;
	};

	spi@11013000 {
		compatible = "mediatek,mt6765-spi";
		mediatek,pad-select = <0x00>;
		reg = <0x00 0x11013000 0x00 0x1000>;
		interrupts = <0x00 0x81 0x08>;
		clocks = <0x26 0x0b 0x26 0x6b 0x25 0x38>;
		clock-names = "parent-clk\0sel-clk\0spi-clk";
		phandle = <0xbb>;
	};

	spi@11014000 {
		compatible = "mediatek,mt6765-spi";
		mediatek,pad-select = <0x00>;
		reg = <0x00 0x11014000 0x00 0x1000>;
		interrupts = <0x00 0x5f 0x08>;
		clocks = <0x26 0x0b 0x26 0x6b 0x25 0x41>;
		clock-names = "parent-clk\0sel-clk\0spi-clk";
		phandle = <0xbc>;
	};

	spi@11015000 {
		compatible = "mediatek,mt6765-spi";
		mediatek,pad-select = <0x00>;
		reg = <0x00 0x11015000 0x00 0x1000>;
		interrupts = <0x00 0x60 0x08>;
		clocks = <0x26 0x0b 0x26 0x6b 0x25 0x42>;
		clock-names = "parent-clk\0sel-clk\0spi-clk";
		phandle = <0xbd>;
	};

	imp_iic@11017000 {
		compatible = "mediatek,imp_iic";
		reg = <0x00 0x11017000 0x00 0x1000>;
	};

	nfi@11018000 {
		compatible = "mediatek,nfi";
		reg = <0x00 0x11018000 0x00 0x1000>;
	};

	nfiecc@11019000 {
		compatible = "mediatek,nfiecc";
		reg = <0x00 0x11019000 0x00 0x1000>;
	};

	usb0@11200000 {
		compatible = "mediatek,mt6765-usb20";
		reg = <0x00 0x11200000 0x00 0x10000 0x00 0x11cc0000 0x00 0x10000>;
		interrupts = <0x00 0x49 0x08>;
		mode = <0x02>;
		multipoint = <0x01>;
		num_eps = <0x10>;
		clocks = <0x25 0x08 0x26 0x76 0x26 0x20>;
		clock-names = "usb0\0usb0_clk_top_sel\0usb0_clk_univpll3_d4";
		pericfg = <0x4e>;
		interrupt-names = "mc";
		phys = <0x4f 0x03>;
		dr_mode = "otg";
		usb-role-switch;
		phandle = <0x69>;
	};

	usb-phy@11210000 {
		compatible = "mediatek,generic-tphy-v1";
		reg = <0x00 0x11cc0000 0x00 0x800>;
		#address-cells = <0x02>;
		#size-cells = <0x02>;
		ranges;
		status = "okay";
		phandle = <0xbe>;

		usb-phy@11210000 {
			reg = <0x00 0x11cc0800 0x00 0x100>;
			clocks = <0x24>;
			clock-names = "ref";
			#phy-cells = <0x01>;
			mediatek,eye-vrt = <0x06>;
			mediatek,eye-term = <0x03>;
			mediatek,eye-rev6 = <0x02>;
			mediatek,host-eye-vrt = <0x06>;
			mediatek,host-eye-term = <0x03>;
			mediatek,host-eye-rev6 = <0x03>;
			nvmem-cells = <0x50>;
			nvmem-cell-names = "intr_cal";
			nvmem-cell-masks = <0x1f>;
			status = "okay";
			phandle = <0x4f>;
		};
	};

	msdc@11230000 {
		compatible = "mediatek,msdc";
		reg = <0x00 0x11230000 0x00 0x10000>;
		interrupts = <0x00 0x4f 0x08>;
		index = [00];
		clk_src = [01];
		bus-width = <0x08>;
		max-frequency = <0xbebc200>;
		cap-mmc-highspeed;
		mmc-ddr-1_8v;
		mmc-hs200-1_8v;
		mmc-hs400-1_8v;
		no-sd;
		no-sdio;
		non-removable;
		pinctl = <0x51>;
		pinctl_hs400 = <0x52>;
		pinctl_hs200 = <0x53>;
		register_setting = <0x54>;
		host_function = [00];
		bootable;
		status = "okay";
		infracfg = <0x25>;
		topckgen = <0x26>;
		vmmc-supply = <0x55>;
		clocks = <0x25 0x4c 0x25 0x1c 0x25 0x44>;
		clock-names = "msdc0-clock\0msdc0-hclock\0msdc0-aes-clock";
		phandle = <0xbf>;
	};

	msdc@11240000 {
		compatible = "mediatek,msdc";
		reg = <0x00 0x11240000 0x00 0x10000>;
		interrupts = <0x00 0x50 0x08>;
		index = [01];
		clk_src = [02];
		bus-width = <0x04>;
		max-frequency = <0xbebc200>;
		cap-sd-highspeed;
		sd-uhs-sdr12;
		sd-uhs-sdr25;
		sd-uhs-sdr50;
		sd-uhs-sdr104;
		sd-uhs-ddr50;
		no-mmc;
		no-sdio;
		pinctl = <0x56>;
		pinctl_sdr104 = <0x57>;
		pinctl_sdr50 = <0x58>;
		pinctl_ddr50 = <0x59>;
		register_setting = <0x5a>;
		host_function = [01];
		cd_level = [01];
		cd-gpios = <0x1f 0x01 0x00>;
		status = "okay";
		vmmc-supply = <0x5b>;
		vqmmc-supply = <0x5c>;
		mediatek,pwrap-regmap = <0x2f>;
		clocks = <0x25 0x4d 0x25 0x1d>;
		clock-names = "msdc1-clock\0msdc1-hclock";
		phandle = <0xc0>;
	};

	msdc@11250000 {
		compatible = "mediatek,msdc2";
		reg = <0x00 0x11250000 0x00 0x10000>;
		status = "disable";
		phandle = <0xc1>;
	};

	msdc@11260000 {
		compatible = "mediatek,msdc3";
		reg = <0x00 0x11250000 0x00 0x10000>;
		status = "disable";
		phandle = <0xc2>;
	};

	msdc1_ins@0 {
		compatible = "mediatek,mt6765-sdcard-ins";
		phandle = <0xc3>;
	};

	msdc0_top@11cd0000 {
		compatible = "mediatek,msdc0_top";
		reg = <0x00 0x11cd0000 0x00 0x1000>;
	};

	msdc1_top@11c90000 {
		compatible = "mediatek,msdc1_top";
		reg = <0x00 0x11c90000 0x00 0x1000>;
	};

	usb1p_sif@11210000 {
		compatible = "mediatek,usb1p_sif";
		reg = <0x00 0x11210000 0x00 0x10000>;
	};

	audclk@11220000 {
		compatible = "mediatek,mt6765-audsys\0syscon";
		reg = <0x00 0x11220000 0x00 0x1000>;
		#clock-cells = <0x01>;
		phandle = <0x5e>;
	};

	audio@11220000 {
		compatible = "mediatek,audio\0syscon";
		reg = <0x00 0x11220000 0x00 0x1000>;
		mediatek,btcvsd_snd = <0x5d>;
		phandle = <0xc4>;
	};

	mt_soc_dl1_pcm@11220000 {
		compatible = "mediatek,mt_soc_pcm_dl1";
		reg = <0x00 0x11220000 0x00 0x1000>;
		interrupts = <0x00 0x99 0x08>;
		clocks = <0x5e 0x00 0x5e 0x04 0x5e 0x05 0x5e 0x03 0x5e 0x01 0x5e 0x02 0x5e 0x06 0x25 0x2b 0x25 0x33 0x26 0x6f 0x26 0x70 0x26 0x03 0x26 0x71 0x26 0x29 0x26 0x72 0x26 0x2c 0x03 0x08 0x24>;
		clock-names = "aud_afe_clk\0aud_dac_clk\0aud_dac_predis_clk\0aud_adc_clk\0aud_apll22m_clk\0aud_apll1_tuner_clk\0aud_tml_clk\0aud_infra_clk\0mtkaif_26m_clk\0top_mux_audio\0top_mux_audio_int\0top_sys_pll1_d4\0top_mux_aud_1\0top_apll1_ck\0top_mux_aud_eng1\0top_apll1_d8\0apmixed_apll1\0top_clk26m_clk";
		phandle = <0xc5>;
	};

	audio_sram@11221000 {
		compatible = "mediatek,audio_sram";
		reg = <0x00 0x11221000 0x00 0x9000>;
	};

	mtk-btcvsd-snd@18050000 {
		compatible = "mediatek,mtk-btcvsd-snd";
		reg = <0x00 0x18050000 0x00 0x1000 0x00 0x18080000 0x00 0x10000>;
		interrupts = <0x00 0x10a 0x08>;
		mediatek,infracfg = <0x25>;
		mediatek,offset = <0xf00 0x800 0x140 0x144 0x148>;
		disable_write_silence = <0x00>;
		phandle = <0x5d>;
	};

	mipi_rx_ana_csi0a@11c10000 {
		compatible = "mediatek,mt6765-mipi0a\0syscon";
		reg = <0x00 0x11c10000 0x00 0x1000>;
		#clock-cells = <0x01>;
		phandle = <0x67>;
	};

	mipi_rx_ana_csi0b@11c11000 {
		compatible = "mediatek,mt6765-mipi0b\0syscon";
		reg = <0x00 0x11c11000 0x00 0x1000>;
		#clock-cells = <0x01>;
		phandle = <0xc6>;
	};

	mipi_rx_ana_csi1a@11c12000 {
		compatible = "mediatek,mt6765-mipi1a\0syscon";
		reg = <0x00 0x11c12000 0x00 0x1000>;
		#clock-cells = <0x01>;
		phandle = <0xc7>;
	};

	mipi_rx_ana_csi1b@11c13000 {
		compatible = "mediatek,mt6765-mipi1b\0syscon";
		reg = <0x00 0x11c13000 0x00 0x1000>;
		#clock-cells = <0x01>;
		phandle = <0xc8>;
	};

	mipi_rx_ana_csi2a@11c14000 {
		compatible = "mediatek,mt6765-mipi2a\0syscon";
		reg = <0x00 0x11c14000 0x00 0x1000>;
		#clock-cells = <0x01>;
		phandle = <0xc9>;
	};

	mipi_rx_ana_csi2b@11c15000 {
		compatible = "mediatek,mt6765-mipi2b\0syscon";
		reg = <0x00 0x11c15000 0x00 0x1000>;
		#clock-cells = <0x01>;
		phandle = <0xca>;
	};

	efuse@11c50000 {
		compatible = "mediatek,devinfo";
		reg = <0x00 0x11c50000 0x00 0x10000>;
		#address-cells = <0x01>;
		#size-cells = <0x01>;
		phandle = <0x3b>;

		segment@78 {
			reg = <0x78 0x04>;
			phandle = <0x39>;
		};

		segment@1c {
			reg = <0x1c 0x04>;
			phandle = <0x4a>;
		};

		segment@190 {
			reg = <0x190 0x0c>;
			phandle = <0x4b>;
		};

		ly@210 {
			reg = <0x210 0x04>;
			phandle = <0x3a>;
		};

		u2_phy_data@1ac {
			reg = <0x1ac 0x04>;
			phandle = <0x50>;
		};
	};

	mipi_tx0@11c80000 {
		compatible = "mediatek,mipi_tx0";
		reg = <0x00 0x11c80000 0x00 0x10000>;
	};

	msdc1_pad_macro@11c90000 {
		compatible = "mediatek,msdc1_pad_macro";
		reg = <0x00 0x11c90000 0x00 0x10000>;
	};

	msdc0_pad_macro@11cd0000 {
		compatible = "mediatek,msdc0_pad_macro";
		reg = <0x00 0x11cd0000 0x00 0x10000>;
	};

	mfg_doma@13000000 {
		compatible = "mediatek,doma";
		reg = <0x00 0x13000000 0x00 0x80000>;
		interrupts = <0x00 0x103 0x08>;
		interrupt-names = "RGX";
		clock-frequency = <0x21f98280>;
		ged-supply = <0x5f>;
		phandle = <0xcb>;
	};

	mfg_cfg@13ffe000 {
		compatible = "mediatek,mfgcfg\0syscon";
		reg = <0x00 0x13ffe000 0x00 0x1000>;
		#clock-cells = <0x01>;
		phandle = <0xcc>;
	};

	gpufreq {
		compatible = "mediatek,mt6765-gpufreq";
		clocks = <0x26 0x64 0x26 0x26 0x24 0x35 0x08 0x35 0x04 0x35 0x07>;
		clock-names = "clk_mux\0clk_main_parent\0clk_sub_parent\0mtcmos_mfg_async\0mtcmos_mfg\0mtcmos_mfg_core0";
		nvmem-cells = <0x39>;
		nvmem-cell-names = "efuse_segment_cell";
		vcore-supply = <0x37>;
		phandle = <0x60>;
	};

	ged {
		compatible = "mediatek,ged";
		gpufreq-supply = <0x60>;
		phandle = <0x5f>;
	};

	mmsys_config@14000000 {
		compatible = "mediatek,mt6765-mmsys_config\0syscon";
		reg = <0x00 0x14000000 0x00 0x1000>;
		interrupts = <0x00 0xe3 0x08>;
		#clock-cells = <0x01>;
		phandle = <0x61>;
	};

	dispsys_config@14000000 {
		compatible = "mediatek,mmsys_config\0syscon";
		reg = <0x00 0x14000000 0x00 0x1000>;
		interrupts = <0x00 0xab 0x08>;
		clocks = <0x61 0x17 0x61 0x1a 0x61 0x1b>;
		clock-names = "CAM_MDP\0IMG_DL_RELAY\0IMG_DL_ASYNC_TOP";
		phandle = <0x3c>;
	};

	hwinfo {
		compatible = "ontim,hwinfo";
		base-gpios = <0x1f 0x00 0x00>;
		discrete-memory-gpios = <0x1f 0xa3 0x00>;
		phandle = <0xcd>;
	};

	nfc {
		compatible = "mediatek,nfc-gpio-v2";
		gpio-rst = <0xac>;
		gpio-rst-std = <0x1f 0xac 0x00>;
		gpio-irq = <0x0a>;
		gpio-irq-std = <0x1f 0x0a 0x00>;
		phandle = <0xce>;
	};

	als_ps@0 {
		compatible = "mediatek,als_ps";
		status = "okay";
		pinctrl-names = "plv3v_enable\0plv3v_disable";
		pinctrl-0 = <0x62>;
		pinctrl-1 = <0x63>;
		phandle = <0xcf>;
	};

	irq_nfc {
		compatible = "mediatek,irq_nfc-eint";
		phandle = <0xd0>;
	};

	pn544 {
		compatible = "nxp,pn544";
		phandle = <0xd1>;
	};

	disp_mutex0@14001000 {
		compatible = "mediatek,disp_mutex0";
		reg = <0x00 0x14001000 0x00 0x1000>;
		interrupts = <0x00 0xd2 0x08>;
		phandle = <0x45>;
	};

	smi_common@14002000 {
		compatible = "mediatek,smi_common";
		reg = <0x00 0x14002000 0x00 0x1000>;
		mmsys_config = <0x3c>;
		clocks = <0x35 0x03 0x61 0x15 0x61 0x16 0x61 0x13 0x26 0x62 0x26 0x21 0x26 0x17 0x26 0x22>;
		clock-names = "mtcmos-mm\0smi-common-gals-comm0\0smi-common-gals-comm1\0smi-common\0mmdvfs_clk_mm_sel_ck\0mmdvfs_clk_mmpll_ck\0mmdvfs_clk_univpll1_d2_ck\0mmdvfs_clk_mmpll_d2_ck";
		mediatek,smi-id = <0x04>;
		mediatek,smi-cnt = <0x05>;
		phandle = <0xd2>;
	};

	mmdvfs_pmqos {
		compatible = "mediatek,mmdvfs_pmqos";
		mm_step0 = <0x1c9 0x01 0x00 0x01>;
		mm_step1 = <0x138 0x01 0x00 0x02>;
		mm_step2 = <0xe4 0x01 0x00 0x03>;
		vopp_steps = <0x00 0x01 0x03>;
		disp_freq = "mm_step0\0mm_step1\0mm_step2";
		mdp_freq = "mm_step0\0mm_step1\0mm_step2";
		cam_freq = "mm_step0\0mm_step1\0mm_step2";
		img_freq = "mm_step0\0mm_step1\0mm_step2";
		vdec_freq = "mm_step0\0mm_step1\0mm_step2";
		venc_freq = "mm_step0\0mm_step1\0mm_step2";
		clocks = <0x26 0x62 0x26 0x21 0x26 0x17 0x26 0x22>;
		clock-names = "mmdvfs_clk_mm_sel_ck\0mmdvfs_clk_mmpll_ck\0mmdvfs_clk_univpll1_d2_ck\0mmdvfs_clk_mmpll_d2_ck";
	};

	imgsys_clk@15020000 {
		compatible = "mediatek,mt6765-imgsys\0syscon";
		reg = <0x00 0x15020000 0x00 0x1000>;
		#clock-cells = <0x01>;
		phandle = <0x64>;
	};

	imgsys@15020000 {
		compatible = "mediatek,imgsys\0syscon";
		reg = <0x00 0x15020000 0x00 0x1000>;
		clocks = <0x35 0x03 0x35 0x05 0x35 0x09 0x64 0x01 0x65 0x02 0x65 0x03 0x65 0x05 0x65 0x06 0x65 0x07>;
		clock-names = "ISP_SCP_SYS_DIS\0ISP_SCP_SYS_ISP\0ISP_SCP_SYS_CAM\0ISP_CLK_IMG_DIP\0ISP_CLK_CAM\0ISP_CLK_CAMTG\0ISP_CLK_CAMSV0\0ISP_CLK_CAMSV1\0ISP_CLK_CAMSV2";
	};

	dip1@15022000 {
		compatible = "mediatek,dip1";
		reg = <0x00 0x15022000 0x00 0x3000>;
		interrupts = <0x00 0xff 0x08>;
	};

	dpe@15028000 {
		compatible = "mediatek,dpe";
		reg = <0x00 0x15028000 0x00 0x1000>;
		interrupts = <0x00 0x100 0x08>;
		clocks = <0x64 0x03>;
		clock-names = "DPE_CG_IMG_DPE";
	};

	smi_larb0@14003000 {
		cell-index = <0x00>;
		compatible = "mediatek,smi_larb0\0mediatek,smi_larb";
		reg = <0x00 0x14003000 0x00 0x1000>;
		mediatek,larb-id = <0x00>;
		clocks = <0x35 0x03 0x61 0x14>;
		clock-names = "mtcmos-mm\0mm-larb0";
		mediatek,smi-id = <0x00>;
		phandle = <0xd3>;
	};

	mdp_rdma0@14004000 {
		compatible = "mediatek,mdp_rdma0";
		reg = <0x00 0x14004000 0x00 0x1000>;
		interrupts = <0x00 0xd3 0x08>;
		clocks = <0x61 0x00>;
		clock-names = "MDP_RDMA0";
		phandle = <0x3d>;
	};

	mdp_ccorr0@14005000 {
		compatible = "mediatek,mdp_ccorr0";
		reg = <0x00 0x14005000 0x00 0x1000>;
		interrupts = <0x00 0xe2 0x08>;
		clocks = <0x61 0x01>;
		clock-names = "MDP_CCORR";
		phandle = <0x44>;
	};

	mdp_rsz0@14006000 {
		compatible = "mediatek,mdp_rsz0";
		reg = <0x00 0x14006000 0x00 0x1000>;
		interrupts = <0x00 0xd4 0x08>;
		clocks = <0x61 0x02>;
		clock-names = "MDP_RSZ0";
		phandle = <0x3e>;
	};

	mdp_rsz1@14007000 {
		compatible = "mediatek,mdp_rsz1";
		reg = <0x00 0x14007000 0x00 0x1000>;
		interrupts = <0x00 0xd5 0x08>;
		clocks = <0x61 0x03>;
		clock-names = "MDP_RSZ1";
		phandle = <0x3f>;
	};

	mdp_wdma0@14008000 {
		compatible = "mediatek,mdp_wdma0";
		reg = <0x00 0x14008000 0x00 0x1000>;
		interrupts = <0x00 0xd8 0x08>;
		clocks = <0x61 0x06>;
		clock-names = "MDP_WDMA";
		phandle = <0x40>;
	};

	mdp_wrot0@14009000 {
		compatible = "mediatek,mdp_wrot0";
		reg = <0x00 0x14009000 0x00 0x1000>;
		interrupts = <0x00 0xd7 0x08>;
		clocks = <0x61 0x05>;
		clock-names = "MDP_WROT0";
		phandle = <0x41>;
	};

	mdp_tdshp0@1400a000 {
		compatible = "mediatek,mdp_tdshp0";
		reg = <0x00 0x1400a000 0x00 0x1000>;
		clocks = <0x61 0x04>;
		clock-names = "MDP_TDSHP";
		phandle = <0x42>;
	};

	disp_ovl0@1400b000 {
		compatible = "mediatek,disp_ovl0";
		reg = <0x00 0x1400b000 0x00 0x1000>;
		interrupts = <0x00 0xd9 0x08>;
	};

	disp_ovl0_2l@1400c000 {
		compatible = "mediatek,disp_ovl0_2l";
		reg = <0x00 0x1400c000 0x00 0x1000>;
		interrupts = <0x00 0xe5 0x08>;
	};

	disp_rdma0@1400d000 {
		compatible = "mediatek,disp_rdma0";
		reg = <0x00 0x1400d000 0x00 0x1000>;
		interrupts = <0x00 0xda 0x08>;
	};

	disp_wdma0@1400e000 {
		compatible = "mediatek,disp_wdma0";
		reg = <0x00 0x1400e000 0x00 0x1000>;
		interrupts = <0x00 0xdb 0x08>;
	};

	disp_color0@1400f000 {
		compatible = "mediatek,disp_color0";
		reg = <0x00 0x1400f000 0x00 0x1000>;
		interrupts = <0x00 0xdc 0x08>;
		clocks = <0x61 0x0c>;
		clock-names = "MDP_COLOR";
		phandle = <0x43>;
	};

	disp_ccorr0@14010000 {
		compatible = "mediatek,disp_ccorr0";
		reg = <0x00 0x14010000 0x00 0x1000>;
		interrupts = <0x00 0xdd 0x08>;
	};

	disp_aal0@14011000 {
		compatible = "mediatek,disp_aal0";
		reg = <0x00 0x14011000 0x00 0x1000>;
		interrupts = <0x00 0xde 0x08>;
	};

	disp_gamma0@14012000 {
		compatible = "mediatek,disp_gamma0";
		reg = <0x00 0x14012000 0x00 0x1000>;
		interrupts = <0x00 0xdf 0x08>;
	};

	disp_dither0@14013000 {
		compatible = "mediatek,disp_dither0";
		reg = <0x00 0x14013000 0x00 0x1000>;
		interrupts = <0x00 0xe0 0x08>;
	};

	dsi0@14014000 {
		compatible = "mediatek,dsi0";
		reg = <0x00 0x14014000 0x00 0x1000>;
		interrupts = <0x00 0xe1 0x08>;
	};

	disp_rsz0@14015000 {
		compatible = "mediatek,disp_rsz0";
		reg = <0x00 0x14015000 0x00 0x1000>;
		interrupts = <0x00 0x114 0x08>;
	};

	mtkfb@0 {
		compatible = "mediatek,mtkfb";
		phandle = <0xd4>;
	};

	dispsys {
		compatible = "mediatek,dispsys";
		clocks = <0x35 0x03 0x61 0x13 0x61 0x14 0x61 0x15 0x61 0x16 0x61 0x07 0x61 0x08 0x61 0x0a 0x61 0x0b 0x61 0x0c 0x61 0x0d 0x61 0x0e 0x61 0x0f 0x61 0x10 0x61 0x11 0x61 0x1c 0x61 0x1d 0x61 0x09 0x03 0x15 0x26 0x73 0x25 0x31 0x24 0x26 0x1b 0x26 0x2e 0x26 0x30>;
		clock-names = "MMSYS_MTCMOS\0MMSYS_SMI_COMMON\0MMSYS_SMI_LARB0\0MMSYS_GALS_COMM0\0MMSYS_GALS_COMM1\0MMSYS_DISP_OVL0\0MMSYS_DISP_OVL0_2L\0MMSYS_DISP_RDMA0\0MMSYS_DISP_WDMA0\0MMSYS_DISP_COLOR0\0MMSYS_DISP_CCORR0\0MMSYS_DISP_AAL0\0MMSYS_DISP_GAMMA0\0MMSYS_DISP_DITHER0\0MMSYS_DSI0_MM_CK\0MMSYS_DSI0_IF_CK\0MMSYS_26M\0MMSYS_DISP_RSZ0\0APMIXED_MIPI_26M\0TOP_MUX_DISP_PWM\0DISP_PWM\0TOP_26M\0TOP_UNIVPLL2_D4\0TOP_ULPOSC1_D2\0TOP_ULPOSC1_D8";
	};

	dsi_te {
		compatible = "mediatek, DSI_TE-eint";
		status = "disabled";
		phandle = <0xd5>;
	};

	smi_larb2@15021000 {
		cell-index = <0x02>;
		compatible = "mediatek,smi_larb2\0mediatek,smi_larb";
		reg = <0x00 0x15021000 0x00 0x1000>;
		mediatek,larb-id = <0x02>;
		clocks = <0x35 0x05 0x61 0x18 0x64 0x00>;
		clock-names = "mtcmos-isp\0gals-img2mm\0img-larb2";
		mediatek,smi-id = <0x02>;
		phandle = <0xd6>;
	};

	fdvt@1502b000 {
		compatible = "mediatek,fdvt";
		reg = <0x00 0x1502b000 0x00 0x1000>;
		interrupts = <0x00 0x102 0x08>;
		clocks = <0x64 0x02>;
		clock-names = "FD_CLK_IMG_FDVT";
	};

	vcodecsys@17000000 {
		compatible = "mediatek,mt6765-vcodecsys\0syscon";
		reg = <0x00 0x17000000 0x00 0x10000>;
		#clock-cells = <0x01>;
		phandle = <0x66>;
	};

	venc_gcon@17000000 {
		compatible = "mediatek,venc_gcon\0syscon";
		reg = <0x00 0x17000000 0x00 0x10000>;
		clocks = <0x35 0x03 0x35 0x0a 0x61 0x15 0x61 0x16 0x61 0x13 0x66 0x03 0x66 0x01>;
		clock-names = "MT_SCP_SYS_DIS\0MT_SCP_SYS_VCODEC\0MT_CG_MM_SMI_COMM0\0MT_CG_MM_SMI_COMM1\0MT_CG_MM_SMI_COMMON\0MT_CG_VDEC\0MT_CG_VENC";
		phandle = <0xd7>;
	};

	smi_larb1@17010000 {
		cell-index = <0x01>;
		compatible = "mediatek,smi_larb1\0mediatek,smi_larb";
		reg = <0x00 0x17010000 0x00 0x1000>;
		mediatek,larb-id = <0x01>;
		clocks = <0x35 0x0a 0x66 0x01>;
		clock-names = "mtcmos-vcodec\0venc-larb1";
		mediatek,smi-id = <0x01>;
		phandle = <0xd8>;
	};

	venc@17020000 {
		compatible = "mediatek,venc";
		reg = <0x00 0x17020000 0x00 0x10000>;
		interrupts = <0x00 0xe6 0x08>;
	};

	venc_jpg@17030000 {
		compatible = "mediatek,venc_jpg";
		reg = <0x00 0x17030000 0x00 0x10000>;
		interrupts = <0x00 0xe8 0x08>;
		clocks = <0x66 0x02>;
		clock-names = "MT_CG_VENC_JPGENC";
	};

	vdec@17040000 {
		compatible = "mediatek,vdec";
		reg = <0x00 0x17040000 0x00 0x10000>;
		interrupts = <0x00 0xe9 0x08>;
	};

	mbist@17050000 {
		compatible = "mediatek,mbist";
		reg = <0x00 0x17050000 0x00 0x10000>;
	};

	camsys@1a000000 {
		compatible = "mediatek,mt6765-camsys\0syscon";
		reg = <0x00 0x1a000000 0x00 0x1000>;
		#clock-cells = <0x01>;
		phandle = <0x65>;
	};

	camsysisp@1a000000 {
		compatible = "mediatek,camsys\0syscon";
		reg = <0x00 0x1a000000 0x00 0x1000>;
		#clock-cells = <0x01>;
		phandle = <0xd9>;
	};

	smi_larb3@1a002000 {
		cell-index = <0x03>;
		compatible = "mediatek,smi_larb3\0mediatek,smi_larb";
		reg = <0x00 0x1a002000 0x00 0x1000>;
		mediatek,larb-id = <0x03>;
		clocks = <0x35 0x09 0x61 0x19 0x65 0x00>;
		clock-names = "mtcmos-cam\0gals-cam2mm\0cam-larb3";
		mediatek,smi-id = <0x03>;
		phandle = <0xda>;
	};

	cam1@1a003000 {
		compatible = "mediatek,cam1";
		reg = <0x00 0x1a003000 0x00 0x1000>;
		interrupts = <0x00 0xeb 0x08>;
	};

	cam2@1a004000 {
		compatible = "mediatek,cam2";
		reg = <0x00 0x1a004000 0x00 0x1000>;
		interrupts = <0x00 0xec 0x08>;
	};

	cam3@1a005000 {
		compatible = "mediatek,cam3";
		reg = <0x00 0x1a005000 0x00 0x1000>;
		interrupts = <0x00 0xed 0x08>;
	};

	cam_set@1a00b000 {
		compatible = "mediatek,cam_set";
		reg = <0x00 0x1a00b000 0x00 0x1000>;
	};

	cama_set@1a00c000 {
		compatible = "mediatek,cama_set";
		reg = <0x00 0x1a00c000 0x00 0x1000>;
	};

	camb_set@1a00d000 {
		compatible = "mediatek,camb_set";
		reg = <0x00 0x1a00d000 0x00 0x1000>;
	};

	cam_inner@1a013000 {
		compatible = "mediatek,cam_inner";
		reg = <0x00 0x1a013000 0x00 0x1000>;
	};

	cama_inner@1a014000 {
		compatible = "mediatek,cama_inner";
		reg = <0x00 0x1a014000 0x00 0x1000>;
	};

	camb_inner@1a015000 {
		compatible = "mediatek,camb_inner";
		reg = <0x00 0x1a015000 0x00 0x1000>;
	};

	cam_clear@1a01b000 {
		compatible = "mediatek,cam_clear";
		reg = <0x00 0x1a01b000 0x00 0x1000>;
	};

	cama_clear@1a01c000 {
		compatible = "mediatek,cama_clear";
		reg = <0x00 0x1a01c000 0x00 0x1000>;
	};

	camb_clear@1a01d000 {
		compatible = "mediatek,camb_clear";
		reg = <0x00 0x1a01d000 0x00 0x1000>;
	};

	cama_ext@1a024000 {
		compatible = "mediatek,cama_ext";
		reg = <0x00 0x1a024000 0x00 0x1000>;
	};

	camb_ext@1a025000 {
		compatible = "mediatek,camb_ext";
		reg = <0x00 0x1a025000 0x00 0x1000>;
	};

	seninf1@1a040000 {
		compatible = "mediatek,seninf1";
		reg = <0x00 0x1a040000 0x00 0x1000>;
	};

	seninf2@1a041000 {
		compatible = "mediatek,seninf2";
		reg = <0x00 0x1a041000 0x00 0x1000>;
	};

	seninf3@1a042000 {
		compatible = "mediatek,seninf3";
		reg = <0x00 0x1a042000 0x00 0x1000>;
	};

	seninf4@1a043000 {
		compatible = "mediatek,seninf4";
		reg = <0x00 0x1a043000 0x00 0x1000>;
	};

	kd_camera_hw1@1a040000 {
		compatible = "mediatek,camera_hw";
		reg = <0x00 0x1a040000 0x00 0x1000>;
		clocks = <0x26 0x66 0x26 0x67 0x26 0x68 0x26 0x69 0x26 0x14 0x26 0x13 0x26 0x1d 0x26 0x11 0x26 0x1c 0x26 0x12 0x24 0x65 0x04 0x03 0x0e 0x03 0x12 0x67 0x00 0x26 0x7d 0x26 0x1a 0x35 0x09>;
		clock-names = "CLK_TOP_CAMTG_SEL\0CLK_TOP_CAMTG1_SEL\0CLK_TOP_CAMTG2_SEL\0CLK_TOP_CAMTG3_SEL\0CLK_MCLK_6M\0CLK_MCLK_12M\0CLK_MCLK_13M\0CLK_MCLK_48M\0CLK_MCLK_52M\0CLK_MCLK_24M\0CLK_MCLK_26M\0CLK_CAM_SENINF_CG\0CLK_MIPI_C0_26M_CG\0CLK_MIPI_C1_26M_CG\0CLK_MIPI_ANA_0A_CG\0CLK_TOP_CAMTM_SEL_CG\0CLK_TOP_CAMTM_208_CG\0CLK_SCP_SYS_CAM";
		phandle = <0xdb>;
	};

	camsv1@1a050000 {
		compatible = "mediatek,camsv1";
		reg = <0x00 0x1a050000 0x00 0x1000>;
		interrupts = <0x00 0xf3 0x08>;
	};

	camsv2@1a051000 {
		compatible = "mediatek,camsv2";
		reg = <0x00 0x1a051000 0x00 0x1000>;
		interrupts = <0x00 0xf4 0x08>;
	};

	camsv3@1a052000 {
		compatible = "mediatek,camsv3";
		reg = <0x00 0x1a052000 0x00 0x1000>;
		interrupts = <0x00 0xf1 0x08>;
	};

	camsv4@1a053000 {
		compatible = "mediatek,camsv4";
		reg = <0x00 0x1a053000 0x00 0x1000>;
		interrupts = <0x00 0xf2 0x08>;
	};

	camera_af_hw_node {
		compatible = "mediatek,camera_af_lens";
		phandle = <0xdc>;
	};

	flashlight_core {
		compatible = "mediatek,flashlight_core";
		phandle = <0xdd>;
	};

	flashlights_mt6370 {
		compatible = "mediatek,flashlights_mt6370";
		decouple = <0x00>;
		phandle = <0xde>;

		channel@1 {
			type = <0x00>;
			ct = <0x00>;
			part = <0x00>;
		};

		channel@2 {
			type = <0x00>;
			ct = <0x01>;
			part = <0x00>;
		};
	};

	flashlights_ocp8135b {
		compatible = "mediatek,flashlights_ocp8135b";
		phandle = <0xdf>;
	};

	gps {
		compatible = "mediatek,gps";
	};

	ccu@1a0b1000 {
		compatible = "mediatek,ccu";
		reg = <0x00 0x1a0b1000 0x00 0x1000>;
		interrupts = <0x00 0xf6 0x08>;
		clocks = <0x65 0x08 0x35 0x09>;
		clock-names = "CCU_CLK_CAM_CCU\0CAM_PWR";
	};

	lk_charger {
		compatible = "mediatek,lk_charger";
		enable_anime;
		enable_pe_plus;
		enable_pd20_reset;
		power_path_support;
		max_charger_voltage = <0x632ea0>;
		fast_charge_voltage = <0x2dc6c0>;
		usb_charger_current = <0x7a120>;
		ac_charger_current = <0x1e8480>;
		ac_charger_input_current = <0x16e360>;
		non_std_ac_charger_current = <0x7a120>;
		charging_host_charger_current = <0x16e360>;
		ta_ac_charger_current = <0x2dc6c0>;
		pd_charger_current = <0x7a120>;
		temp_t4_threshold = <0x32>;
		temp_t3_threshold = <0x2d>;
		temp_t1_threshold = <0x00>;
		phandle = <0xe0>;
	};

	pe {
		compatible = "mediatek,charger,pe";
		gauge = <0x68>;
		ta_9v_support;
		pe_ichg_level_threshold = <0xf4240>;
		ta_start_battery_soc = <0x00>;
		ta_stop_battery_soc = <0x55>;
		min_charger_voltage = <0x4630c0>;
		ta_ac_12v_input_current = <0x186a00>;
		ta_ac_9v_input_current = <0x186a00>;
		ta_ac_7v_input_current = <0x200b20>;
		pe_charger_current = <0x27ac40>;
		phandle = <0xe1>;
	};

	pe2 {
		compatible = "mediatek,charger,pe2";
		gauge = <0x68>;
		pe20_ichg_level_threshold = <0xf4240>;
		ta_start_battery_soc = <0x00>;
		ta_stop_battery_soc = <0x55>;
		min_charger_voltage = <0x4630c0>;
		cable_imp_threshold = <0x2bb>;
		vbat_cable_imp_threshold = <0x3b8260>;
		sc_input_current = <0x1e8480>;
		sc_charger_current = <0x27ac40>;
		dcs_input_current = <0x30d400>;
		dcs_chg1_charger_current = <0x16e360>;
		dcs_chg2_charger_current = <0x16e360>;
		dual_polling_ieoc = <0x6ddd0>;
		slave_mivr_diff = <0x186a0>;
		phandle = <0xe2>;
	};

	charger {
		compatible = "mediatek,charger";
		gauge = <0x68>;
		charger = <0x29>;
		bootmode = <0x2a>;
		pmic = <0x30>;
		algorithm_name = "Basic";
		charger_configuration = <0x00>;
		battery_cv = <0x445c00>;
		max_charger_voltage = <0xa037a0>;
		min_charger_voltage = <0x4630c0>;
		usb_charger_current = <0x7a120>;
		ac_charger_current = <0x249f00>;
		ac_charger_input_current = <0x200b20>;
		charging_host_charger_current = <0x16e360>;
		enable_dynamic_mivr;
		min_charger_voltage_1 = <0x432380>;
		min_charger_voltage_2 = <0x401640>;
		max_dmivr_charger_current = <0x1b7740>;
		enable_sw_jeita;
		jeita_temp_above_t4_cv = <0x401640>;
		jeita_temp_t3_to_t4_cv = <0x401640>;
		jeita_temp_t2_to_t3_cv = <0x445c00>;
		jeita_temp_t1_to_t2_cv = <0x445c00>;
		jeita_temp_t0_to_t1_cv = <0x445c00>;
		jeita_temp_below_t0_cv = <0x401640>;
		temp_t4_thres = <0x37>;
		temp_t4_thres_minus_x_degree = <0x34>;
		temp_t3_thres = <0x2e>;
		temp_t3_thres_minus_x_degree = <0x27>;
		temp_t2_thres = <0x0f>;
		temp_t2_thres_plus_x_degree = <0x12>;
		temp_t1_thres = <0x0f>;
		temp_t1_thres_plus_x_degree = <0x12>;
		temp_t0_thres = <0x00>;
		temp_t0_thres_plus_x_degree = <0x02>;
		temp_neg_10_thres = <0x00>;
		enable_min_charge_temp;
		min_charge_temp = <0x00>;
		min_charge_temp_plus_x_degree = <0x02>;
		max_charge_temp = <0x37>;
		max_charge_temp_minus_x_degree = <0x34>;
		phandle = <0x2e>;
	};

	pd_adapter {
		compatible = "mediatek,pd_adapter";
		adapter_name = "pd_adapter";
		phandle = <0xe3>;
	};

	extcon_usb {
		compatible = "mediatek,extcon-usb";
		charger = <0x29>;
		dev-conn = <0x69>;
		mediatek,bypss-typec-sink = <0x01>;
		phandle = <0xe4>;
	};

	rt9465_slave_chr {
		compatible = "richtek,rt9465";
		status = "disabled";
		phandle = <0xe5>;
	};

	rt-pd-manager {
		compatible = "mediatek,rt-pd-manager";
	};

	mt6370_pmu_eint {
		phandle = <0xe6>;
	};

	mt6370_pd_eint {
		phandle = <0xe7>;
	};

	irtx_pwm {
		compatible = "mediatek,irtx-pwm";
		pwm_ch = <0x00>;
		pwm_data_invert = <0x00>;
		phandle = <0xe8>;
	};

	odm {
		compatible = "simple-bus";
		phandle = <0xe9>;
	};

	memory-ssmr-features {
		compatible = "mediatek,memory-ssmr-features";
		svp-region-based-size = <0x00 0x10000000>;
		wfd-size = <0x00 0x4000000>;
		phandle = <0xea>;
	};

	ssmr {
		compatible = "mediatek,trusted_mem";
		memory-region = <0x6a>;
	};

	radio_md_cfg {
		compatible = "mediatek,radio_md_cfg";
		phandle = <0xeb>;
	};

	dynamic_options {
		compatible = "mediatek,dynamic_options";
		phandle = <0xec>;
	};

	audio_snd_card {
		compatible = "mediatek,audio_snd_card";
	};

	mt_soc_deep_buffer_dl_pcm {
		compatible = "mediatek,mt_soc_pcm_deep_buffer_dl";
	};

	mt_soc_ul1_pcm {
		compatible = "mediatek,mt_soc_pcm_capture";
	};

	mt_soc_voice_md1 {
		compatible = "mediatek,mt_soc_pcm_voice_md1";
	};

	mt_soc_uldlloopback_pcm {
		compatible = "mediatek,mt_soc_pcm_uldlloopback";
	};

	mt_soc_i2s0_pcm {
		compatible = "mediatek,mt_soc_pcm_dl1_i2s0";
	};

	mt_soc_mrgrx_pcm {
		compatible = "mediatek,mt_soc_pcm_mrgrx";
	};

	mt_soc_mrgrx_awb_pcm {
		compatible = "mediatek,mt_soc_pcm_mrgrx_awb";
	};

	mt_soc_fm_i2s_pcm {
		compatible = "mediatek,mt_soc_pcm_fm_i2s";
	};

	mt_soc_fm_i2s_awb_pcm {
		compatible = "mediatek,mt_soc_pcm_fm_i2s_awb";
	};

	mt_soc_i2s0dl1_pcm {
		compatible = "mediatek,mt_soc_pcm_dl1_i2s0dl1";
	};

	mt_soc_dl1_awb_pcm {
		compatible = "mediatek,mt_soc_pcm_dl1_awb";
	};

	mt_soc_voice_md1_bt {
		compatible = "mediatek,mt_soc_pcm_voice_md1_bt";
	};

	mt_soc_voip_bt_out {
		compatible = "mediatek,mt_soc_pcm_dl1_bt";
	};

	mt_soc_voip_bt_in {
		compatible = "mediatek,mt_soc_pcm_bt_dai";
	};

	mt_soc_tdmrx_pcm {
		compatible = "mediatek,mt_soc_tdm_capture";
	};

	mt_soc_fm_mrgtx_pcm {
		compatible = "mediatek,mt_soc_pcm_fmtx";
	};

	mt_soc_ul2_pcm {
		compatible = "mediatek,mt_soc_pcm_capture2";
	};

	mt_soc_i2s0_awb_pcm {
		compatible = "mediatek,mt_soc_pcm_i2s0_awb";
	};

	mt_soc_voice_md2 {
		compatible = "mediatek,mt_soc_pcm_voice_md2";
	};

	mt_soc_pcm_dl1_scp_spk {
		compatible = "mediatek,mt_soc_pcm_dl1_scp_spk";
	};

	mt_soc_pcm_voice_scp {
		compatible = "mediatek,mt_soc_pcm_voice_scp";
	};

	mt_soc_routing_pcm {
		compatible = "mediatek,mt_soc_pcm_routing";
	};

	mt_soc_voice_md2_bt {
		compatible = "mediatek,mt_soc_pcm_voice_md2_bt";
	};

	mt_soc_hp_impedance_pcm {
		compatible = "mediatek,mt_soc_pcm_hp_impedance";
	};

	mt_soc_codec_name {
		compatible = "mediatek,mt_soc_codec_63xx";
		use_hp_depop_flow = <0x00>;
		use_ul_260k = <0x00>;
	};

	mt_soc_dummy_pcm {
		compatible = "mediatek,mt_soc_pcm_dummy";
	};

	mt_soc_codec_dummy_name {
		compatible = "mediatek,mt_soc_codec_dummy";
	};

	mt_soc_routing_dai_name {
		compatible = "mediatek,mt_soc_dai_routing";
	};

	mt_soc_dai_name {
		compatible = "mediatek,mt_soc_dai_stub";
	};

	mt_soc_dl2_pcm {
		compatible = "mediatek,mt_soc_pcm_dl2";
	};

	mt_soc_anc_pcm {
		compatible = "mediatek,mt_soc_pcm_anc";
	};

	mt_soc_pcm_voice_ultra {
		compatible = "mediatek,mt_soc_pcm_voice_ultra";
	};

	mt_soc_pcm_voice_usb {
		compatible = "mediatek,mt_soc_pcm_voice_usb";
	};

	mt_soc_pcm_voice_usb_echoref {
		compatible = "mediatek,mt_soc_pcm_voice_usb_echoref";
	};

	pmic_clock_buffer_ctrl {
		compatible = "mediatek,pmic_clock_buffer";
		mediatek,clkbuf-quantity = <0x07>;
		mediatek,clkbuf-config = <0x02 0x01 0x01 0x02 0x00 0x00 0x00>;
		mediatek,clkbuf-driving-current = <0x01 0x01 0x01 0x01 0x01 0x01 0x01>;
		mediatek,bblpm-support = "enable";
		pwrap-dcxo-en = <0x188 0x00 0x188 0x01 0x188 0x00>;
		pwrap-dcxo-cfg = <0x18c 0x19c>;
		spm-pwr-status = <0x180 0x00 0x180 0x01>;
		pwrap = <0x2f>;
		sleep = <0x6b>;
		phandle = <0xed>;
	};

	eas {
		eff_turn_point = <0x1d3>;
		tiny = <0x32>;
	};

	i2c7 {
		phandle = <0xee>;
	};

	i2c8 {
		phandle = <0xef>;
	};

	i2c9 {
		phandle = <0xf0>;
	};

	smart_pa {
		phandle = <0xf1>;
	};

	md1_sim1_hot_plug_eint {
		phandle = <0xf2>;
	};

	md1_sim2_hot_plug_eint {
		phandle = <0xf3>;
	};

	cm_mgr@10200000 {
		compatible = "mediatek,mt6765-cm_mgr";
		reg = <0x00 0x10200000 0x00 0x4000>;
		reg-names = "cm_mgr_base";
		required-opps = <0x31 0x32 0x33>;
		cm_mgr,cp_down = <0x64 0x64>;
		cm_mgr,cp_up = <0x64 0x64>;
		cm_mgr,dt_down = <0x00 0x03>;
		cm_mgr,dt_up = <0x00 0x03>;
		cm_mgr,vp_down = <0x64 0x64>;
		cm_mgr,vp_up = <0x64 0x64>;
		phandle = <0xf4>;
	};

	dram_ctrl {
		compatible = "mediatek,dram-qosctrl";
		required-opps = <0x31 0x32>;
	};

	trusty {
		compatible = "android,trusty-smc-v1";
		ranges;
		#address-cells = <0x02>;
		#size-cells = <0x02>;
		tee-id = <0x00>;
		tee-name = "trusty";

		mtee {
			compatible = "mediatek,trusty-mtee-v1";
		};

		gz-main {
			compatible = "mediatek,trusty-gz";
		};

		trusty-irq {
			compatible = "android,trusty-irq-v1";
			ppi-interrupt-parent = <0x16>;
		};

		trusty-virtio {
			compatible = "android,trusty-virtio-v1";
		};

		trusty-gz-log {
			compatible = "android,trusty-gz-log-v1";
		};
	};

	nebula {
		compatible = "android,nebula-smc-v1";
		ranges;
		#address-cells = <0x02>;
		#size-cells = <0x02>;
		tee-id = <0x01>;
		tee-name = "nebula";

		nebula-virtio {
			compatible = "android,nebula-virtio-v1";
		};

		nebula-irq {
			compatible = "android,nebula-irq-v1";
			ppi-interrupt-parent = <0x16>;
		};

		nebula-gz-log {
			compatible = "android,nebula-gz-log-v1";
		};
	};

	__symbols__ {
		chosen = "/chosen";
		cluster0_opp = "/opp_table0";
		cluster1_opp = "/opp_table1";
		cci_opp = "/opp_table2";
		cci = "/cci";
		cpu0 = "/cpus/cpu@000";
		cpu1 = "/cpus/cpu@001";
		cpu2 = "/cpus/cpu@002";
		cpu3 = "/cpus/cpu@003";
		cpu4 = "/cpus/cpu@100";
		cpu5 = "/cpus/cpu@101";
		cpu6 = "/cpus/cpu@102";
		cpu7 = "/cpus/cpu@103";
		STANDBY = "/cpus/idle-states/standby";
		MCDI_CPU = "/cpus/idle-states/mcdi-cpu";
		MCDI_CLUSTER = "/cpus/idle-states/mcdi-cluster";
		SODI = "/cpus/idle-states/sodi";
		SODI3 = "/cpus/idle-states/sodi3";
		DPIDLE = "/cpus/idle-states/dpidle";
		SUSPEND = "/cpus/idle-states/suspend";
		reserved_memory = "/reserved-memory";
		consys_mem = "/reserved-memory/consys-reserve-memory";
		wifi_mem = "/reserved-memory/wifi-reserve-memory";
		ssmr_cma_mem = "/reserved-memory/ssmr-reserved-cma_memory";
		cpu_dbgapb = "/cpu_dbgapb@0d410000";
		gic = "/interrupt-controller@0c000000";
		dcm = "/dcm@10001000";
		sysirq = "/intpol-controller@10200a80";
		infracfg_ao = "/infracfg_ao@10001000";
		scpsys = "/scpsys@10001000";
		topckgen = "/topckgen@10000000";
		scp_infra = "/scp_infra@10001000";
		io_cfg_lt = "/io_cfg_lt@10002000";
		io_cfg_lm = "/io_cfg_lm@10002200";
		io_cfg_lb = "/io_cfg_lb@10002400";
		io_cfg_bl = "/io_cfg_bl@10002600";
		io_cfg_rr = "/io_cfg_rr@10002800";
		io_cfg_rb = "/io_cfg_rb@10002a00";
		io_cfg_rt = "/io_cfg_rt@10002c00";
		pericfg = "/pericfg@10003000";
		gpio_usage_mapping = "/gpio";
		eint = "/eint@1000b000";
		gpio = "/gpio@10005000";
		pio = "/pinctrl@1000b000";
		pl_v3v_enable = "/pinctrl@1000b000/plv3venable";
		pl_v3v_disable = "/pinctrl@1000b000/plv3vdisable";
		msdc0_pins_default = "/pinctrl@1000b000/msdc0@default";
		msdc0_pins_hs400 = "/pinctrl@1000b000/msdc0@hs400";
		msdc0_pins_hs200 = "/pinctrl@1000b000/msdc0@hs200";
		msdc0_register_setting_default = "/pinctrl@1000b000/msdc0@register_default";
		msdc1_pins_default = "/pinctrl@1000b000/msdc1@default";
		msdc1_pins_sdr104 = "/pinctrl@1000b000/msdc1@sdr104";
		msdc1_pins_sdr50 = "/pinctrl@1000b000/msdc1@sdr50";
		msdc1_pins_ddr50 = "/pinctrl@1000b000/msdc1@ddr50";
		msdc1_register_setting_default = "/pinctrl@1000b000/msdc1@register_default";
		msdc3_pins_default = "/pinctrl@1000b000/msdc3@default";
		msdc3_register_setting_default = "/pinctrl@1000b000/msdc3@register_default";
		sleep = "/sleep@10006000";
		toprgu = "/toprgu@10007000";
		hwrng = "/hwrng";
		clk26m = "/clocks/clk26m";
		clk13m = "/clocks/clk13m";
		clk32k = "/clocks/clk32k";
		apmixed = "/apmixed@1000c000";
		pwrap = "/pwrap@1000d000";
		main_pmic = "/pwrap@1000d000/main_pmic";
		pmic_accdet = "/pwrap@1000d000/main_pmic/pmic_accdet";
		mt6357keys = "/pwrap@1000d000/main_pmic/mt6357keys";
		pmic_auxadc = "/pwrap@1000d000/main_pmic/pmic_auxadc";
		mtk_gauge = "/pwrap@1000d000/main_pmic/mtk_gauge";
		mtk_charger_type = "/pwrap@1000d000/main_pmic/mtk_charger_type";
		mt6357_charger = "/pwrap@1000d000/main_pmic/mt6357_charger";
		mtk_ts_pmic = "/pwrap@1000d000/main_pmic/mtk_ts_pmic";
		mt6357_ts_buck1 = "/pwrap@1000d000/main_pmic/mt6357_ts_buck1";
		mt6357_ts_buck2 = "/pwrap@1000d000/main_pmic/mt6357_ts_buck2";
		pmic_efuse = "/pwrap@1000d000/main_pmic/pmic_efuse";
		mt6357regulator = "/pwrap@1000d000/main_pmic/mt6357regulator";
		mt_pmic_vs1_buck_reg = "/pwrap@1000d000/main_pmic/mt6357regulator/buck_vs1";
		mt_pmic_vmodem_buck_reg = "/pwrap@1000d000/main_pmic/mt6357regulator/buck_vmodem";
		mt_pmic_vcore_buck_reg = "/pwrap@1000d000/main_pmic/mt6357regulator/buck_vcore";
		mt_pmic_vproc_buck_reg = "/pwrap@1000d000/main_pmic/mt6357regulator/buck_vproc";
		mt_pmic_vpa_buck_reg = "/pwrap@1000d000/main_pmic/mt6357regulator/buck_vpa";
		mt_pmic_vfe28_ldo_reg = "/pwrap@1000d000/main_pmic/mt6357regulator/ldo_vfe28";
		mt_pmic_vxo22_ldo_reg = "/pwrap@1000d000/main_pmic/mt6357regulator/ldo_vxo22";
		mt_pmic_vrf18_ldo_reg = "/pwrap@1000d000/main_pmic/mt6357regulator/ldo_vrf18";
		mt_pmic_vrf12_ldo_reg = "/pwrap@1000d000/main_pmic/mt6357regulator/ldo_vrf12";
		mt_pmic_vefuse_ldo_reg = "/pwrap@1000d000/main_pmic/mt6357regulator/ldo_vefuse";
		mt_pmic_vcn33_bt_ldo_reg = "/pwrap@1000d000/main_pmic/mt6357regulator/ldo_vcn33_bt";
		mt_pmic_vcn33_wifi_ldo_reg = "/pwrap@1000d000/main_pmic/mt6357regulator/ldo_vcn33_wifi";
		mt_pmic_vcn28_ldo_reg = "/pwrap@1000d000/main_pmic/mt6357regulator/ldo_vcn28";
		mt_pmic_vcn18_ldo_reg = "/pwrap@1000d000/main_pmic/mt6357regulator/ldo_vcn18";
		mt_pmic_vcama_ldo_reg = "/pwrap@1000d000/main_pmic/mt6357regulator/ldo_vcama";
		mt_pmic_vcamd_ldo_reg = "/pwrap@1000d000/main_pmic/mt6357regulator/ldo_vcamd";
		mt_pmic_vcamio_ldo_reg = "/pwrap@1000d000/main_pmic/mt6357regulator/ldo_vcamio";
		mt_pmic_vldo28_ldo_reg = "/pwrap@1000d000/main_pmic/mt6357regulator/ldo_vldo28";
		mt_pmic_vsram_others_ldo_reg = "/pwrap@1000d000/main_pmic/mt6357regulator/ldo_vsram_others";
		mt_pmic_vsram_proc_ldo_reg = "/pwrap@1000d000/main_pmic/mt6357regulator/ldo_vsram_proc";
		mt_pmic_vaux18_ldo_reg = "/pwrap@1000d000/main_pmic/mt6357regulator/ldo_vaux18";
		mt_pmic_vaud28_ldo_reg = "/pwrap@1000d000/main_pmic/mt6357regulator/ldo_vaud28";
		mt_pmic_vio28_ldo_reg = "/pwrap@1000d000/main_pmic/mt6357regulator/ldo_vio28";
		mt_pmic_vio18_ldo_reg = "/pwrap@1000d000/main_pmic/mt6357regulator/ldo_vio18";
		mt_pmic_vdram_ldo_reg = "/pwrap@1000d000/main_pmic/mt6357regulator/ldo_vdram";
		mt_pmic_vmc_ldo_reg = "/pwrap@1000d000/main_pmic/mt6357regulator/ldo_vmc";
		mt_pmic_vmch_ldo_reg = "/pwrap@1000d000/main_pmic/mt6357regulator/ldo_vmch";
		mt_pmic_vemc_ldo_reg = "/pwrap@1000d000/main_pmic/mt6357regulator/ldo_vemc";
		mt_pmic_vsim1_ldo_reg = "/pwrap@1000d000/main_pmic/mt6357regulator/ldo_vsim1";
		mt_pmic_vsim2_ldo_reg = "/pwrap@1000d000/main_pmic/mt6357regulator/ldo_vsim2";
		mt_pmic_vibr_ldo_reg = "/pwrap@1000d000/main_pmic/mt6357regulator/ldo_vibr";
		mt_pmic_vusb33_ldo_reg = "/pwrap@1000d000/main_pmic/mt6357regulator/ldo_vusb33";
		mtk_rtc = "/pwrap@1000d000/main_pmic/mtk_rtc";
		fg_init = "/pwrap@1000d000/main_pmic/mtk_rtc/fg_init";
		fg_soc = "/pwrap@1000d000/main_pmic/mtk_rtc/fg_soc";
		ext_32k = "/pwrap@1000d000/main_pmic/mtk_rtc/ext_32k";
		pmic_codec = "/pwrap@1000d000/main_pmic/pmic_codec";
		clock_buffer_ctrl = "/pwrap@1000d000/main_pmic/clock_buffer_ctrl";
		keypad = "/kp@10010000";
		otg_iddig = "/otg_iddig";
		mrdump_ext_rst = "/mrdump_ext_rst";
		touch = "/touch";
		accdet = "/accdet";
		usb_cable = "/usb_cable";
		goodix_fp = "/fingerprint";
		fingerprint_pinctrl = "/fingerprint_pinctrl";
		fps_fpc_eint = "/fps_fpc_eint";
		fps_egis_eint = "/fps_egis_eint";
		dvfsrc = "/dvfsrc@10012000";
		dvfsrc_freq_opp2 = "/dvfsrc@10012000/opp2";
		dvfsrc_freq_opp1 = "/dvfsrc@10012000/opp1";
		dvfsrc_freq_opp0 = "/dvfsrc@10012000/opp0";
		timer = "/timer@10017000";
		ccifdriver = "/ccifdriver@10209000";
		cldmadriver = "/cldmadriver@10014000";
		mddriver = "/mddriver@10014000";
		md_auxadc = "/md_auxadc";
		gce = "/gce@10238000";
		gce_mbox = "/gce_mbox@10238000";
		gce_mbox_svp = "/gce_mbox_svp@10238000";
		auxadc = "/auxadc@11001000";
		apdma = "/dma-controller@11000580";
		uart0 = "/serial@11020000";
		uart1 = "/serial@11030000";
		i2c_common = "/i2c_common";
		i2c0 = "/i2c0@11007000";
		i2c1 = "/i2c1@11008000";
		i2c2 = "/i2c2@11009000";
		i2c3 = "/i2c3@1100f000";
		i2c4 = "/i2c4@11011000";
		i2c5 = "/i2c5@11016000";
		i2c6 = "/i2c6@1100d000";
		pwm = "/pwm@11006000";
		spi0 = "/spi@1100a000";
		tboard_thermistor1 = "/thermal-sensor1";
		tboard_thermistor2 = "/thermal-sensor2";
		tboard_thermistor3 = "/thermal-sensor3";
		consys = "/consys@18002000";
		wifi = "/wifi@18000000";
		spi1 = "/spi@11010000";
		spi2 = "/spi@11012000";
		spi3 = "/spi@11013000";
		spi4 = "/spi@11014000";
		spi5 = "/spi@11015000";
		usb = "/usb0@11200000";
		u2phy0 = "/usb-phy@11210000";
		u2port0 = "/usb-phy@11210000/usb-phy@11210000";
		msdc0 = "/msdc@11230000";
		msdc1 = "/msdc@11240000";
		msdc2 = "/msdc@11250000";
		msdc3 = "/msdc@11260000";
		msdc1_ins = "/msdc1_ins@0";
		audclk = "/audclk@11220000";
		audio = "/audio@11220000";
		audgpio = "/mt_soc_dl1_pcm@11220000";
		btcvsd_snd = "/mtk-btcvsd-snd@18050000";
		mipi_rx_ana_csi0a = "/mipi_rx_ana_csi0a@11c10000";
		mipi_rx_ana_csi0b = "/mipi_rx_ana_csi0b@11c11000";
		mipi_rx_ana_csi1a = "/mipi_rx_ana_csi1a@11c12000";
		mipi_rx_ana_csi1b = "/mipi_rx_ana_csi1b@11c13000";
		mipi_rx_ana_csi2a = "/mipi_rx_ana_csi2a@11c14000";
		mipi_rx_ana_csi2b = "/mipi_rx_ana_csi2b@11c15000";
		efuse = "/efuse@11c50000";
		efuse_segment = "/efuse@11c50000/segment@78";
		cpu_freq_segment = "/efuse@11c50000/segment@1c";
		thermal_efuse = "/efuse@11c50000/segment@190";
		efuse_ly = "/efuse@11c50000/ly@210";
		u2_phy_data = "/efuse@11c50000/u2_phy_data@1ac";
		mfg_doma = "/mfg_doma@13000000";
		mfg_cfg = "/mfg_cfg@13ffe000";
		gpufreq = "/gpufreq";
		ged = "/ged";
		mmsys_config = "/mmsys_config@14000000";
		dispsys_config = "/dispsys_config@14000000";
		hwinfo = "/hwinfo";
		nfc = "/nfc";
		als = "/als_ps@0";
		irq_nfc = "/irq_nfc";
		pn544 = "/pn544";
		disp_mutex0 = "/disp_mutex0@14001000";
		smi_common = "/smi_common@14002000";
		imgsys = "/imgsys_clk@15020000";
		smi_larb0 = "/smi_larb0@14003000";
		mdp_rdma0 = "/mdp_rdma0@14004000";
		mdp_ccorr = "/mdp_ccorr0@14005000";
		mdp_rsz0 = "/mdp_rsz0@14006000";
		mdp_rsz1 = "/mdp_rsz1@14007000";
		mdp_wdma0 = "/mdp_wdma0@14008000";
		mdp_wrot0 = "/mdp_wrot0@14009000";
		mdp_tdshp0 = "/mdp_tdshp0@1400a000";
		disp_color0 = "/disp_color0@1400f000";
		mtkfb = "/mtkfb@0";
		dsi_te = "/dsi_te";
		smi_larb2 = "/smi_larb2@15021000";
		vcodecsys = "/vcodecsys@17000000";
		venc_gcon = "/venc_gcon@17000000";
		smi_larb1 = "/smi_larb1@17010000";
		camsys = "/camsys@1a000000";
		camsys1 = "/camsysisp@1a000000";
		smi_larb3 = "/smi_larb3@1a002000";
		kd_camera_hw1 = "/kd_camera_hw1@1a040000";
		camera_af_hw_node = "/camera_af_hw_node";
		flashlight_core = "/flashlight_core";
		flashlights_mt6370 = "/flashlights_mt6370";
		flashlights_ocp8135b = "/flashlights_ocp8135b";
		lk_charger = "/lk_charger";
		pe = "/pe";
		pe2 = "/pe2";
		charger = "/charger";
		pd_adapter = "/pd_adapter";
		extcon_usb = "/extcon_usb";
		rt9465_slave_chr = "/rt9465_slave_chr";
		subpmic_pmu_eint = "/mt6370_pmu_eint";
		tcpc_pd = "/mt6370_pd_eint";
		irtx_pwm = "/irtx_pwm";
		odm = "/odm";
		memory_ssmr_features = "/memory-ssmr-features";
		radio_md_cfg = "/radio_md_cfg";
		dynamic_options = "/dynamic_options";
		pmic_clock_buffer_ctrl = "/pmic_clock_buffer_ctrl";
		i2c7 = "/i2c7";
		i2c8 = "/i2c8";
		i2c9 = "/i2c9";
		smart_pa = "/smart_pa";
		md1_sim1_hot_plug_eint = "/md1_sim1_hot_plug_eint";
		md1_sim2_hot_plug_eint = "/md1_sim2_hot_plug_eint";
		cm_mgr = "/cm_mgr@10200000";
	};
};
